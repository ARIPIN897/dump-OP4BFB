/dts-v1/;

/ {
	#address-cells = <0x2>;
	#size-cells = <0x2>;
	compatible = "mediatek,MT6765";
	interrupt-parent = <0x1>;
	model = "MT6765";

	__symbols__ {
		DPIDLE = "/cpus/idle-states/dpidle";
		MCDI_CLUSTER = "/cpus/idle-states/mcdi-cluster";
		MCDI_CPU = "/cpus/idle-states/mcdi-cpu";
		SODI = "/cpus/idle-states/sodi";
		SODI3 = "/cpus/idle-states/sodi3";
		STANDBY = "/cpus/idle-states/standby";
		SUSPEND = "/cpus/idle-states/suspend";
		accdet = "/accdet";
		alsps_mtk = "/alsps_mtk";
		apdma = "/dma-controller@11000580";
		apmixed = "/apmixed@1000c000";
		audgpio = "/mt_soc_dl1_pcm@11220000";
		audio = "/audio@11220000";
		auxadc = "/auxadc@11001000";
		bat_gm30 = "/battery";
		camsys = "/camsys@1a000000";
		charger = "/charger";
		chosen = "/chosen";
		chr_stat = "/chr_stat";
		clk26m = "/clocks/clk26m";
		clk32k = "/clocks/clk32k";
		consys = "/consys@18002000";
		cpu0 = "/cpus/cpu@000";
		cpu1 = "/cpus/cpu@001";
		cpu2 = "/cpus/cpu@002";
		cpu3 = "/cpus/cpu@003";
		cpu4 = "/cpus/cpu@100";
		cpu5 = "/cpus/cpu@101";
		cpu6 = "/cpus/cpu@102";
		cpu7 = "/cpus/cpu@103";
		cpu_dbgapb = "/cpu_dbgapb@0d410000";
		disp_color0 = "/disp_color0@1400f000";
		disp_mutex0 = "/disp_mutex0@14001000";
		dsi_te = "/dsi_te";
		dynamic_options = "/dynamic_options";
		flashlight_core = "/flashlight_core";
		flashlight_pins_default = "/pinctrl@1000b000/flashlight_pins_default";
		flashlight_pins_srobe_off = "/pinctrl@1000b000/flashlight_pins_srobe_off";
		flashlight_pins_srobe_on = "/pinctrl@1000b000/flashlight_pins_srobe_on";
		flashlight_pins_torch_off = "/pinctrl@1000b000/flashlight_pins_torch_off";
		flashlight_pins_torch_on = "/pinctrl@1000b000/flashlight_pins_torch_on";
		flashlight_pins_torch_pwm = "/pinctrl@1000b000/flashlight_pins_torch_pwm";
		flashlights_cola = "/flashlights_cola";
		flashlights_cola_pins_hwen_default = "/pinctrl@1000b000/hwen_default";
		flashlights_cola_pins_hwen_high = "/pinctrl@1000b000/hwen_high";
		flashlights_cola_pins_hwen_low = "/pinctrl@1000b000/hwen_low";
		flashlights_gpio = "/flashlights_gpio";
		flashlights_mt6370 = "/flashlights_mt6370";
		gce = "/gce@10238000";
		gce_mbox = "/gce_mbox@10238000";
		gce_mbox_svp = "/gce_mbox_svp@10238000";
		gic = "/interrupt-controller@0c000000";
		gpio = "/gpio@10005000";
		gpio_usage_mapping = "/gpio";
		gse_1 = "/gse_1";
		i2c0 = "/i2c0@11007000";
		i2c1 = "/i2c1@11008000";
		i2c2 = "/i2c2@11009000";
		i2c3 = "/i2c3@1100f000";
		i2c4 = "/i2c4@11011000";
		i2c5 = "/i2c5@11016000";
		i2c6 = "/i2c6@1100d000";
		i2c7 = "/i2c7";
		i2c8 = "/i2c8";
		i2c9 = "/i2c9";
		i2c_common = "/i2c_common";
		iddig_high = "/pinctrl@1000b000/iddig_high";
		iddig_low = "/pinctrl@1000b000/iddig_low";
		imgsys = "/imgsys@15020000";
		infracfg_ao = "/infracfg_ao@10001000";
		iommu = "/m4u@10205000";
		irq_nfc = "/irq_nfc";
		irtx_pwm = "/irtx_pwm";
		kd_camera_hw1 = "/kd_camera_hw1@1a040000";
		keypad = "/kp@10010000";
		lcm = "/lcm";
		lk_charger = "/lk_charger";
		main_pmic = "/mt-pmic";
		md1_sim1_hot_plug_eint = "/md1_sim1_hot_plug_eint";
		md1_sim2_hot_plug_eint = "/md1_sim2_hot_plug_eint";
		mdcldma = "/mdcldma@10014000";
		mdp_ccorr = "/mdp_ccorr0@14005000";
		mdp_rdma0 = "/mdp_rdma0@14004000";
		mdp_rsz0 = "/mdp_rsz0@14006000";
		mdp_rsz1 = "/mdp_rsz1@14007000";
		mdp_tdshp0 = "/mdp_tdshp0@1400a000";
		mdp_wdma0 = "/mdp_wdma0@14008000";
		mdp_wrot0 = "/mdp_wrot0@14009000";
		mfg_cfg = "/mfg_cfg@13ffe000";
		mipi_rx_ana_csi0a = "/mipi_rx_ana_csi0a@11c10000";
		mipi_rx_ana_csi0b = "/mipi_rx_ana_csi0b@11c11000";
		mipi_rx_ana_csi1a = "/mipi_rx_ana_csi1a@11c12000";
		mipi_rx_ana_csi1b = "/mipi_rx_ana_csi1b@11c13000";
		mipi_rx_ana_csi2a = "/mipi_rx_ana_csi2a@11c14000";
		mipi_rx_ana_csi2b = "/mipi_rx_ana_csi2b@11c15000";
		mmsys_config = "/mmsys_config@14000000";
		mrdump_ext_rst = "/mrdump_ext_rst";
		msdc0 = "/msdc@11230000";
		msdc0_pins_default = "/pinctrl@1000b000/msdc0@default";
		msdc0_pins_hs200 = "/pinctrl@1000b000/msdc0@hs200";
		msdc0_pins_hs400 = "/pinctrl@1000b000/msdc0@hs400";
		msdc0_register_setting_default = "/pinctrl@1000b000/msdc0@register_default";
		msdc1 = "/msdc@11240000";
		msdc1_ins = "/msdc1_ins@0";
		msdc1_pins_ddr50 = "/pinctrl@1000b000/msdc1@ddr50";
		msdc1_pins_default = "/pinctrl@1000b000/msdc1@default";
		msdc1_pins_sdr104 = "/pinctrl@1000b000/msdc1@sdr104";
		msdc1_pins_sdr50 = "/pinctrl@1000b000/msdc1@sdr50";
		msdc1_register_setting_default = "/pinctrl@1000b000/msdc1@register_default";
		msdc2 = "/msdc@11250000";
		msdc3 = "/msdc@11260000";
		msdc3_pins_default = "/pinctrl@1000b000/msdc3@default";
		msdc3_register_setting_default = "/pinctrl@1000b000/msdc3@register_default";
		mt6370_pmu = "/mt6370_pmu_dts";
		mt6370_typec = "/type_c_port0";
		mt_charger = "/mt_charger";
		mt_pmic_vaud28_ldo_reg = "/mt-pmic/ldo_regulators/ldo_vaud28";
		mt_pmic_vaux18_ldo_reg = "/mt-pmic/ldo_regulators/ldo_vaux18";
		mt_pmic_vcama_ldo_reg = "/mt-pmic/ldo_regulators/ldo_vcama";
		mt_pmic_vcamd_ldo_reg = "/mt-pmic/ldo_regulators/ldo_vcamd";
		mt_pmic_vcamio_ldo_reg = "/mt-pmic/ldo_regulators/ldo_vcamio";
		mt_pmic_vcn18_ldo_reg = "/mt-pmic/ldo_regulators/ldo_vcn18";
		mt_pmic_vcn28_ldo_reg = "/mt-pmic/ldo_regulators/ldo_vcn28";
		mt_pmic_vcn33_bt_ldo_reg = "/mt-pmic/ldo_regulators/ldo_vcn33_bt";
		mt_pmic_vcn33_wifi_ldo_reg = "/mt-pmic/ldo_regulators/ldo_vcn33_wifi";
		mt_pmic_vcore_buck_reg = "/mt-pmic/buck_regulators/buck_vcore";
		mt_pmic_vdram_ldo_reg = "/mt-pmic/ldo_regulators/ldo_vdram";
		mt_pmic_vefuse_ldo_reg = "/mt-pmic/ldo_regulators/ldo_vefuse";
		mt_pmic_vemc_ldo_reg = "/mt-pmic/ldo_regulators/ldo_vemc";
		mt_pmic_vfe28_ldo_reg = "/mt-pmic/ldo_regulators/ldo_vfe28";
		mt_pmic_vibr_ldo_reg = "/mt-pmic/ldo_regulators/ldo_vibr";
		mt_pmic_vio18_ldo_reg = "/mt-pmic/ldo_regulators/ldo_vio18";
		mt_pmic_vio28_ldo_reg = "/mt-pmic/ldo_regulators/ldo_vio28";
		mt_pmic_vldo28_ldo_reg = "/mt-pmic/ldo_regulators/ldo_vldo28";
		mt_pmic_vmc_ldo_reg = "/mt-pmic/ldo_regulators/ldo_vmc";
		mt_pmic_vmch_ldo_reg = "/mt-pmic/ldo_regulators/ldo_vmch";
		mt_pmic_vmodem_buck_reg = "/mt-pmic/buck_regulators/buck_vmodem";
		mt_pmic_vpa_buck_reg = "/mt-pmic/buck_regulators/buck_vpa";
		mt_pmic_vproc_buck_reg = "/mt-pmic/buck_regulators/buck_vproc";
		mt_pmic_vrf12_ldo_reg = "/mt-pmic/ldo_regulators/ldo_vrf12";
		mt_pmic_vrf18_ldo_reg = "/mt-pmic/ldo_regulators/ldo_vrf18";
		mt_pmic_vs1_buck_reg = "/mt-pmic/buck_regulators/buck_vs1";
		mt_pmic_vsim1_ldo_reg = "/mt-pmic/ldo_regulators/ldo_vsim1";
		mt_pmic_vsim2_ldo_reg = "/mt-pmic/ldo_regulators/ldo_vsim2";
		mt_pmic_vsram_others_ldo_reg = "/mt-pmic/ldo_regulators/ldo_vsram_others";
		mt_pmic_vsram_proc_ldo_reg = "/mt-pmic/ldo_regulators/ldo_vsram_proc";
		mt_pmic_vusb33_ldo_reg = "/mt-pmic/ldo_regulators/ldo_vusb33";
		mt_pmic_vxo22_ldo_reg = "/mt-pmic/ldo_regulators/ldo_vxo22";
		mtkfb = "/mtkfb@0";
		nfc = "/nfc";
		odm = "/odm";
		oppo_secure_common = "/oppo_secure_common";
		otg_iddig = "/otg_iddig";
		pericfg = "/pericfg@10003000";
		pio = "/pinctrl@1000b000";
		pmic_auxadc = "/mt-pmic/mt635x-auxadc";
		pmic_clock_buffer_ctrl = "/pmic_clock_buffer_ctrl";
		pwm = "/pwm@11006000";
		radio_md_cfg = "/radio_md_cfg";
		reserved_memory = "/reserved-memory";
		rt9465_slave_chr = "/rt9465_slave_chr";
		scpsys = "/scpsys@10001000";
		silead_fp = "/silead_fp";
		smart_pa = "/smart_pa";
		smi_larb0 = "/smi_larb0@14003000";
		smi_larb1 = "/smi_larb1@17010000";
		smi_larb2 = "/smi_larb2@15021000";
		smi_larb3 = "/smi_larb3@1a002000";
		spi0 = "/spi@1100a000";
		spi1 = "/spi@11010000";
		spi2 = "/spi@11012000";
		spi3 = "/spi@11013000";
		spi4 = "/spi@11014000";
		spi5 = "/spi@11015000";
		subpmic_pmu_eint = "/mt6370_pmu_eint";
		swtp = "/swtp";
		swtp_1 = "/swtp_1";
		syscfg_pctl_0 = "/syscfg_pctl_0@10005000";
		syscfg_pctl_1 = "/syscfg_pctl_1@0x10002000";
		syscfg_pctl_2 = "/syscfg_pctl_2@0x10002200";
		syscfg_pctl_3 = "/syscfg_pctl_3@0x10002400";
		syscfg_pctl_4 = "/syscfg_pctl_4@0x10002600";
		syscfg_pctl_5 = "/syscfg_pctl_5@0x10002800";
		syscfg_pctl_6 = "/syscfg_pctl_6@0x10002a00";
		syscfg_pctl_7 = "/syscfg_pctl_7@0x10002c00";
		sysirq = "/intpol-controller@10200a80";
		tcpc_pd = "/mt6370_pd_eint";
		topckgen = "/topckgen@10000000";
		touch = "/touch";
		uart0 = "/serial@11020000";
		uart1 = "/serial@11030000";
		venc_gcon = "/venc_gcon@17000000";
	};

	accdet {
		compatible = "mediatek,pmic-accdet";
		linux,phandle = <0x81>;
		phandle = <0x81>;
	};

	aes_top0@10016000 {
		compatible = "mediatek,aes_top0";
		reg = <0x0 0x10016000 0x0 0x1000>;
	};

	alsps_mtk {
		linux,phandle = <0xb8>;
		phandle = <0xb8>;
	};

	ap_ccif0@10209000 {
		compatible = "mediatek,ap_ccif0";
		interrupts = <0x0 0x94 0x8>;
		reg = <0x0 0x10209000 0x0 0x1000>;
	};

	ap_ccif1@1020b000 {
		compatible = "mediatek,ap_ccif1";
		interrupts = <0x0 0x96 0x8>;
		reg = <0x0 0x1020b000 0x0 0x1000>;
	};

	ap_ccif2@1023c000 {
		compatible = "mediatek,ap_ccif2";
		interrupts = <0x0 0x8f 0x8>;
		reg = <0x0 0x1023c000 0x0 0x1000>;
	};

	ap_ccif3@1023e000 {
		compatible = "mediatek,ap_ccif3";
		interrupts = <0x0 0x92 0x8>;
		reg = <0x0 0x1023e000 0x0 0x1000>;
	};

	ap_dma@11000000 {
		compatible = "mediatek,ap_dma";
		interrupts = <0x0 0x61 0x8>;
		reg = <0x0 0x11000000 0x0 0x1000>;
	};

	apcldmain@1021b000 {
		compatible = "mediatek,apcldmain";
		reg = <0x0 0x1021b000 0x0 0x0>;
	};

	apcldmain_ao@10014000 {
		compatible = "mediatek,apcldmain_ao";
		reg = <0x0 0x10014000 0x0 0x400>;
	};

	apcldmamisc@1021b800 {
		compatible = "mediatek,apcldmamisc";
		interrupts = <0x0 0xa5 0x4>;
		reg = <0x0 0x1021b800 0x0 0x0>;
	};

	apcldmamisc_ao@10014800 {
		compatible = "mediatek,apcldmamisc_ao";
		reg = <0x0 0x10014800 0x0 0x400>;
	};

	apcldmaout@1021b400 {
		compatible = "mediatek,apcldmaout";
		reg = <0x0 0x1021b400 0x0 0x0>;
	};

	apcldmaout_ao@10014400 {
		compatible = "mediatek,apcldmaout_ao";
		reg = <0x0 0x10014400 0x0 0x400>;
	};

	apmixed@1000c000 {
		#clock-cells = <0x1>;
		compatible = "mediatek,apmixed", "syscon";
		linux,phandle = <0x41>;
		phandle = <0x41>;
		reg = <0x0 0x1000c000 0x0 0x1000>;
	};

	apxgpt@10008000 {
		clocks = <0x1d>;
		compatible = "mediatek,apxgpt";
		interrupts = <0x0 0xaa 0x8>;
		reg = <0x0 0x10008000 0x0 0x1000>;
	};

	atf_logger {
		compatible = "mediatek,atf_logger";
		interrupts = <0x0 0xf7 0x1>;
	};

	audio@11220000 {
		#clock-cells = <0x1>;
		compatible = "mediatek,audio", "syscon";
		linux,phandle = <0x40>;
		phandle = <0x40>;
		reg = <0x0 0x11220000 0x0 0x1000>;
	};

	audio_snd_card {
		compatible = "mediatek,audio_snd_card";
	};

	audio_sram@11221000 {
		compatible = "mediatek,audio_sram";
		reg = <0x0 0x11221000 0x0 0x9000>;
	};

	auxadc@11001000 {
		clock-names = "auxadc-main";
		clocks = <0x27 0x21>;
		compatible = "mediatek,auxadc";
		interrupts = <0x0 0x4c 0x2>;
		linux,phandle = <0x86>;
		phandle = <0x86>;
		reg = <0x0 0x11001000 0x0 0x10000>;
	};

	battery {
		ACTIVE_TABLE = <0x0>;
		CAR_TUNE_VALUE = <0x64>;
		DIFFERENCE_FULLOCV_ITH = <0xc8>;
		EMBEDDED_SEL = <0x1>;
		FG_METER_RESISTANCE = <0x4b>;
		KEEP_100_PERCENT = <0x1>;
		MULTI_BATTERY = <0x0>;
		PMIC_MIN_VOL = <0x82dc>;
		PMIC_SHUTDOWN_CURRENT = <0x14>;
		POWERON_SYSTEM_IBOOT = <0x1f4>;
		Q_MAX_SYS_VOLTAGE_BAT0 = <0xd16>;
		Q_MAX_SYS_VOLTAGE_BAT1 = <0xd16>;
		Q_MAX_SYS_VOLTAGE_BAT2 = <0xd16>;
		Q_MAX_SYS_VOLTAGE_BAT3 = <0xd16>;
		R_FG_VALUE = <0xa>;
		SHUTDOWN_1_TIME = <0x1e>;
		SHUTDOWN_GAUGE0_VOLTAGE = <0x84d0>;
		TEMPERATURE_T0 = <0x32>;
		TEMPERATURE_T1 = <0x19>;
		TEMPERATURE_T2 = <0xa>;
		TEMPERATURE_T3 = <0x0>;
		TEMPERATURE_T4 = <0xfffffff6>;
		battery0_profile_t0 = <0x0 0xaaaa 0x41a 0x1a9 0xa9f8 0x41a 0x351 0xa95a 0x42b 0x4fa 0xa8cc 0x433 0x6a3 0xa844 0x429 0x84c 0xa7bf 0x41a 0x9f4 0xa740 0x41a 0xb9d 0xa6c9 0x41a 0xd46 0xa653 0x41a 0xeef 0xa5dc 0x41a 0x1097 0xa565 0x41a 0x1240 0xa4ee 0x41a 0x13e9 0xa479 0x41a 0x1592 0xa40a 0x41b 0x173a 0xa39c 0x430 0x18e3 0xa326 0x420 0x1a8c 0xa2b5 0x41a 0x1c35 0xa247 0x41a 0x1ddd 0xa1d8 0x41a 0x1f86 0xa16a 0x41a 0x212f 0xa0fb 0x41a 0x22d8 0xa095 0x42f 0x2480 0xa02e 0x433 0x2629 0x9fc1 0x433 0x27d2 0x9f57 0x433 0x297b 0x9ef4 0x439 0x2b23 0x9e95 0x44c 0x2ccc 0x9e2f 0x44c 0x2e75 0x9dd1 0x44c 0x301e 0x9d74 0x45c 0x31c6 0x9d16 0x465 0x336f 0x9cb9 0x465 0x3518 0x9c5e 0x465 0x36c1 0x9c09 0x465 0x3869 0x9bb4 0x465 0x3a12 0x9b66 0x48b 0x3bbb 0x9b14 0x488 0x3d64 0x9ac3 0x489 0x3f0c 0x9a77 0x4a6 0x40b5 0x9a2a 0x4cd 0x425e 0x99de 0x4e2 0x4407 0x9989 0x4f7 0x45af 0x9926 0x4ea 0x4758 0x98b0 0x4b9 0x4901 0x982c 0x46f 0x4aaa 0x97b1 0x42d 0x4c52 0x9755 0x41a 0x4dfb 0x9709 0x41a 0x4fa4 0x96cc 0x41a 0x514d 0x968a 0x40a 0x52f5 0x9650 0x401 0x549e 0x961d 0x40a 0x5647 0x95ea 0x415 0x57f0 0x95b8 0x402 0x5998 0x958d 0x417 0x5b41 0x9563 0x41a 0x5cea 0x9532 0x40b 0x5e93 0x9508 0x40c 0x603b 0x94e6 0x421 0x61e4 0x94c3 0x433 0x638d 0x9499 0x433 0x6536 0x9476 0x433 0x66de 0x9454 0x433 0x6887 0x9438 0x440 0x6a30 0x941a 0x44c 0x6bd9 0x93fa 0x452 0x6d81 0x93e1 0x465 0x6f2a 0x93c7 0x465 0x70d3 0x93ae 0x479 0x727c 0x9387 0x47e 0x7424 0x9353 0x465 0x75cd 0x9310 0x43a 0x7776 0x92c8 0x41a 0x791f 0x928d 0x41b 0x7ac7 0x9263 0x431 0x7c70 0x9231 0x420 0x7e19 0x9204 0x41a 0x7fc2 0x91d9 0x41a 0x816a 0x91b2 0x422 0x8313 0x9190 0x433 0x84bc 0x916e 0x433 0x8665 0x9144 0x448 0x880d 0x910b 0x43b 0x89b6 0x90ca 0x433 0x8b5f 0x908e 0x43d 0x8d08 0x9054 0x446 0x8eb0 0x9007 0x431 0x9059 0x8fbb 0x41b 0x9202 0x8f9e 0x41a 0x93ab 0x8f92 0x42a 0x9553 0x8f84 0x43f 0x96fc 0x8f73 0x466 0x98a5 0x8f5a 0x4a6 0x9a4e 0x8f1f 0x4de 0x9bf6 0x8e42 0x489 0x9d9f 0x8c95 0x491 0x9f48 0x8b7a 0x4c3 0xa0f1 0x8b04 0x519 0xa299 0x8974 0x82e 0xa442 0x875a 0x1a5e>;
		battery0_profile_t0_num = <0x64>;
		battery0_profile_t1 = <0x0 0xaa0d 0x5dc 0x1a9 0xa969 0x5dc 0x351 0xa8dc 0x5ed 0x4fa 0xa85a 0x5f5 0x6a3 0xa7da 0x5f5 0x84c 0xa75d 0x5f5 0x9f4 0xa6e6 0x5f5 0xb9d 0xa66f 0x5f5 0xd46 0xa601 0x5f5 0xeef 0xa585 0x5e5 0x1097 0xa510 0x5dc 0x1240 0xa4a1 0x5e5 0x13e9 0xa431 0x5f0 0x1592 0xa3ba 0x5dc 0x173a 0xa34c 0x5dc 0x18e3 0xa2dd 0x5dc 0x1a8c 0xa26f 0x5dc 0x1c35 0xa201 0x5dc 0x1ddd 0xa192 0x5dc 0x1f86 0xa125 0x5e0 0x212f 0xa0bf 0x5f5 0x22d8 0xa051 0x5f5 0x2480 0x9fe8 0x5f5 0x2629 0x9f81 0x5f5 0x27d2 0x9f23 0x5ff 0x297b 0x9ece 0x61b 0x2b23 0x9e77 0x640 0x2ccc 0x9e11 0x640 0x2e75 0x9d9b 0x62c 0x301e 0x9d24 0x627 0x31c6 0x9cb7 0x634 0x336f 0x9c59 0x649 0x3518 0x9c06 0x65e 0x36c1 0x9bba 0x673 0x3869 0x9b76 0x689 0x3a12 0x9b2a 0x68b 0x3bbb 0x9ae4 0x6a9 0x3d64 0x9a9b 0x6c8 0x3f0c 0x9a4c 0x6d6 0x40b5 0x99f5 0x6d6 0x425e 0x9998 0x6d6 0x4407 0x9919 0x681 0x45af 0x98a0 0x63e 0x4758 0x9829 0x5f0 0x4901 0x97be 0x5af 0x4aaa 0x9766 0x58b 0x4c52 0x971a 0x578 0x4dfb 0x96d6 0x578 0x4fa4 0x969a 0x564 0x514d 0x965f 0x55f 0x52f5 0x9628 0x55f 0x549e 0x95f5 0x556 0x5647 0x95c4 0x54b 0x57f0 0x959a 0x55f 0x5998 0x956f 0x55f 0x5b41 0x9545 0x572 0x5cea 0x951a 0x578 0x5e93 0x94f4 0x578 0x603b 0x94d2 0x57f 0x61e4 0x94b0 0x591 0x638d 0x948e 0x591 0x6536 0x9475 0x5a6 0x66de 0x9454 0x5aa 0x6887 0x9432 0x5aa 0x6a30 0x9414 0x5b4 0x6bd9 0x93fa 0x5c3 0x6d81 0x93e1 0x5c6 0x6f2a 0x93c7 0x5db 0x70d3 0x93a6 0x5c8 0x727c 0x9384 0x5b3 0x7424 0x9362 0x5aa 0x75cd 0x933c 0x5a1 0x7776 0x9312 0x58c 0x791f 0x92e7 0x577 0x7ac7 0x92bd 0x561 0x7c70 0x929a 0x572 0x7e19 0x9272 0x578 0x7fc2 0x924c 0x583 0x816a 0x922a 0x591 0x8313 0x9206 0x595 0x84bc 0x91dc 0x5aa 0x8665 0x91a1 0x5aa 0x880d 0x915e 0x599 0x89b6 0x9125 0x5ac 0x8b5f 0x90ea 0x5cd 0x8d08 0x909f 0x5d6 0x8eb0 0x9048 0x5c5 0x9059 0x9026 0x5db 0x9202 0x9014 0x5f0 0x93ab 0x9003 0x605 0x9553 0x8ff2 0x633 0x96fc 0x8fda 0x684 0x98a5 0x8f9f 0x6e5 0x9a4e 0x8f00 0x720 0x9bf6 0x8d58 0x70b 0x9d9f 0x8ca3 0x777 0x9f48 0x8ab1 0x832 0xa0f1 0x8a7e 0xa9e 0xa299 0x88c2 0xf6e 0xa442 0x88b8 0x203a>;
		battery0_profile_t1_num = <0x64>;
		battery0_profile_t2 = <0x0 0xaad2 0xa14 0x1a9 0xaa79 0xa10 0x351 0xa9fa 0xa66 0x4fa 0xa98a 0xa8c 0x6a3 0xa906 0xa96 0x84c 0xa825 0xaab 0x9f4 0xa749 0xab9 0xb9d 0xa6ca 0xa8f 0xd46 0xa65b 0xaa0 0xeef 0xa588 0xaa5 0x1097 0xa44d 0xa99 0x1240 0xa311 0xa95 0x13e9 0xa2a3 0xaaa 0x1592 0xa234 0xabe 0x173a 0xa1c6 0xabe 0x18e3 0xa157 0xaab 0x1a8c 0xa0ef 0xab4 0x1c35 0xa085 0xabe 0x1ddd 0xa019 0xabe 0x1f86 0x9fb6 0xac5 0x212f 0x9f61 0xaef 0x22d8 0x9f0c 0xb1a 0x2480 0x9eb6 0xb45 0x2629 0x9e4f 0xb54 0x27d2 0x9dd1 0xb35 0x297b 0x9d43 0xb03 0x2b23 0x9cbd 0xaed 0x2ccc 0x9c46 0xad8 0x2e75 0x9be7 0xaeb 0x301e 0x9b97 0xb00 0x31c6 0x9b55 0xb22 0x336f 0x9b16 0xb44 0x3518 0x9ad2 0xb59 0x36c1 0x9a8e 0xb6e 0x3869 0x9a4a 0xb84 0x3a12 0x99ef 0xb60 0x3bbb 0x9992 0xb45 0x3d64 0x992b 0xb19 0x3f0c 0x98bd 0xad9 0x40b5 0x984d 0xa96 0x425e 0x97d6 0xa41 0x4407 0x9779 0xa01 0x45af 0x9729 0x9f6 0x4758 0x96dd 0x9e8 0x4901 0x9698 0x9dd 0x4aaa 0x965d 0x9dd 0x4c52 0x9622 0x9df 0x4dfb 0x95ef 0x9f5 0x4fa4 0x95bc 0x9e2 0x514d 0x9590 0x9ed 0x52f5 0x9565 0xa02 0x549e 0x953b 0xa0f 0x5647 0x9512 0xa19 0x57f0 0x94f0 0xa40 0x5998 0x94c5 0xa2b 0x5b41 0x94aa 0xa60 0x5cea 0x9484 0xa64 0x5e93 0x9463 0xa70 0x603b 0x9446 0xa8c 0x61e4 0x9426 0xa90 0x638d 0x940c 0xaa5 0x6536 0x93f3 0xaba 0x66de 0x93d9 0xacf 0x6887 0x93c0 0xae4 0x6a30 0x93aa 0xaf0 0x6bd9 0x9399 0xafd 0x6d81 0x9388 0xb27 0x6f2a 0x9377 0xb52 0x70d3 0x935e 0xb68 0x727c 0x9344 0xb7d 0x7424 0x9326 0xb9f 0x75cd 0x9304 0xbca 0x7776 0x92e0 0xbea 0x791f 0x92b6 0xbee 0x7ac7 0x9294 0xc2e 0x7c70 0x926a 0xc6d 0x7e19 0x923a 0xcbc 0x7fc2 0x9207 0xd11 0x816a 0x91ce 0xd57 0x8313 0x918b 0xd91 0x84bc 0x9150 0xe10 0x8665 0x90fb 0xe65 0x880d 0x90ad 0xedd 0x89b6 0x9071 0xf5c 0x8b5f 0x9046 0x1003 0x8d08 0x9027 0x10e4 0x8eb0 0x900c 0x11e8 0x9059 0x8fea 0x1311 0x9202 0x8fb0 0x149e 0x93ab 0x8f34 0x1621 0x9553 0x8e3c 0x1793 0x96fc 0x8c99 0x1916 0x98a5 0x8a25 0x1b20 0x9a4e 0x87cf 0x1ece 0x9bf6 0x867b 0x2171 0x9d9f 0x85d4 0x22c4 0x9f48 0x8570 0x26ac 0xa0f1 0x850c 0x28a0 0xa299 0x84d0 0x29cc 0xa442 0x84a8 0x2a94>;
		battery0_profile_t2_num = <0x64>;
		battery0_profile_t3 = <0x0 0xa8ec 0x1068 0x1a9 0xa7d9 0x1068 0x351 0xa617 0x122e 0x4fa 0xa52c 0x1420 0x6a3 0xa486 0x1536 0x84c 0xa3c3 0x156f 0x9f4 0xa358 0x1597 0xb9d 0xa309 0x15ad 0xd46 0xa2d9 0x15c2 0xeef 0xa204 0x15c7 0x1097 0xa1a5 0x15c7 0x1240 0xa0f5 0x15d0 0x13e9 0xa0af 0x15e0 0x1592 0xa055 0x15e0 0x173a 0x9fef 0x15e0 0x18e3 0x9f98 0x1618 0x1a8c 0x9f43 0x1657 0x1c35 0x9ee1 0x166b 0x1ddd 0x9e69 0x1647 0x1f86 0x9de0 0x1607 0x212f 0x9d50 0x15c8 0x22d8 0x9cc8 0x15b2 0x2480 0x9c45 0x158b 0x2629 0x9bdb 0x157c 0x27d2 0x9b7d 0x1572 0x297b 0x9b25 0x1576 0x2b23 0x9ad8 0x15ae 0x2ccc 0x9a8c 0x15ae 0x2e75 0x9a37 0x159a 0x301e 0x99dc 0x1585 0x31c6 0x997e 0x156f 0x336f 0x991d 0x1548 0x3518 0x98b8 0x150e 0x36c1 0x9852 0x14e2 0x3869 0x97ec 0x14a2 0x3a12 0x9795 0x1488 0x3bbb 0x9740 0x1473 0x3d64 0x96f4 0x1469 0x3f0c 0x96b0 0x1469 0x40b5 0x966f 0x1471 0x425e 0x963c 0x149b 0x4407 0x9601 0x1486 0x45af 0x95cc 0x1493 0x4758 0x959f 0x14a9 0x4901 0x9570 0x14be 0x4aaa 0x9540 0x14d9 0x4c52 0x9516 0x1501 0x4dfb 0x94f4 0x1517 0x4fa4 0x94ca 0x152c 0x514d 0x94a6 0x1551 0x52f5 0x9484 0x156f 0x549e 0x9462 0x1585 0x5647 0x9442 0x15a4 0x57f0 0x9429 0x15e2 0x5998 0x940f 0x160d 0x5b41 0x93f6 0x1637 0x5cea 0x93e2 0x167f 0x5e93 0x93d1 0x16be 0x603b 0x93bd 0x16f7 0x61e4 0x93a5 0x174c 0x638d 0x9394 0x17a1 0x6536 0x937b 0x180b 0x66de 0x9361 0x1864 0x6887 0x9348 0x18b9 0x6a30 0x932a 0x1918 0x6bd9 0x9308 0x198b 0x6d81 0x92e5 0x1a0a 0x6f2a 0x92ba 0x1a89 0x70d3 0x9288 0x1ae1 0x727c 0x925b 0x1b77 0x7424 0x9227 0x1c14 0x75cd 0x91eb 0x1cb2 0x7776 0x91ac 0x1d5c 0x791f 0x9160 0x1e07 0x7ac7 0x9125 0x1ec6 0x7c70 0x90e9 0x1fd0 0x7e19 0x90b4 0x20e5 0x7fc2 0x9081 0x220f 0x816a 0x904e 0x235d 0x8313 0x9019 0x24e1 0x84bc 0x8fde 0x26de 0x8665 0x8f78 0x28c6 0x880d 0x8eef 0x2af5 0x89b6 0x8e12 0x2d17 0x8b5f 0x8ccb 0x2f20 0x8d08 0x8afe 0x312a 0x8eb0 0x8aac 0x339d 0x9059 0x8a5f 0x3857 0x9202 0x8a3d 0x38a4 0x93ab 0x8a1c 0x38a4 0x9553 0x8a08 0x38a4 0x96fc 0x89c5 0x38a4 0x98a5 0x8972 0x38a4 0x9a4e 0x895f 0x38a4 0x9bf6 0x8950 0x38a4 0x9d9f 0x8933 0x38a4 0x9f48 0x891b 0x38a4 0xa0f1 0x88b8 0x38a4 0xa299 0x88cc 0x38a4 0xa442 0x88b8 0x38a4>;
		battery0_profile_t3_num = <0x64>;
		battery0_profile_t4 = <0x0 0xaa96 0x253a 0x1a9 0xa9ca 0x2536 0x351 0xa905 0x263b 0x4fa 0xa83c 0x2727 0x6a3 0xa769 0x27c9 0x84c 0xa687 0x285b 0x9f4 0xa59a 0x2930 0xb9d 0xa4b4 0x2aae 0xd46 0xa417 0x2c40 0xeef 0xa391 0x2ce2 0x1097 0xa312 0x2d1e 0x1240 0xa094 0x2d0c 0x13e9 0x9e05 0x2c9d 0x1592 0x9d64 0x2c1c 0x173a 0x9cc2 0x2b88 0x18e3 0x9c21 0x2b18 0x1a8c 0x9b91 0x2acc 0x1c35 0x9b0e 0x2a97 0x1ddd 0x9a94 0x2a74 0x1f86 0x9a26 0x2a5b 0x212f 0x99b7 0x2a31 0x22d8 0x995a 0x2a1b 0x2480 0x98fb 0x29f4 0x2629 0x98a2 0x29ad 0x27d2 0x9851 0x2977 0x297b 0x9805 0x2968 0x2b23 0x97b9 0x2968 0x2ccc 0x9775 0x2968 0x2e75 0x973a 0x2940 0x301e 0x96f8 0x28f4 0x31c6 0x96be 0x28df 0x336f 0x9687 0x28eb 0x3518 0x964e 0x28f5 0x36c1 0x961a 0x291d 0x3869 0x95df 0x291d 0x3a12 0x95b2 0x290a 0x3bbb 0x9582 0x2913 0x3d64 0x9553 0x291d 0x3f0c 0x9526 0x291d 0x40b5 0x94f4 0x2937 0x425e 0x94ca 0x29cc 0x4407 0x94a8 0x2a0c 0x45af 0x9486 0x2a4b 0x4758 0x9464 0x2aa7 0x4901 0x9442 0x2af3 0x4aaa 0x941e 0x2b10 0x4c52 0x93f4 0x2b18 0x4dfb 0x93d2 0x2b6f 0x4fa4 0x93b0 0x2bd8 0x514d 0x9388 0x2c33 0x52f5 0x935d 0x2ca0 0x549e 0x932f 0x2d06 0x5647 0x92fc 0x2d59 0x57f0 0x92c9 0x2dec 0x5998 0x9296 0x2e6c 0x5b41 0x925c 0x2ed9 0x5cea 0x9221 0x2f34 0x5e93 0x91e5 0x2faa 0x603b 0x91a7 0x3072 0x61e4 0x9164 0x3183 0x638d 0x9129 0x3217 0x6536 0x90e5 0x32eb 0x66de 0x90a1 0x33d0 0x6887 0x905d 0x34d5 0x6a30 0x9014 0x35e8 0x6bd9 0x8fbd 0x36fc 0x6d81 0x8f47 0x380d 0x6f2a 0x8e9d 0x38cc 0x70d3 0x8d4a 0x38fe 0x727c 0x8b15 0x39ac 0x7424 0x8aba 0x3ab9 0x75cd 0x8a85 0x3b6a 0x7776 0x8a3e 0x3b6a 0x791f 0x89da 0x3b6a 0x7ac7 0x8976 0x3b6a 0x7c70 0x8912 0x3b6a 0x7e19 0x88ae 0x3b6a 0x7fc2 0x884a 0x3b6a 0x816a 0x87e6 0x3b6a 0x8313 0x8782 0x3b6a 0x84bc 0x871e 0x3b6a 0x8665 0x86ba 0x3b6a 0x880d 0x8656 0x3b6a 0x89b6 0x85f2 0x3b6a 0x8b5f 0x858e 0x3b6a 0x8d08 0x8584 0x3b6a 0x8eb0 0x857a 0x3b6a 0x9059 0x8570 0x3b6a 0x9202 0x8566 0x3b6a 0x93ab 0x855c 0x3b6a 0x9553 0x8552 0x3b6a 0x96fc 0x8548 0x3b6a 0x98a5 0x853e 0x3b6a 0x9a4e 0x8534 0x3b6a 0x9bf6 0x852a 0x3b6a 0x9d9f 0x8520 0x3b6a 0x9f48 0x8516 0x3b6a 0xa0f1 0x850c 0x3b6a 0xa299 0x8502 0x3b6a 0xa442 0x8502 0x3b6a>;
		battery0_profile_t4_num = <0x64>;
		battery1_profile_t0 = <0x0 0xaa96 0x406 0x1a9 0xaa0e 0x402 0x352 0xa994 0x413 0x4fb 0xa91d 0x41a 0x6a5 0xa8a2 0x410 0x84e 0xa827 0x407 0x9f7 0xa7b8 0x41d 0xba0 0xa741 0x432 0xd49 0xa6c2 0x40b 0xef2 0xa649 0x411 0x109c 0xa5d2 0x41a 0x1245 0xa55e 0x423 0x13ee 0xa4ed 0x433 0x1597 0xa476 0x432 0x1740 0xa3ff 0x41c 0x18e9 0xa390 0x42d 0x1a92 0xa31b 0x433 0x1c3c 0xa2a9 0x433 0x1de5 0xa23a 0x43b 0x1f8e 0xa1cc 0x44c 0x2137 0xa15d 0x44c 0x22e0 0xa0ef 0x44c 0x2489 0xa07e 0x44c 0x2632 0xa015 0x45a 0x27dc 0x9faf 0x465 0x2985 0x9f46 0x45e 0x2b2e 0x9eda 0x452 0x2cd7 0x9e7c 0x47d 0x2e80 0x9e1f 0x47e 0x3029 0x9dbb 0x47e 0x31d3 0x9d5a 0x48b 0x337c 0x9cf8 0x497 0x3525 0x9c97 0x49d 0x36ce 0x9c42 0x4b0 0x3877 0x9bed 0x4b0 0x3a20 0x9ba0 0x4d7 0x3bc9 0x9b4d 0x4f2 0x3d73 0x9af8 0x4fb 0x3f1c 0x9aa3 0x503 0x40c5 0x9a4c 0x519 0x426e 0x99ee 0x52b 0x4417 0x9976 0x4eb 0x45c0 0x98e9 0x499 0x476a 0x986a 0x452 0x4913 0x9805 0x433 0x4abc 0x97b2 0x433 0x4c65 0x9767 0x430 0x4e0e 0x9723 0x41a 0x4fb7 0x96e8 0x41a 0x5160 0x96ac 0x41a 0x530a 0x9676 0x41a 0x54b3 0x9643 0x424 0x565c 0x9610 0x42d 0x5805 0x95dd 0x41c 0x59ae 0x95aa 0x431 0x5b57 0x957f 0x433 0x5d00 0x9554 0x433 0x5eaa 0x952a 0x43f 0x6053 0x9502 0x44c 0x61fc 0x94df 0x44c 0x63a5 0x94b4 0x44d 0x654e 0x9492 0x462 0x66f7 0x9470 0x477 0x68a1 0x9454 0x48d 0x6a4a 0x9436 0x497 0x6bf3 0x9414 0x497 0x6d9c 0x93f3 0x49b 0x6f45 0x93da 0x4b0 0x70ee 0x93b8 0x4b0 0x7297 0x9387 0x49e 0x7441 0x9343 0x46d 0x75ea 0x92fb 0x44c 0x7793 0x92bc 0x44c 0x793c 0x928a 0x44c 0x7ae5 0x9260 0x44c 0x7c8e 0x9235 0x44c 0x7e38 0x9204 0x43b 0x7fe1 0x91db 0x440 0x818a 0x91b9 0x44c 0x8333 0x9197 0x451 0x84dc 0x9174 0x463 0x8685 0x9141 0x44e 0x882e 0x9106 0x44c 0x89d8 0x90cb 0x44c 0x8b81 0x9094 0x458 0x8d2a 0x9058 0x45d 0x8ed3 0x900d 0x444 0x907c 0x8fca 0x41a 0x9225 0x8fb9 0x430 0x93ce 0x8faf 0x445 0x9578 0x8fa6 0x468 0x9721 0x8f95 0x493 0x98ca 0x8f71 0x4bd 0x9a73 0x8f18 0x4d6 0x9c1c 0x8e08 0x481 0x9dc5 0x8c44 0x492 0x9f6f 0x89fa 0x4c9 0xa118 0x89e7 0x523 0xa2c1 0x892c 0x76e 0xa46a 0x88e0 0x18e7>;
		battery1_profile_t0_num = <0x64>;
		battery1_profile_t1 = <0x0 0xaad2 0x564 0x1a9 0xaa7d 0x560 0x352 0xa9fb 0x55f 0x4fb 0xa8cd 0x56d 0x6a5 0xa80c 0x56e 0x84e 0xa7af 0x565 0x9f7 0xa740 0x578 0xba0 0xa6c9 0x578 0xd49 0xa652 0x578 0xef2 0xa5db 0x578 0x109c 0xa564 0x578 0x1245 0xa4f0 0x578 0x13ee 0xa47f 0x578 0x1597 0xa409 0x579 0x1740 0xa39a 0x58f 0x18e9 0xa32c 0x591 0x1a92 0xa2bd 0x5a0 0x1c3c 0xa24f 0x5aa 0x1de5 0xa1dd 0x5aa 0x1f8e 0xa169 0x5ae 0x2137 0xa103 0x5c3 0x22e0 0xa095 0x5c3 0x2489 0xa02b 0x5d5 0x2632 0x9fbf 0x5dc 0x27dc 0x9f59 0x5dc 0x2985 0x9efe 0x5ea 0x2b2e 0x9ea7 0x611 0x2cd7 0x9e41 0x626 0x2e80 0x9dd2 0x63c 0x3029 0x9d64 0x640 0x31d3 0x9cfb 0x64d 0x337c 0x9c98 0x662 0x3525 0x9c3b 0x672 0x36ce 0x9bdf 0x676 0x3877 0x9b92 0x6a1 0x3a20 0x9b3e 0x6a4 0x3bc9 0x9aef 0x6a4 0x3d73 0x9aa3 0x6bc 0x3f1c 0x9a49 0x6c5 0x40c5 0x99d3 0x68d 0x426e 0x9943 0x623 0x4417 0x98bb 0x5b9 0x45c0 0x9849 0x573 0x476a 0x97f2 0x55f 0x4913 0x97a5 0x554 0x4abc 0x975e 0x546 0x4c65 0x9721 0x543 0x4e0e 0x96dd 0x52d 0x4fb7 0x96a2 0x52d 0x5160 0x966d 0x52d 0x530a 0x963a 0x53a 0x54b3 0x960b 0x550 0x565c 0x95de 0x559 0x5805 0x95ac 0x548 0x59ae 0x9581 0x55d 0x5b57 0x9557 0x55f 0x5d00 0x952c 0x55f 0x5eaa 0x9507 0x56b 0x6053 0x94e4 0x580 0x61fc 0x94c2 0x591 0x63a5 0x94a0 0x592 0x654e 0x947e 0x5a7 0x66f7 0x945c 0x5aa 0x68a1 0x9440 0x5b9 0x6a4a 0x9427 0x5ce 0x6bf3 0x940a 0x5d4 0x6d9c 0x93e8 0x5bf 0x6f45 0x93c6 0x5aa 0x70ee 0x93ac 0x5c0 0x7297 0x9384 0x5b1 0x7441 0x935a 0x59c 0x75ea 0x932f 0x587 0x7793 0x9305 0x578 0x793c 0x92da 0x575 0x7ae5 0x92b0 0x560 0x7c8e 0x928d 0x573 0x7e38 0x926b 0x578 0x7fe1 0x9249 0x578 0x818a 0x9227 0x581 0x8333 0x9201 0x591 0x84dc 0x91ce 0x591 0x8685 0x9192 0x591 0x882e 0x9156 0x57e 0x89d8 0x9121 0x597 0x8b81 0x90e0 0x59e 0x8d2a 0x9094 0x581 0x8ed3 0x9053 0x563 0x907c 0x9042 0x579 0x9225 0x9039 0x5a3 0x93ce 0x902a 0x5ce 0x9578 0x9013 0x5f8 0x9721 0x8fed 0x62d 0x98ca 0x8f7c 0x645 0x9a73 0x8e67 0x611 0x9c1c 0x8c93 0x626 0x9dc5 0x8bac 0x68d 0x9f6f 0x8a6d 0x72a 0xa118 0x89a5 0x144e 0xa2c1 0x8908 0x203a 0xa46a 0x88b8 0x203a>;
		battery1_profile_t1_num = <0x64>;
		battery1_profile_t2 = <0x0 0xa956 0x834 0x1a9 0xa8a3 0x834 0x352 0xa80d 0x846 0x4fb 0xa787 0x84d 0x6a5 0xa72a 0x857 0x84e 0xa677 0x866 0x9f7 0xa663 0x863 0xba0 0xa59d 0x84e 0xd49 0xa52e 0x875 0xef2 0xa4b9 0x86f 0x109c 0xa442 0x866 0x1245 0xa3ce 0x878 0x13ee 0xa360 0x898 0x1597 0xa2f1 0x899 0x1740 0xa282 0x8af 0x18e9 0xa214 0x8b1 0x1a92 0xa1a5 0x8c0 0x1c3c 0xa137 0x8ca 0x1de5 0xa0c8 0x8d2 0x1f8e 0xa05b 0x8e3 0x2137 0x9ff5 0x8e3 0x22e0 0x9f98 0x8f8 0x2489 0x9f41 0x91f 0x2632 0x9eec 0x958 0x27dc 0x9e8f 0x98d 0x2985 0x9e1f 0x9a5 0x2b2e 0x9d96 0x98f 0x2cd7 0x9d05 0x97a 0x2e80 0x9c85 0x979 0x3029 0x9c20 0x989 0x31d3 0x9bd1 0x9ab 0x337c 0x9b8d 0x9c4 0x3525 0x9b43 0x9be 0x36ce 0x9aee 0x9ab 0x3877 0x9a99 0x9ab 0x3a20 0x9a44 0x9ab 0x3bc9 0x99dc 0x97c 0x3d73 0x9964 0x930 0x3f1c 0x98e8 0x8e3 0x40c5 0x9874 0x8a3 0x426e 0x980f 0x865 0x4417 0x97ba 0x850 0x45c0 0x976c 0x83b 0x476a 0x972b 0x843 0x4913 0x96eb 0x842 0x4abc 0x96aa 0x834 0x4c65 0x9670 0x837 0x4e0e 0x963d 0x84d 0x4fb7 0x960a 0x84d 0x5160 0x95d7 0x84d 0x530a 0x95a9 0x85a 0x54b3 0x957f 0x866 0x565c 0x9554 0x86c 0x5805 0x952b 0x881 0x59ae 0x9509 0x896 0x5b57 0x94df 0x898 0x5d00 0x94bb 0x8a8 0x5eaa 0x9499 0x8b1 0x6053 0x947a 0x8c2 0x61fc 0x945e 0x8e3 0x63a5 0x943d 0x8e4 0x654e 0x9423 0x8f9 0x66f7 0x9402 0x8fc 0x68a1 0x93ec 0x919 0x6a4a 0x93d2 0x923 0x6bf3 0x93b6 0x915 0x6d9c 0x93a4 0x919 0x6f45 0x938a 0x92e 0x70ee 0x9379 0x943 0x7297 0x935a 0x936 0x7441 0x9338 0x92e 0x75ea 0x9316 0x938 0x7793 0x92f4 0x947 0x793c 0x92d1 0x947 0x7ae5 0x92a6 0x947 0x7c8e 0x928c 0x970 0x7e38 0x925e 0x98a 0x7fe1 0x922b 0x9ac 0x818a 0x91f5 0x9cd 0x8333 0x91b9 0x9dd 0x84dc 0x917e 0x9e2 0x8685 0x9142 0xa22 0x882e 0x90f7 0xa4e 0x89d8 0x90ab 0xa69 0x8b81 0x907a 0xa96 0x8d2a 0x9064 0xade 0x8ed3 0x9051 0xb33 0x907c 0x9038 0xb89 0x9225 0x901e 0xc33 0x93ce 0x8fef 0xd01 0x9578 0x8f3f 0xd9d 0x9721 0x8dd8 0xe5b 0x98ca 0x8bb3 0xf90 0x9a73 0x88cc 0x1171 0x9c1c 0x87b4 0x14ae 0x9dc5 0x862a 0x23d8 0x9f6f 0x8552 0x23dc 0xa118 0x8516 0x23dc 0xa2c1 0x84ee 0x23dc 0xa46a 0x84d0 0x23dc>;
		battery1_profile_t2_num = <0x64>;
		battery1_profile_t3 = <0x0 0xaad2 0xd02 0x1a9 0xaa62 0xcfe 0x352 0xa9b7 0xdf2 0x4fb 0xa8da 0xe69 0x6a5 0xa802 0xe88 0x84e 0xa78f 0xeac 0x9f7 0xa683 0xec4 0xba0 0xa592 0xeef 0xd49 0xa418 0xef1 0xef2 0xa389 0xf01 0x109c 0xa285 0xf17 0x1245 0xa216 0xf2c 0x13ee 0xa1a8 0xf41 0x1597 0xa139 0xf55 0x1740 0xa0ca 0xf55 0x18e9 0xa05c 0xf55 0x1a92 0x9ff9 0xf64 0x1c3c 0x9fa0 0xf90 0x1de5 0x9f4f 0xfdf 0x1f8e 0x9efd 0x103a 0x2137 0x9e97 0x104f 0x22e0 0x9e0f 0x1024 0x2489 0x9d6f 0x100b 0x2632 0x9cd8 0x1004 0x27dc 0x9c54 0x1004 0x2985 0x9be3 0x100b 0x2b2e 0x9b80 0x101d 0x2cd7 0x9b34 0x101d 0x2e80 0x9af0 0x1046 0x3029 0x9a9e 0x102d 0x31d3 0x9a49 0x1010 0x337c 0x99e9 0xfde 0x3525 0x997a 0xf8f 0x36ce 0x990c 0xf51 0x3877 0x98a6 0xf26 0x3a20 0x9840 0xefc 0x3bc9 0x97e1 0xee1 0x3d73 0x978d 0xecc 0x3f1c 0x9743 0xec7 0x40c5 0x96ff 0xed8 0x426e 0x96bc 0xed8 0x4417 0x9680 0xed8 0x45c0 0x964c 0xefd 0x476a 0x9619 0xf19 0x4913 0x95e6 0xf2e 0x4abc 0x95b6 0xf4a 0x4c65 0x958b 0xf6e 0x4e0e 0x9561 0xf6e 0x4fb7 0x9536 0xf98 0x5160 0x950c 0xfb1 0x530a 0x94e7 0xfd4 0x54b3 0x94c1 0xff5 0x565c 0x9499 0x100a 0x5805 0x9477 0x1021 0x59ae 0x945e 0x104c 0x5b57 0x943d 0x1063 0x5d00 0x9421 0x1088 0x5eaa 0x9407 0x10b2 0x6053 0x93f1 0x10e5 0x61fc 0x93e0 0x1120 0x63a5 0x93cf 0x114b 0x654e 0x93be 0x1175 0x66f7 0x93ad 0x11b2 0x68a1 0x9396 0x11d5 0x6a4a 0x937d 0x11f5 0x6bf3 0x9363 0x1228 0x6d9c 0x9349 0x1268 0x6f45 0x9330 0x12a8 0x70ee 0x930e 0x12e8 0x7297 0x92e4 0x1327 0x7441 0x92c0 0x1383 0x75ea 0x9295 0x13d9 0x7793 0x9262 0x1426 0x793c 0x922e 0x1490 0x7ae5 0x91f3 0x14fa 0x7c8e 0x91b7 0x158d 0x7e38 0x917c 0x1611 0x7fe1 0x9136 0x169e 0x818a 0x90e6 0x172d 0x8333 0x909b 0x17c6 0x84dc 0x9072 0x1896 0x8685 0x9059 0x1995 0x882e 0x903f 0x1abb 0x89d8 0x901f 0x1c22 0x8b81 0x8ff9 0x1dcf 0x8d2a 0x8fa2 0x1fba 0x8ed3 0x8ecf 0x21ce 0x907c 0x8d2a 0x23ea 0x9225 0x8abd 0x27bc 0x93ce 0x8a52 0x2d83 0x9578 0x8980 0x3212 0x9721 0x8911 0x3264 0x98ca 0x8854 0x3264 0x9a73 0x87ff 0x3264 0x9c1c 0x87be 0x3264 0x9dc5 0x8372 0x3264 0x9f6f 0x82dc 0x3264 0xa118 0x82ce 0x3264 0xa2c1 0x7eae 0x3264 0xa46a 0x7e90 0x3264>;
		battery1_profile_t3_num = <0x64>;
		battery1_profile_t4 = <0x0 0xaaaa 0x1c0c 0x1a9 0xa9cd 0x1c08 0x352 0xa8f0 0x1cc8 0x4fb 0xa802 0x1d88 0x6a5 0xa718 0x1e5a 0x84e 0xa64a 0x1f66 0x9f7 0xa5a5 0x207b 0xba0 0xa525 0x20fb 0xd49 0xa4ae 0x212a 0xef2 0xa311 0x2165 0x109c 0xa1e5 0x21be 0x1245 0x9f93 0x2205 0x13ee 0x9f32 0x2229 0x1597 0x9ec1 0x2274 0x1740 0x9e30 0x221f 0x18e9 0x9d91 0x21ef 0x1a92 0x9ce9 0x21d4 0x1c3c 0x9c4d 0x21ca 0x1de5 0x9bc2 0x21c2 0x1f8e 0x9b44 0x21a9 0x2137 0x9acd 0x217f 0x22e0 0x9a67 0x2194 0x2489 0x9a08 0x2175 0x2632 0x99ab 0x2166 0x27dc 0x994d 0x2152 0x2985 0x98f2 0x212e 0x2b2e 0x989d 0x211e 0x2cd7 0x9848 0x2133 0x2e80 0x97fa 0x20f6 0x3029 0x97ad 0x211c 0x31d3 0x9760 0x2127 0x337c 0x9718 0x2137 0x3525 0x96d6 0x2171 0x36ce 0x969b 0x21a0 0x3877 0x9668 0x21f5 0x3a20 0x962d 0x21e8 0x3bc9 0x95f8 0x2212 0x3d73 0x95c5 0x223a 0x3f1c 0x9592 0x223f 0x40c5 0x9561 0x2240 0x426e 0x9536 0x2295 0x4417 0x950c 0x22ea 0x45c0 0x94e1 0x22f6 0x476a 0x94bd 0x2330 0x4913 0x949b 0x239b 0x4abc 0x947b 0x2406 0x4c65 0x9462 0x244d 0x4e0e 0x9448 0x24b6 0x4fb7 0x942f 0x24f7 0x5160 0x941c 0x2547 0x530a 0x9406 0x25aa 0x54b3 0x93f0 0x2627 0x565c 0x93dd 0x26a5 0x5805 0x93c3 0x26e0 0x59ae 0x93aa 0x26f5 0x5b57 0x9390 0x276d 0x5d00 0x9371 0x280c 0x5eaa 0x9353 0x28b6 0x6053 0x9333 0x2936 0x61fc 0x930a 0x299c 0x63a5 0x92e8 0x2a84 0x654e 0x92b5 0x2b43 0x66f7 0x9282 0x2c15 0x68a1 0x924f 0x2cbd 0x6a4a 0x9217 0x2d45 0x6bf3 0x91dc 0x2de8 0x6d9c 0x919f 0x2edf 0x6f45 0x915b 0x3009 0x70ee 0x9117 0x3132 0x7297 0x90da 0x326d 0x7441 0x90a9 0x339a 0x75ea 0x9082 0x351b 0x7793 0x9060 0x36e5 0x793c 0x903c 0x3856 0x7ae5 0x9008 0x3a08 0x7c8e 0x8fa4 0x3bbb 0x7e38 0x8edb 0x3d1c 0x7fe1 0x8d6b 0x3e12 0x818a 0x8b3a 0x3f5d 0x8333 0x8afa 0x40e1 0x84dc 0x8a9e 0x40e2 0x8685 0x8a2a 0x40e2 0x882e 0x89c6 0x40e2 0x89d8 0x8962 0x40e2 0x8b81 0x88fe 0x40e2 0x8d2a 0x889a 0x40e2 0x8ed3 0x8836 0x40e2 0x907c 0x87d2 0x40e2 0x9225 0x876e 0x40e2 0x93ce 0x870a 0x40e2 0x9578 0x86a6 0x40e2 0x9721 0x8642 0x40e2 0x98ca 0x85de 0x40e2 0x9a73 0x857a 0x40e2 0x9c1c 0x8516 0x40e2 0x9dc5 0x8516 0x40e2 0x9f6f 0x8516 0x40e2 0xa118 0x8516 0x40e2 0xa2c1 0x8516 0x40e2 0xa46a 0x8516 0x40e2>;
		battery1_profile_t4_num = <0x64>;
		compatible = "mediatek,bat_gm30";
		g_FG_PSEUDO100_T0 = <0x64>;
		g_FG_PSEUDO100_T1 = <0x5f>;
		g_FG_PSEUDO100_T2 = <0x5c>;
		g_FG_PSEUDO100_T3 = <0x5c>;
		g_FG_PSEUDO100_T4 = <0x5a>;
		linux,phandle = <0x83>;
		phandle = <0x83>;
	};

	bpi_bsi_slv0@1021e000 {
		compatible = "mediatek,bpi_bsi_slv0";
		reg = <0x0 0x1021e000 0x0 0x1000>;
	};

	bpi_bsi_slv1@1021f000 {
		compatible = "mediatek,bpi_bsi_slv1";
		reg = <0x0 0x1021f000 0x0 0x6000>;
	};

	bpi_bsi_slv2@10225000 {
		compatible = "mediatek,bpi_bsi_slv2";
		reg = <0x0 0x10225000 0x0 0x1000>;
	};

	btcvsd@10001000 {
		compatible = "mediatek,audio_bt_cvsd";
		interrupts = <0x0 0x10a 0x8>;
		offset = <0xf00 0x800 0x140 0x144 0x148>;
		reg = <0x0 0x10001000 0x0 0x1000 0x0 0x18050000 0x0 0x1000 0x0 0x18080000 0x0 0x10000>;
	};

	btif@1100c000 {
		clock-names = "btifc", "apdmac";
		clocks = <0x27 0x1a 0x27 0x26>;
		compatible = "mediatek,btif";
		interrupts = <0x0 0x70 0x8 0x0 0x84 0x8 0x0 0x85 0x8>;
		reg = <0x0 0x1100c000 0x0 0x1000 0x0 0x11000880 0x0 0x80 0x0 0x11000900 0x0 0x80>;
	};

	bus_dbg@10208000 {
		compatible = "mediatek,bus_dbg-v2";
		interrupts = <0x0 0x8d 0x8>;
		mediatek,bus_dbg_con_offset = <0x2fc>;
		reg = <0x0 0x10208000 0x0 0x1000 0x0 0x10001000 0x0 0x1000>;
	};

	cam1@1a003000 {
		compatible = "mediatek,cam1";
		interrupts = <0x0 0xeb 0x8>;
		reg = <0x0 0x1a003000 0x0 0x1000>;
	};

	cam2@1a004000 {
		compatible = "mediatek,cam2";
		interrupts = <0x0 0xec 0x8>;
		reg = <0x0 0x1a004000 0x0 0x1000>;
	};

	cam3@1a005000 {
		compatible = "mediatek,cam3";
		interrupts = <0x0 0xed 0x8>;
		reg = <0x0 0x1a005000 0x0 0x1000>;
	};

	cam_clear@1a01b000 {
		compatible = "mediatek,cam_clear";
		reg = <0x0 0x1a01b000 0x0 0x1000>;
	};

	cam_inner@1a013000 {
		compatible = "mediatek,cam_inner";
		reg = <0x0 0x1a013000 0x0 0x1000>;
	};

	cam_set@1a00b000 {
		compatible = "mediatek,cam_set";
		reg = <0x0 0x1a00b000 0x0 0x1000>;
	};

	cama_clear@1a01c000 {
		compatible = "mediatek,cama_clear";
		reg = <0x0 0x1a01c000 0x0 0x1000>;
	};

	cama_ext@1a024000 {
		compatible = "mediatek,cama_ext";
		reg = <0x0 0x1a024000 0x0 0x1000>;
	};

	cama_inner@1a014000 {
		compatible = "mediatek,cama_inner";
		reg = <0x0 0x1a014000 0x0 0x1000>;
	};

	cama_set@1a00c000 {
		compatible = "mediatek,cama_set";
		reg = <0x0 0x1a00c000 0x0 0x1000>;
	};

	camb_clear@1a01d000 {
		compatible = "mediatek,camb_clear";
		reg = <0x0 0x1a01d000 0x0 0x1000>;
	};

	camb_ext@1a025000 {
		compatible = "mediatek,camb_ext";
		reg = <0x0 0x1a025000 0x0 0x1000>;
	};

	camb_inner@1a015000 {
		compatible = "mediatek,camb_inner";
		reg = <0x0 0x1a015000 0x0 0x1000>;
	};

	camb_set@1a00d000 {
		compatible = "mediatek,camb_set";
		reg = <0x0 0x1a00d000 0x0 0x1000>;
	};

	camsv1@1a050000 {
		compatible = "mediatek,camsv1";
		interrupts = <0x0 0xf3 0x8>;
		reg = <0x0 0x1a050000 0x0 0x1000>;
	};

	camsv2@1a051000 {
		compatible = "mediatek,camsv2";
		interrupts = <0x0 0xf4 0x8>;
		reg = <0x0 0x1a051000 0x0 0x1000>;
	};

	camsv3@1a052000 {
		compatible = "mediatek,camsv3";
		interrupts = <0x0 0xf1 0x8>;
		reg = <0x0 0x1a052000 0x0 0x1000>;
	};

	camsv4@1a053000 {
		compatible = "mediatek,camsv4";
		interrupts = <0x0 0xf2 0x8>;
		reg = <0x0 0x1a053000 0x0 0x1000>;
	};

	camsys@1a000000 {
		#clock-cells = <0x1>;
		compatible = "mediatek,camsys", "syscon";
		linux,phandle = <0x43>;
		phandle = <0x43>;
		reg = <0x0 0x1a000000 0x0 0x1000>;
	};

	ccu@1a0b0000 {
		clock-names = "CCU_CLK_CAM_CCU";
		clocks = <0x43 0x8>;
		compatible = "mediatek,ccu";
		interrupts = <0x0 0xf6 0x8>;
		reg = <0x0 0x1a0b1000 0x0 0x1000>;
	};

	charger {
		ac_charger_current = <0x1f47d0>;
		ac_charger_input_current = <0x1e8480>;
		algorithm_name = "SwitchCharging";
		apple_1_0a_charger_current = <0x1e8480>;
		apple_2_1a_charger_current = <0x1e8480>;
		battery_cv = <0x42ae50>;
		bif_cv_under_threshold2 = <0x43e6d0>;
		bif_threshold1 = <0x40d990>;
		bif_threshold2 = <0x419ce0>;
		cable_imp_threshold = <0x2bb>;
		charging_host_charger_current = <0x16e360>;
		chg1_ta_ac_charger_current = <0x16e360>;
		chg2_ta_ac_charger_current = <0x16e360>;
		compatible = "mediatek,charger";
		enable_min_charge_temp;
		enable_sw_jeita;
		enable_sw_safety_timer;
		jeita_temp_above_t7_cv = <0x42a680>;
		jeita_temp_below_t0_cv = <0x42a680>;
		jeita_temp_t0_to_t1_cc = <0x57e40>;
		jeita_temp_t0_to_t1_cv = <0x42a680>;
		jeita_temp_t1_to_t2_cc = <0x927c0>;
		jeita_temp_t1_to_t2_cv = <0x42a680>;
		jeita_temp_t2_to_t3_cc = <0x124f80>;
		jeita_temp_t2_to_t3_cv = <0x42a680>;
		jeita_temp_t3_to_t4_cc = <0x1b7740>;
		jeita_temp_t3_to_t4_cv = <0x42a680>;
		jeita_temp_t4_to_t5_cc = <0x1f20c0>;
		jeita_temp_t4_to_t5_cv = <0x42a680>;
		jeita_temp_t5_to_t6_cc = <0x124f80>;
		jeita_temp_t5_to_t6_cv = <0x42a680>;
		jeita_temp_t6_to_t7_cv = <0x42a680>;
		linux,phandle = <0xad>;
		max_charge_temp = <0x35>;
		max_charge_temp_minus_x_degree = <0x33>;
		max_charger_voltage = <0x588040>;
		min_charge_temp = <0x0>;
		min_charge_temp_plus_x_degree = <0x7>;
		min_charger_voltage = <0x4630c0>;
		non_std_ac_charger_current = <0x1e8480>;
		pe20_ichg_level_threshold = <0xf4240>;
		pe40_dual_charger_chg1_current = <0x1e8480>;
		pe40_dual_charger_chg2_current = <0x1e8480>;
		pe40_dual_charger_input_current = <0x2dc6c0>;
		pe40_r_cable_1a_lower = <0x229>;
		pe40_r_cable_2a_lower = <0x19f>;
		pe40_r_cable_3a_lower = <0x113>;
		pe40_single_charger_current = <0x2dc6c0>;
		pe40_single_charger_input_current = <0x2dc6c0>;
		pe40_stop_battery_soc = <0x50>;
		pe_ichg_level_threshold = <0xf4240>;
		phandle = <0xad>;
		power_path_support;
		ta_12v_support;
		ta_9v_support;
		ta_ac_12v_input_current = <0x30d400>;
		ta_ac_7v_input_current = <0x30d400>;
		ta_ac_9v_input_current = <0x30d400>;
		ta_ac_charger_current = <0x2dc6c0>;
		ta_start_battery_soc = <0x0>;
		ta_stop_battery_soc = <0x55>;
		temp_neg_10_thres = <0x0>;
		temp_t0_thres = <0x0>;
		temp_t0_thres_plus_x_degree = <0x2>;
		temp_t1_thres = <0x5>;
		temp_t1_thres_plus_x_degree = <0x7>;
		temp_t2_thres = <0xc>;
		temp_t2_thres_plus_x_degree = <0xa>;
		temp_t3_thres = <0x10>;
		temp_t3_thres_minus_x_degree = <0x12>;
		temp_t4_thres = <0x2c>;
		temp_t4_thres_minus_x_degree = <0x2a>;
		temp_t5_thres = <0x35>;
		temp_t5_thres_minus_x_degree = <0x33>;
		usb_charger_current = <0x7a120>;
		usb_charger_current_configured = <0x7a120>;
		usb_charger_current_suspend = <0x0>;
		usb_charger_current_unconfigured = <0x11170>;
		vbat_cable_imp_threshold = <0x3b8260>;
	};

	chipid@08000000 {
		compatible = "mediatek,chipid";
		reg = <0x0 0x8000000 0x0 0x4 0x0 0x8000004 0x0 0x4 0x0 0x8000008 0x0 0x4 0x0 0x800000c 0x0 0x4>;
	};

	chosen {
		bootargs = "console=tty0 console=ttyS0,921600n1 vmalloc=496M slub_max_order=0 slub_debug=OFZPU page_owner=on androidboot.hardware=mt6765 maxcpus=8 firmware_class.path=/vendor/firmware loop.max_part=7";
		kaslr-seed = <0x0 0x0>;
		linux,phandle = <0x55>;
		phandle = <0x55>;
	};

	chr_stat {
		linux,phandle = <0xb9>;
		phandle = <0xb9>;
	};

	clocks {

		clk26m {
			#clock-cells = <0x0>;
			clock-frequency = <0x18cba80>;
			compatible = "fixed-clock";
			linux,phandle = <0x1f>;
			phandle = <0x1f>;
		};

		clk32k {
			#clock-cells = <0x0>;
			clock-frequency = <0x7d00>;
			compatible = "fixed-clock";
			linux,phandle = <0x1d>;
			phandle = <0x1d>;
		};
	};

	consys@18002000 {
		#address-cells = <0x2>;
		#size-cells = <0x2>;
		clock-names = "conn";
		clocks = <0x28 0x1>;
		compatible = "mediatek,mt6765-consys";
		interrupts = <0x0 0x10b 0x8 0x0 0x10d 0x8 0x0 0x10e 0x1>;
		linux,phandle = <0x1b>;
		phandle = <0x1b>;
		reg = <0x0 0x18002000 0x0 0x1000 0x0 0x10007000 0x0 0x100 0x0 0x10001000 0x0 0x1000 0x0 0x10006000 0x0 0x1000 0x0 0x18007000 0x0 0x1000 0x0 0x180b1000 0x0 0x1000 0x0 0x180a3000 0x0 0x1000 0x0 0x180a5000 0x0 0x800 0x0 0x180c1000 0x0 0x1000 0x0 0x18004000 0x0 0x1000>;
	};

	cpu_dbgapb@0d410000 {
		compatible = "mediatek,hw_dbg";
		linux,phandle = <0x57>;
		num = <0x8>;
		phandle = <0x57>;
		reg = <0x0 0xd410000 0x0 0x1000 0x0 0xd510000 0x0 0x1000 0x0 0xd610000 0x0 0x1000 0x0 0xd710000 0x0 0x1000 0x0 0xd810000 0x0 0x1000 0x0 0xd910000 0x0 0x1000 0x0 0xda10000 0x0 0x1000 0x0 0xdb10000 0x0 0x1000>;
	};

	cpus {
		#address-cells = <0x1>;
		#size-cells = <0x0>;

		cpu-map {

			cluster0 {

				core0 {
					cpu = <0x9>;
				};

				core1 {
					cpu = <0xa>;
				};

				core2 {
					cpu = <0xb>;
				};

				core3 {
					cpu = <0xc>;
				};
			};

			cluster1 {

				core0 {
					cpu = <0xd>;
				};

				core1 {
					cpu = <0xe>;
				};

				core2 {
					cpu = <0xf>;
				};

				core3 {
					cpu = <0x10>;
				};
			};
		};

		cpu@000 {
			clock-frequency = <0x89267940>;
			compatible = "arm,cortex-a53";
			cpu-idle-states = <0x2 0x3 0x4 0x5 0x6 0x7 0x8>;
			device_type = "cpu";
			enable-method = "psci";
			linux,phandle = <0x9>;
			phandle = <0x9>;
			reg = <0x0>;
		};

		cpu@001 {
			clock-frequency = <0x89267940>;
			compatible = "arm,cortex-a53";
			cpu-idle-states = <0x2 0x3 0x4 0x5 0x6 0x7 0x8>;
			device_type = "cpu";
			enable-method = "psci";
			linux,phandle = <0xa>;
			phandle = <0xa>;
			reg = <0x1>;
		};

		cpu@002 {
			clock-frequency = <0x89267940>;
			compatible = "arm,cortex-a53";
			cpu-idle-states = <0x2 0x3 0x4 0x5 0x6 0x7 0x8>;
			device_type = "cpu";
			enable-method = "psci";
			linux,phandle = <0xb>;
			phandle = <0xb>;
			reg = <0x2>;
		};

		cpu@003 {
			clock-frequency = <0x89267940>;
			compatible = "arm,cortex-a53";
			cpu-idle-states = <0x2 0x3 0x4 0x5 0x6 0x7 0x8>;
			device_type = "cpu";
			enable-method = "psci";
			linux,phandle = <0xc>;
			phandle = <0xc>;
			reg = <0x3>;
		};

		cpu@100 {
			clock-frequency = <0x6b49d200>;
			compatible = "arm,cortex-a53";
			cpu-idle-states = <0x2 0x3 0x4 0x5 0x6 0x7 0x8>;
			device_type = "cpu";
			enable-method = "psci";
			linux,phandle = <0xd>;
			phandle = <0xd>;
			reg = <0x100>;
		};

		cpu@101 {
			clock-frequency = <0x6b49d200>;
			compatible = "arm,cortex-a53";
			cpu-idle-states = <0x2 0x3 0x4 0x5 0x6 0x7 0x8>;
			device_type = "cpu";
			enable-method = "psci";
			linux,phandle = <0xe>;
			phandle = <0xe>;
			reg = <0x101>;
		};

		cpu@102 {
			clock-frequency = <0x6b49d200>;
			compatible = "arm,cortex-a53";
			cpu-idle-states = <0x2 0x3 0x4 0x5 0x6 0x7 0x8>;
			device_type = "cpu";
			enable-method = "psci";
			linux,phandle = <0xf>;
			phandle = <0xf>;
			reg = <0x102>;
		};

		cpu@103 {
			clock-frequency = <0x6b49d200>;
			compatible = "arm,cortex-a53";
			cpu-idle-states = <0x2 0x3 0x4 0x5 0x6 0x7 0x8>;
			device_type = "cpu";
			enable-method = "psci";
			linux,phandle = <0x10>;
			phandle = <0x10>;
			reg = <0x103>;
		};

		idle-states {
			entry-method = "arm,psci";

			dpidle {
				arm,psci-suspend-param = <0x1010004>;
				compatible = "arm,idle-state";
				entry-latency-us = <0x320>;
				exit-latency-us = <0x3e8>;
				linux,phandle = <0x7>;
				min-residency-us = <0x7d0>;
				phandle = <0x7>;
			};

			mcdi-cluster {
				arm,psci-suspend-param = <0x1010001>;
				compatible = "arm,idle-state";
				entry-latency-us = <0x258>;
				exit-latency-us = <0x258>;
				linux,phandle = <0x4>;
				min-residency-us = <0x4b0>;
				phandle = <0x4>;
			};

			mcdi-cpu {
				arm,psci-suspend-param = <0x10001>;
				compatible = "arm,idle-state";
				entry-latency-us = <0x258>;
				exit-latency-us = <0x258>;
				linux,phandle = <0x3>;
				min-residency-us = <0x4b0>;
				phandle = <0x3>;
			};

			sodi {
				arm,psci-suspend-param = <0x1010002>;
				compatible = "arm,idle-state";
				entry-latency-us = <0x320>;
				exit-latency-us = <0x3e8>;
				linux,phandle = <0x5>;
				min-residency-us = <0x7d0>;
				phandle = <0x5>;
			};

			sodi3 {
				arm,psci-suspend-param = <0x1010003>;
				compatible = "arm,idle-state";
				entry-latency-us = <0x320>;
				exit-latency-us = <0x3e8>;
				linux,phandle = <0x6>;
				min-residency-us = <0x7d0>;
				phandle = <0x6>;
			};

			standby {
				arm,psci-suspend-param = <0x1>;
				compatible = "arm,idle-state";
				entry-latency-us = <0x258>;
				exit-latency-us = <0x258>;
				linux,phandle = <0x2>;
				min-residency-us = <0x4b0>;
				phandle = <0x2>;
			};

			suspend {
				arm,psci-suspend-param = <0x1010005>;
				compatible = "arm,idle-state";
				entry-latency-us = <0x320>;
				exit-latency-us = <0x3e8>;
				linux,phandle = <0x8>;
				min-residency-us = <0x7d0>;
				phandle = <0x8>;
			};
		};
	};

	cq_dma@10212000 {
		clock-names = "cqdma";
		clocks = <0x27 0x43>;
		compatible = "mediatek,mt-cqdma-v1";
		interrupts = <0x0 0x71 0x8 0x0 0x72 0x8>;
		keep_clock_ao = "yes";
		nr_channel = <0x2>;
		reg = <0x0 0x10212000 0x0 0x80 0x0 0x10212080 0x0 0x80>;
	};

	dbg_apmcu_mp0@0d400000 {
		compatible = "mediatek,dbg_apmcu_mp0";
		reg = <0x0 0xd400000 0x0 0x1000>;
	};

	dbg_apmcu_mp0@0d410000 {
		compatible = "mediatek,dbg_apmcu_mp0";
		reg = <0x0 0xd410000 0x0 0x1000>;
	};

	dbg_apmcu_mp0@0d420000 {
		compatible = "mediatek,dbg_apmcu_mp0";
		reg = <0x0 0xd420000 0x0 0x1000>;
	};

	dbg_apmcu_mp0@0d430000 {
		compatible = "mediatek,dbg_apmcu_mp0";
		reg = <0x0 0xd430000 0x0 0x1000>;
	};

	dbg_apmcu_mp0@0d440000 {
		compatible = "mediatek,dbg_apmcu_mp0";
		reg = <0x0 0xd440000 0x0 0x1000>;
	};

	dbg_apmcu_mp0@0d510000 {
		compatible = "mediatek,dbg_apmcu_mp0";
		reg = <0x0 0xd510000 0x0 0x1000>;
	};

	dbg_apmcu_mp0@0d520000 {
		compatible = "mediatek,dbg_apmcu_mp0";
		reg = <0x0 0xd520000 0x0 0x1000>;
	};

	dbg_apmcu_mp0@0d530000 {
		compatible = "mediatek,dbg_apmcu_mp0";
		reg = <0x0 0xd530000 0x0 0x1000>;
	};

	dbg_apmcu_mp0@0d540000 {
		compatible = "mediatek,dbg_apmcu_mp0";
		reg = <0x0 0xd540000 0x0 0x1000>;
	};

	dbg_apmcu_mp0@0d610000 {
		compatible = "mediatek,dbg_apmcu_mp0";
		reg = <0x0 0xd610000 0x0 0x1000>;
	};

	dbg_apmcu_mp0@0d620000 {
		compatible = "mediatek,dbg_apmcu_mp0";
		reg = <0x0 0xd620000 0x0 0x1000>;
	};

	dbg_apmcu_mp0@0d630000 {
		compatible = "mediatek,dbg_apmcu_mp0";
		reg = <0x0 0xd630000 0x0 0x1000>;
	};

	dbg_apmcu_mp0@0d640000 {
		compatible = "mediatek,dbg_apmcu_mp0";
		reg = <0x0 0xd640000 0x0 0x1000>;
	};

	dbg_apmcu_mp0@0d710000 {
		compatible = "mediatek,dbg_apmcu_mp0";
		reg = <0x0 0xd710000 0x0 0x1000>;
	};

	dbg_apmcu_mp0@0d720000 {
		compatible = "mediatek,dbg_apmcu_mp0";
		reg = <0x0 0xd720000 0x0 0x1000>;
	};

	dbg_apmcu_mp0@0d730000 {
		compatible = "mediatek,dbg_apmcu_mp0";
		reg = <0x0 0xd730000 0x0 0x1000>;
	};

	dbg_apmcu_mp0@0d740000 {
		compatible = "mediatek,dbg_apmcu_mp0";
		reg = <0x0 0xd740000 0x0 0x1000>;
	};

	dbg_apmcu_mp1@0d800000 {
		compatible = "mediatek,dbg_apmcu_mp1";
		reg = <0x0 0xd800000 0x0 0x1000>;
	};

	dbg_apmcu_mp1@0d810000 {
		compatible = "mediatek,dbg_apmcu_mp1";
		reg = <0x0 0xd810000 0x0 0x1000>;
	};

	dbg_apmcu_mp1@0d820000 {
		compatible = "mediatek,dbg_apmcu_mp1";
		reg = <0x0 0xd820000 0x0 0x1000>;
	};

	dbg_apmcu_mp1@0d830000 {
		compatible = "mediatek,dbg_apmcu_mp1";
		reg = <0x0 0xd830000 0x0 0x1000>;
	};

	dbg_apmcu_mp1@0d840000 {
		compatible = "mediatek,dbg_apmcu_mp1";
		reg = <0x0 0xd840000 0x0 0x1000>;
	};

	dbg_apmcu_mp1@0d910000 {
		compatible = "mediatek,dbg_apmcu_mp1";
		reg = <0x0 0xd910000 0x0 0x1000>;
	};

	dbg_apmcu_mp1@0d920000 {
		compatible = "mediatek,dbg_apmcu_mp1";
		reg = <0x0 0xd920000 0x0 0x1000>;
	};

	dbg_apmcu_mp1@0d930000 {
		compatible = "mediatek,dbg_apmcu_mp1";
		reg = <0x0 0xd930000 0x0 0x1000>;
	};

	dbg_apmcu_mp1@0d940000 {
		compatible = "mediatek,dbg_apmcu_mp1";
		reg = <0x0 0xd940000 0x0 0x1000>;
	};

	dbg_apmcu_mp1@0da10000 {
		compatible = "mediatek,dbg_apmcu_mp1";
		reg = <0x0 0xda10000 0x0 0x1000>;
	};

	dbg_apmcu_mp1@0da20000 {
		compatible = "mediatek,dbg_apmcu_mp1";
		reg = <0x0 0xda20000 0x0 0x1000>;
	};

	dbg_apmcu_mp1@0da30000 {
		compatible = "mediatek,dbg_apmcu_mp1";
		reg = <0x0 0xda30000 0x0 0x1000>;
	};

	dbg_apmcu_mp1@0da40000 {
		compatible = "mediatek,dbg_apmcu_mp1";
		reg = <0x0 0xda40000 0x0 0x1000>;
	};

	dbg_apmcu_mp1@0db10000 {
		compatible = "mediatek,dbg_apmcu_mp1";
		reg = <0x0 0xdb10000 0x0 0x1000>;
	};

	dbg_apmcu_mp1@0db20000 {
		compatible = "mediatek,dbg_apmcu_mp1";
		reg = <0x0 0xdb20000 0x0 0x1000>;
	};

	dbg_apmcu_mp1@0db30000 {
		compatible = "mediatek,dbg_apmcu_mp1";
		reg = <0x0 0xdb30000 0x0 0x1000>;
	};

	dbg_apmcu_mp1@0db40000 {
		compatible = "mediatek,dbg_apmcu_mp1";
		reg = <0x0 0xdb40000 0x0 0x1000>;
	};

	dbg_cti@0d020000 {
		compatible = "mediatek,dbg_cti";
		reg = <0x0 0xd020000 0x0 0x10000>;
	};

	dbg_dem@0d0a0000 {
		compatible = "mediatek,dbg_dem";
		interrupts = <0x0 0x8c 0x8>;
		reg = <0x0 0xd0a0000 0x0 0x10000>;
	};

	dbg_etr@0d030000 {
		compatible = "mediatek,dbg_etr";
		reg = <0x0 0xd030000 0x0 0x10000>;
	};

	dbg_funnel@0d040000 {
		compatible = "mediatek,dbg_funnel";
		reg = <0x0 0xd040000 0x0 0x10000>;
	};

	dbg_mdsys1@0d0c0000 {
		compatible = "mediatek,dbg_mdsys1";
		reg = <0x0 0xd0c0000 0x0 0x40000>;
	};

	ddrphy@10015000 {
		compatible = "mediatek,ddrphy";
		reg = <0x0 0x10015000 0x0 0x1000>;
	};

	ddrphy@1001e000 {
		compatible = "mediatek,ddrphy";
		reg = <0x0 0x1001e000 0x0 0x1000>;
	};

	devapc@10207000 {
		clock-names = "devapc-infra-clock";
		clocks = <0x27 0x28>;
		compatible = "mediatek,devapc";
		interrupts = <0x0 0x8e 0x8>;
		reg = <0x0 0x10207000 0x0 0x1000>;
	};

	dfd@10200b00 {
		compatible = "mediatek,dfd";
		mediatek,chain_length = <0xc350>;
		mediatek,enabled = <0x1>;
		mediatek,rg_dfd_timeout = <0xa0>;
		reg = <0x0 0x10200b00 0x0 0x10000>;
	};

	dip1@15022000 {
		compatible = "mediatek,dip1";
		interrupts = <0x0 0xff 0x8>;
		reg = <0x0 0x15022000 0x0 0x3000>;
	};

	disp_aal0@14011000 {
		compatible = "mediatek,disp_aal0";
		interrupts = <0x0 0xde 0x8>;
		reg = <0x0 0x14011000 0x0 0x1000>;
	};

	disp_ccorr0@14010000 {
		compatible = "mediatek,disp_ccorr0";
		interrupts = <0x0 0xdd 0x8>;
		reg = <0x0 0x14010000 0x0 0x1000>;
	};

	disp_color0@1400f000 {
		clock-names = "MDP_COLOR";
		clocks = <0x29 0xc>;
		compatible = "mediatek,disp_color0";
		interrupts = <0x0 0xdc 0x8>;
		linux,phandle = <0x30>;
		phandle = <0x30>;
		reg = <0x0 0x1400f000 0x0 0x1000>;
	};

	disp_dither0@14013000 {
		compatible = "mediatek,disp_dither0";
		interrupts = <0x0 0xe0 0x8>;
		reg = <0x0 0x14013000 0x0 0x1000>;
	};

	disp_gamma0@14012000 {
		compatible = "mediatek,disp_gamma0";
		interrupts = <0x0 0xdf 0x8>;
		reg = <0x0 0x14012000 0x0 0x1000>;
	};

	disp_mutex0@14001000 {
		compatible = "mediatek,disp_mutex0";
		interrupts = <0x0 0xd2 0x8>;
		linux,phandle = <0x32>;
		phandle = <0x32>;
		reg = <0x0 0x14001000 0x0 0x1000>;
	};

	disp_ovl0@1400b000 {
		compatible = "mediatek,disp_ovl0";
		interrupts = <0x0 0xd9 0x8>;
		reg = <0x0 0x1400b000 0x0 0x1000>;
	};

	disp_ovl0_2l@1400c000 {
		compatible = "mediatek,disp_ovl0_2l";
		interrupts = <0x0 0xe5 0x8>;
		reg = <0x0 0x1400c000 0x0 0x1000>;
	};

	disp_pwm@1100e000 {
		compatible = "mediatek,disp_pwm";
		reg = <0x0 0x1100e000 0x0 0x1000>;
	};

	disp_rdma0@1400d000 {
		compatible = "mediatek,disp_rdma0";
		interrupts = <0x0 0xda 0x8>;
		reg = <0x0 0x1400d000 0x0 0x1000>;
	};

	disp_rsz0@14015000 {
		compatible = "mediatek,disp_rsz0";
		interrupts = <0x0 0x114 0x8>;
		reg = <0x0 0x14015000 0x0 0x1000>;
	};

	disp_wdma0@1400e000 {
		compatible = "mediatek,disp_wdma0";
		interrupts = <0x0 0xdb 0x8>;
		reg = <0x0 0x1400e000 0x0 0x1000>;
	};

	dispsys {
		clock-names = "MMSYS_MTCMOS", "MMSYS_SMI_COMMON", "MMSYS_SMI_LARB0", "MMSYS_GALS_COMM0", "MMSYS_GALS_COMM1", "MMSYS_DISP_OVL0", "MMSYS_DISP_OVL0_2L", "MMSYS_DISP_RDMA0", "MMSYS_DISP_WDMA0", "MMSYS_DISP_COLOR0", "MMSYS_DISP_CCORR0", "MMSYS_DISP_AAL0", "MMSYS_DISP_GAMMA0", "MMSYS_DISP_DITHER0", "MMSYS_DSI0_MM_CK", "MMSYS_DSI0_IF_CK", "MMSYS_26M", "MMSYS_DISP_RSZ0", "APMIXED_MIPI_26M", "TOP_MUX_DISP_PWM", "DISP_PWM", "TOP_26M", "TOP_UNIVPLL2_D4", "TOP_ULPOSC1_D2", "TOP_ULPOSC1_D8";
		clocks = <0x28 0x3 0x29 0x13 0x29 0x14 0x29 0x15 0x29 0x16 0x29 0x7 0x29 0x8 0x29 0xa 0x29 0xb 0x29 0xc 0x29 0xd 0x29 0xe 0x29 0xf 0x29 0x10 0x29 0x11 0x29 0x1c 0x29 0x1d 0x29 0x9 0x41 0x15 0x1e 0x73 0x27 0x31 0x1f 0x1e 0x1b 0x1e 0x2e 0x1e 0x30>;
		compatible = "mediatek,dispsys";
		mediatek,larb = <0x23>;
	};

	dma-controller@11000580 {
		#dma-cells = <0x1>;
		clock-names = "apdma";
		clocks = <0x27 0x26>;
		compatible = "mediatek,mt6577-uart-dma";
		interrupts = <0x0 0x6d 0x8 0x0 0x6e 0x8 0x0 0x6f 0x8 0x0 0x74 0x8>;
		linux,phandle = <0x34>;
		phandle = <0x34>;
		reg = <0x0 0x11000680 0x0 0x80 0x0 0x11000700 0x0 0x80 0x0 0x11000780 0x0 0x80 0x0 0x11000800 0x0 0x80>;
	};

	dpe@15028000 {
		clock-names = "DPE_CG_IMG_DPE";
		clocks = <0x42 0x3>;
		compatible = "mediatek,dpe";
		interrupts = <0x0 0x100 0x8>;
		reg = <0x0 0x15028000 0x0 0x1000>;
	};

	dramc0@1001d000 {
		compatible = "mediatek,dramc0";
		reg = <0x0 0x1001d000 0x0 0x1000>;
	};

	dramc@1022a000 {
		compatible = "mediatek,dramc";
		reg = <0x0 0x1022a000 0x0 0x2000 0x0 0x10232000 0x0 0x2000 0x0 0x1022c000 0x0 0x1000 0x0 0x10234000 0x0 0x1000 0x0 0x10228000 0x0 0x2000 0x0 0x10230000 0x0 0x2000 0x0 0x1022e000 0x0 0x1000 0x0 0x10236000 0x0 0x1000>;
	};

	dramc_nao@1021d000 {
		compatible = "mediatek,dramc_nao";
		reg = <0x0 0x1021d000 0x0 0x1000>;
	};

	dsi0@14014000 {
		compatible = "mediatek,dsi0";
		interrupts = <0x0 0xe1 0x8>;
		reg = <0x0 0x14014000 0x0 0x1000>;
	};

	dsi_te {
		compatible = "mediatek, DSI_TE-eint";
		linux,phandle = <0xa4>;
		phandle = <0xa4>;
		status = "disabled";
	};

	dvfsp@00110800 {
		compatible = "mediatek,mt6765-dvfsp";
		reg = <0x0 0x110800 0x0 0x1400 0x0 0x110800 0x0 0x1400>;
	};

	dvfsp@10227000 {
		compatible = "mediatek,dvfsp";
		reg = <0x0 0x10227000 0x0 0x1000>;
	};

	dvfsrc@10012000 {
		compatible = "mediatek,dvfsrc";
		reg = <0x0 0x10012000 0x0 0x1000 0x0 0x110780 0x0 0x80>;
	};

	dxcc_sec@10210000 {
		compatible = "mediatek,dxcc_sec";
		interrupts = <0x0 0xa2 0x4>;
		reg = <0x0 0x10210000 0x0 0x1000>;
	};

	dynamic_options {
		compatible = "mediatek,dynamic_options";
		linux,phandle = <0xbe>;
		phandle = <0xbe>;
	};

	eas {
		eff_turn_point = <0x1d3>;
		tiny = <0x32>;
	};

	eem_fsm@1100b000 {
		compatible = "mediatek,eem_fsm";
		interrupts = <0x0 0x7d 0x8>;
		reg = <0x0 0x1100b000 0x0 0x1000>;
	};

	efuse_dbg@10004000 {
		compatible = "mediatek,efuse_dbg";
		reg = <0x0 0x10004000 0x0 0x1000>;
	};

	efusec@11c50000 {
		compatible = "mediatek,efusec";
		reg = <0x0 0x11c50000 0x0 0x10000>;
	};

	emi@10219000 {
		compatible = "mediatek,emi";
		interrupts = <0x0 0x90 0x8>;
		reg = <0x0 0x10219000 0x0 0x1000 0x0 0x10226000 0x0 0x1000 0x0 0x1022d000 0x0 0x1000 0x0 0x10235000 0x0 0x1000>;
	};

	fdvt@1502b000 {
		clock-names = "FD_CLK_IMG_FDVT";
		clocks = <0x42 0x2>;
		compatible = "mediatek,fdvt";
		interrupts = <0x0 0x102 0x8>;
		reg = <0x0 0x1502b000 0x0 0x1000>;
	};

	fhctl@1000ce00 {
		compatible = "mediatek,fhctl";
		reg = <0x0 0x1000ce00 0x0 0x200>;
	};

	firmware {

		android {
			compatible = "android,firmware";

			fstab {
				compatible = "android,fstab";

				vendor {
					compatible = "android,vendor";
					dev = "/dev/block/platform/bootdevice/by-name/vendor";
					fsmgr_flags = "wait,avb";
					mnt_flags = "ro";
					type = "ext4";
				};
			};

			vbmeta {
				compatible = "android,vbmeta";
				parts = "vbmeta,boot,system,vendor,recovery";
			};
		};
	};

	flashlight_core {
		compatible = "mediatek,flashlight_core";
		linux,phandle = <0xa6>;
		phandle = <0xa6>;
	};

	flashlights_cola {
		compatible = "mediatek,flashlights_cola";
		decouple = <0x1>;
		linux,phandle = <0xa9>;
		phandle = <0xa9>;
		pinctrl-0 = <0x51>;
		pinctrl-1 = <0x52>;
		pinctrl-2 = <0x53>;
		pinctrl-names = "hwen_default", "hwen_high", "hwen_low";
		status = "okay";

		channel@1 {
			ct = <0x0>;
			part = <0x0>;
			type = <0x0>;
		};
	};

	flashlights_gpio {
		compatible = "mediatek,flashlights_dummy_gpio";
		linux,phandle = <0xa8>;
		phandle = <0xa8>;
		pinctrl-0 = <0x4b>;
		pinctrl-1 = <0x4c>;
		pinctrl-2 = <0x4d>;
		pinctrl-3 = <0x4e>;
		pinctrl-4 = <0x4f>;
		pinctrl-5 = <0x50>;
		pinctrl-names = "default", "strobe_on_gpio", "strobe_off_gpio", "torch_on_gpio", "torch_off_gpio", "torch_pwm_gpio";
		status = "okay";

		channel@1 {
			ct = <0x0>;
			part = <0x0>;
			type = <0x0>;
		};
	};

	flashlights_mt6370 {
		compatible = "mediatek,flashlights_mt6370";
		decouple = <0x0>;
		linux,phandle = <0xa7>;
		phandle = <0xa7>;

		channel@1 {
			ct = <0x0>;
			part = <0x0>;
			type = <0x0>;
		};

		channel@2 {
			ct = <0x1>;
			part = <0x0>;
			type = <0x0>;
		};
	};

	gauge_timer {
		compatible = "mediatek,gauge_timer_service";
	};

	gce@10238000 {
		#clock-cells = <0x1>;
		ap_dma_base = <0x18010000 0x17 0xffff0000>;
		audio_base = <0x17000000 0x12 0xffff0000>;
		buf_underrun_event_0 = <0x8c>;
		camsys1_base = <0x180a0000 0x1c 0xffff0000>;
		camsys2_base = <0x180b0000 0x1d 0xffff0000>;
		camsys_base = <0x18080000 0x1b 0xffff0000>;
		clock-names = "GCE", "GCE_TIMER";
		clocks = <0x27 0x9 0x27 0x18>;
		compatible = "mediatek,gce", "syscon";
		conn_peri_base = <0x18820000 0x7 0xffff0000>;
		dip_cq_thread0_frame_done = <0x101>;
		dip_cq_thread10_frame_done = <0x10b>;
		dip_cq_thread11_frame_done = <0x10c>;
		dip_cq_thread12_frame_done = <0x10d>;
		dip_cq_thread13_frame_done = <0x10e>;
		dip_cq_thread14_frame_done = <0x10f>;
		dip_cq_thread15_frame_done = <0x110>;
		dip_cq_thread16_frame_done = <0x111>;
		dip_cq_thread17_frame_done = <0x112>;
		dip_cq_thread18_frame_done = <0x113>;
		dip_cq_thread1_frame_done = <0x102>;
		dip_cq_thread2_frame_done = <0x103>;
		dip_cq_thread3_frame_done = <0x104>;
		dip_cq_thread4_frame_done = <0x105>;
		dip_cq_thread5_frame_done = <0x106>;
		dip_cq_thread6_frame_done = <0x107>;
		dip_cq_thread7_frame_done = <0x108>;
		dip_cq_thread8_frame_done = <0x109>;
		dip_cq_thread9_frame_done = <0x10a>;
		disp_2l_ovl0_frame_done = <0x1c>;
		disp_2l_ovl0_sof = <0x8>;
		disp_aal0_frame_done = <0x22>;
		disp_aal0_sof = <0xd>;
		disp_ccorr0_frame_done = <0x21>;
		disp_ccorr0_sof = <0xc>;
		disp_color0_frame_done = <0x20>;
		disp_color0_sof = <0xb>;
		disp_dither0_frame_done = <0x24>;
		disp_dither0_sof = <0xf>;
		disp_dither_base = <0x14010000 0x2 0xffff0000>;
		disp_dsi0_frame_done = <0x25>;
		disp_dsi0_sof = <0x10>;
		disp_gamma0_frame_done = <0x23>;
		disp_gamma0_sof = <0xe>;
		disp_ovl0_frame_done = <0x1b>;
		disp_ovl0_frame_rst_done_pusle = <0x98>;
		disp_ovl0_sof = <0x7>;
		disp_pwm0_sof = <0x13>;
		disp_rdma0_frame_done = <0x1e>;
		disp_rdma0_sof = <0x9>;
		disp_rsz0_frame_done = <0x1d>;
		disp_rsz0_sof = <0x11>;
		disp_wdma0_frame_done = <0x1f>;
		disp_wdma0_rst_done = <0x93>;
		disp_wdma0_sof = <0xa>;
		dsi0_done_event = <0x8f>;
		dsi0_irq_event = <0x8e>;
		dsi0_te_event = <0x8d>;
		dve_frame_done = <0x114>;
		g3d_config_base = <0x13000000 0x0 0xffff0000>;
		gce_base = <0x18020000 0x18 0xffff0000>;
		gcpu_base = <0x10050000 0xf 0xffff0000>;
		img_dl_relay_sof = <0x12>;
		imgsys_base = <0x15020000 0x4 0xffff0000>;
		infra_na3_base = <0x10010000 0xb 0xffff0000>;
		infra_na4_base = <0x10020000 0xc 0xffff0000>;
		interrupts = <0x0 0x9a 0x8 0x0 0x9b 0x8>;
		jpgdec_done = <0x123>;
		jpgenc_done = <0x122>;
		kp_base = <0x18840000 0x9 0xffff0000>;
		linux,phandle = <0x84>;
		max_prefetch_cnt = <0x1>;
		mboxes = <0x33 0x0 0x0 0x4 0x33 0x1 0x0 0x4 0x33 0x2 0x0 0x5 0x33 0x3 0x0 0x4 0x33 0x4 0x0 0x4 0x33 0x5 0x0 0x4 0x33 0x6 0x0 0x4 0x33 0x7 0xffffffff 0x2 0x33 0x8 0x0 0x1 0x33 0x9 0x0 0x1 0x33 0xa 0x0 0x1 0x33 0xb 0x0 0x1 0x33 0xc 0x0 0x1 0x33 0xd 0x0 0x1 0x33 0xe 0x0 0x1 0x33 0xf 0x0 0x1>;
		mcucfg_base = <0x10040000 0xe 0xffff0000>;
		mdp_ccorr0 = <0x31>;
		mdp_ccorr0_frame_done = <0x15>;
		mdp_ccorr0_sof = <0x1>;
		mdp_color0 = <0x30>;
		mdp_rdma0 = <0x2a>;
		mdp_rdma0_frame_done = <0x14>;
		mdp_rdma0_rst_done = <0x97>;
		mdp_rdma0_sof = <0x0>;
		mdp_rsz0 = <0x2b>;
		mdp_rsz0_frame_done = <0x16>;
		mdp_rsz0_sof = <0x2>;
		mdp_rsz1 = <0x2c>;
		mdp_rsz1_frame_done = <0x17>;
		mdp_rsz1_sof = <0x3>;
		mdp_tdshp0 = <0x2f>;
		mdp_tdshp0_frame_done = <0x1a>;
		mdp_tdshp0_sof = <0x6>;
		mdp_wdma0 = <0x2d>;
		mdp_wdma_frame_done = <0x19>;
		mdp_wdma_rst_done = <0x94>;
		mdp_wdma_sof = <0x4>;
		mdp_wrot0 = <0x2e>;
		mdp_wrot0_rst_done = <0x95>;
		mdp_wrot0_sof = <0x5>;
		mdp_wrot0_write_frame_done = <0x18>;
		mediatek,mailbox-gce = <0x33>;
		mipitx0_base = <0x11c80000 0x63 0xffff0000>;
		mm_mutex = <0x32>;
		mm_na_base = <0x14020000 0x3 0xffff0000>;
		mmsys_config = <0x29>;
		mmsys_config_base = <0x14000000 0x1 0xffff0000>;
		msdc2_base = <0x17020000 0x14 0xffff0000>;
		msdc3_base = <0x18000000 0x16 0xffff0000>;
		phandle = <0x84>;
		prefetch_size = <0x60>;
		pwm_sw_base = <0x1100e000 0x63 0xffff0000>;
		reg = <0x0 0x10238000 0x0 0x4000>;
		rsc_frame_done = <0x116>;
		scp_base = <0x10030000 0xd 0xffff0000>;
		scp_sram_base = <0x10000000 0xa 0xffff0000>;
		sram_share_cnt = <0x1>;
		sram_share_engine = <0xa>;
		sram_share_event = <0x2c6>;
		sram_size_cpr_64 = <0x40>;
		stream_done_0 = <0x82>;
		stream_done_1 = <0x83>;
		stream_done_2 = <0x84>;
		stream_done_3 = <0x85>;
		stream_done_4 = <0x86>;
		stream_done_5 = <0x87>;
		stream_done_6 = <0x88>;
		stream_done_7 = <0x89>;
		stream_done_8 = <0x8a>;
		stream_done_9 = <0x8b>;
		topckgen_base = <0x18830000 0x8 0xffff0000>;
		usb0_base = <0x10200000 0x10 0xffff0000>;
		usb_sif_base = <0x10280000 0x11 0xffff0000>;
		vdec1_base = <0x17030000 0x15 0xffff0000>;
		vdec2_base = <0x18040000 0x19 0xffff0000>;
		vdec3_base = <0x18050000 0x1a 0xffff0000>;
		vdec_base = <0x17010000 0x13 0xffff0000>;
		vdec_gcon_base = <0x18800000 0x5 0xffff0000>;
		venc_128byte_cnt_done = <0x125>;
		venc_done = <0x121>;
		venc_gcon_base = <0x18810000 0x6 0xffff0000>;
		venc_mb_done = <0x124>;
		wmf_frame_done = <0x115>;
	};

	gce_mbox@10238000 {
		#gce-event-cells = <0x1>;
		#gce-subsys-cells = <0x2>;
		#mbox-cells = <0x3>;
		clock-names = "gce", "GCE_TIMER";
		clocks = <0x27 0x9 0x27 0x18>;
		compatible = "mediatek,mailbox-gce";
		interrupts = <0x0 0x9a 0x8 0x0 0x9b 0x8>;
		linux,phandle = <0x33>;
		phandle = <0x33>;
		reg = <0x0 0x10238000 0x0 0x4000>;
	};

	gce_mbox_svp@10238000 {
		#mbox-cells = <0x3>;
		clock-names = "gce", "GCE_TIMER";
		clocks = <0x27 0x9 0x27 0x18>;
		compatible = "mediatek,mailbox-gce-svp";
		interrupts = <0x0 0x9a 0x8 0x0 0x9b 0x8>;
		linux,phandle = <0x85>;
		phandle = <0x85>;
		reg = <0x0 0x10238000 0x0 0x4000>;
	};

	gic500@0c000000 {
		compatible = "mediatek,gic500";
		reg = <0x0 0xc000000 0x0 0x1000>;
	};

	gic_cpu@0c400000 {
		compatible = "mediatek,gic_cpu";
		reg = <0x0 0xc400000 0x0 0x40000>;
	};

	gpio {
		compatible = "mediatek,gpio_usage_mapping";
		linux,phandle = <0x59>;
		phandle = <0x59>;
	};

	gpio@10005000 {
		compatible = "mediatek,gpio";
		linux,phandle = <0x5a>;
		phandle = <0x5a>;
		reg = <0x0 0x10005000 0x0 0x1000>;
	};

	gps {
		compatible = "mediatek,gps";
	};

	gpufreq {
		clock-names = "clk_mux", "clk_main_parent", "clk_sub_parent", "mtcmos_mfg_async", "mtcmos_mfg", "mtcmos_mfg_core0";
		clocks = <0x1e 0x64 0x1e 0x26 0x1f 0x28 0x8 0x28 0x4 0x28 0x7>;
		compatible = "mediatek,mt6765-gpufreq";
	};

	gse_1 {
		linux,phandle = <0xba>;
		phandle = <0xba>;
	};

	hacc@1000a000 {
		compatible = "mediatek,hacc";
		interrupts = <0x0 0xbd 0x8>;
		reg = <0x0 0x1000a000 0x0 0x1000>;
	};

	i2c0@11007000 {
		aed = <0x1a>;
		clock-div = <0x5>;
		clock-names = "main", "dma";
		clocks = <0x27 0xb 0x27 0x26>;
		compatible = "mediatek,i2c";
		id = <0x0>;
		interrupts = <0x0 0x54 0x8>;
		linux,phandle = <0x8c>;
		mediatek,hs_only;
		phandle = <0x8c>;
		reg = <0x0 0x11007000 0x0 0x1000 0x0 0x11000080 0x0 0x80>;
	};

	i2c1@11008000 {
		aed = <0x1a>;
		clock-div = <0x5>;
		clock-names = "main", "dma";
		clocks = <0x27 0xb 0x27 0x26>;
		compatible = "mediatek,i2c";
		id = <0x1>;
		interrupts = <0x0 0x55 0x8>;
		linux,phandle = <0x8d>;
		mediatek,hs_only;
		phandle = <0x8d>;
		reg = <0x0 0x11008000 0x0 0x1000 0x0 0x11000100 0x0 0x80>;
	};

	i2c2@11009000 {
		aed = <0x1a>;
		ch_offset_ccu = <0x200>;
		ch_offset_default = <0x100>;
		clock-div = <0x5>;
		clock-names = "main", "dma";
		clocks = <0x27 0xb 0x27 0x26>;
		compatible = "mediatek,i2c";
		id = <0x2>;
		interrupts = <0x0 0x56 0x8>;
		linux,phandle = <0x8e>;
		mediatek,hs_only;
		phandle = <0x8e>;
		reg = <0x0 0x11009000 0x0 0x1000 0x0 0x11000180 0x0 0x180>;
	};

	i2c3@1100f000 {
		aed = <0x1a>;
		ch_offset_default = <0x100>;
		clock-div = <0x5>;
		clock-names = "main", "dma";
		clocks = <0x27 0xb 0x27 0x26>;
		compatible = "mediatek,i2c";
		id = <0x3>;
		interrupts = <0x0 0x57 0x8>;
		linux,phandle = <0x8f>;
		mediatek,hs_only;
		phandle = <0x8f>;
		reg = <0x0 0x1100f000 0x0 0x1000 0x0 0x11000300 0x0 0x100>;
	};

	i2c4@11011000 {
		aed = <0x1a>;
		ch_offset_ccu = <0x200>;
		ch_offset_default = <0x100>;
		clock-div = <0x5>;
		clock-names = "main", "dma";
		clocks = <0x27 0xb 0x27 0x26>;
		compatible = "mediatek,i2c";
		id = <0x4>;
		interrupts = <0x0 0x58 0x8>;
		linux,phandle = <0x90>;
		mediatek,hs_only;
		phandle = <0x90>;
		reg = <0x0 0x11011000 0x0 0x1000 0x0 0x11000400 0x0 0x180>;
	};

	i2c5@11016000 {
		aed = <0x1a>;
		clock-div = <0x5>;
		clock-names = "main", "dma";
		clocks = <0x27 0xb 0x27 0x26>;
		compatible = "mediatek,i2c";
		id = <0x5>;
		interrupts = <0x0 0x82 0x8>;
		linux,phandle = <0x91>;
		mediatek,hs_only;
		phandle = <0x91>;
		reg = <0x0 0x11016000 0x0 0x1000 0x0 0x11000580 0x0 0x80>;
	};

	i2c6@1100d000 {
		aed = <0x1a>;
		ch_offset_ccu = <0x200>;
		ch_offset_default = <0x100>;
		clock-div = <0x5>;
		clock-names = "main", "dma";
		clocks = <0x27 0xb 0x27 0x26>;
		compatible = "mediatek,i2c";
		id = <0x6>;
		interrupts = <0x0 0x83 0x8>;
		linux,phandle = <0x92>;
		mediatek,hs_only;
		phandle = <0x92>;
		reg = <0x0 0x1100d000 0x0 0x1000 0x0 0x11000600 0x0 0x80>;
	};

	i2c7 {
		linux,phandle = <0xb4>;
		phandle = <0xb4>;
	};

	i2c8 {
		linux,phandle = <0xb5>;
		phandle = <0xb5>;
	};

	i2c9 {
		linux,phandle = <0xb6>;
		phandle = <0xb6>;
	};

	i2c_common {
		check_max_freq = [01];
		cnt_constraint = [01];
		compatible = "mediatek,i2c_common";
		dma_support = [02];
		ext_time_config = [18 01];
		idvfs = [01];
		linux,phandle = <0x8b>;
		phandle = <0x8b>;
		set_dt_div = [01];
		set_ltiming = [01];
		ver = [02];
	};

	imgsys@15020000 {
		#clock-cells = <0x1>;
		clock-names = "ISP_SCP_SYS_DIS", "ISP_SCP_SYS_ISP", "ISP_SCP_SYS_CAM", "ISP_CLK_IMG_DIP", "ISP_CLK_CAM", "ISP_CLK_CAMTG", "ISP_CLK_CAM_SENINF", "ISP_CLK_CAMSV0", "ISP_CLK_CAMSV1", "ISP_CLK_CAMSV2";
		clocks = <0x28 0x3 0x28 0x5 0x28 0x9 0x42 0x1 0x43 0x2 0x43 0x3 0x43 0x4 0x43 0x5 0x43 0x6 0x43 0x7>;
		compatible = "mediatek,imgsys", "syscon";
		linux,phandle = <0x42>;
		phandle = <0x42>;
		reg = <0x0 0x15020000 0x0 0x1000>;
	};

	imp_iic@11017000 {
		compatible = "mediatek,imp_iic";
		reg = <0x0 0x11017000 0x0 0x1000>;
	};

	infra_mbist@1020d000 {
		compatible = "mediatek,infra_mbist";
		reg = <0x0 0x1020d000 0x0 0x1000>;
	};

	infracfg@1020e000 {
		compatible = "mediatek,infracfg";
		reg = <0x0 0x1020e000 0x0 0x1000>;
	};

	infracfg_ao@10001000 {
		#clock-cells = <0x1>;
		compatible = "mediatek,infracfg_ao", "syscon";
		interrupts = <0x0 0x93 0x1>;
		linux,phandle = <0x27>;
		phandle = <0x27>;
		reg = <0x0 0x10001000 0x0 0x1000>;
	};

	interrupt-controller@0c000000 {
		#address-cells = <0x2>;
		#interrupt-cells = <0x3>;
		#redistributor-regions = <0x1>;
		#size-cells = <0x2>;
		compatible = "arm,gic-v3";
		interrupt-controller;
		interrupt-parent = <0x11>;
		interrupts = <0x1 0x9 0x4>;
		linux,phandle = <0x11>;
		phandle = <0x11>;
		reg = <0x0 0xc000000 0x0 0x40000 0x0 0xc100000 0x0 0x200000 0x0 0x10200a80 0x0 0x50>;
	};

	intpol-controller@10200a80 {
		#interrupt-cells = <0x3>;
		compatible = "mediatek,mt6577-sysirq";
		interrupt-controller;
		interrupt-parent = <0x11>;
		linux,phandle = <0x1>;
		phandle = <0x1>;
		reg = <0x0 0x10200a80 0x0 0x50>;
	};

	io_cfg_bl@10002600 {
		compatible = "mediatek,io_cfg_bl";
		reg = <0x0 0x10002600 0x0 0x200>;
	};

	io_cfg_lb@10002400 {
		compatible = "mediatek,io_cfg_lb";
		reg = <0x0 0x10002400 0x0 0x200>;
	};

	io_cfg_lm@10002200 {
		compatible = "mediatek,io_cfg_lm";
		reg = <0x0 0x10002200 0x0 0x200>;
	};

	io_cfg_lt@10002000 {
		compatible = "mediatek,io_cfg_lt";
		reg = <0x0 0x10002000 0x0 0x200>;
	};

	io_cfg_rb@10002a00 {
		compatible = "mediatek,io_cfg_rb";
		reg = <0x0 0x10002a00 0x0 0x200>;
	};

	io_cfg_rr@10002800 {
		compatible = "mediatek,io_cfg_rr";
		reg = <0x0 0x10002800 0x0 0x200>;
	};

	io_cfg_rt@10002c00 {
		compatible = "mediatek,io_cfg_rt";
		reg = <0x0 0x10002c00 0x0 0x200>;
	};

	iocfg_0@10002000 {
		compatible = "mediatek,iocfg_0";
		reg = <0x0 0x10002000 0x0 0x200>;
	};

	iocfg_1@10002200 {
		compatible = "mediatek,iocfg_1";
		reg = <0x0 0x10002200 0x0 0x200>;
	};

	iocfg_2@10002400 {
		compatible = "mediatek,iocfg_2";
		reg = <0x0 0x10002400 0x0 0x200>;
	};

	iocfg_3@10002600 {
		compatible = "mediatek,iocfg_3";
		reg = <0x0 0x10002600 0x0 0x200>;
	};

	iocfg_4@10002800 {
		compatible = "mediatek,iocfg_4";
		reg = <0x0 0x10002800 0x0 0x200>;
	};

	iocfg_5@10002a00 {
		compatible = "mediatek,iocfg_5";
		reg = <0x0 0x10002a00 0x0 0x200>;
	};

	irq_nfc {
		compatible = "mediatek,irq_nfc-eint";
		linux,phandle = <0xa2>;
		phandle = <0xa2>;
	};

	irtx_pwm {
		compatible = "mediatek,irtx-pwm";
		linux,phandle = <0xb1>;
		phandle = <0xb1>;
		pwm_ch = <0x0>;
		pwm_data_invert = <0x0>;
	};

	kd_camera_hw1@1a040000 {
		camera-main-af-en = <0x20 0xb1 0x0>;
		clock-names = "CLK_TOP_CAMTG_SEL", "CLK_TOP_CAMTG1_SEL", "CLK_TOP_CAMTG2_SEL", "CLK_TOP_CAMTG3_SEL", "CLK_MCLK_6M", "CLK_MCLK_12M", "CLK_MCLK_13M", "CLK_MCLK_48M", "CLK_MCLK_52M", "CLK_MCLK_24M", "CLK_MCLK_26M", "CLK_CAM_SENINF_CG", "CLK_MIPI_C0_26M_CG", "CLK_MIPI_C1_26M_CG", "CLK_MIPI_ANA_0A_CG", "CLK_MIPI_ANA_0B_CG", "CLK_MIPI_ANA_1A_CG", "CLK_MIPI_ANA_1B_CG", "CLK_MIPI_ANA_2A_CG", "CLK_MIPI_ANA_2B_CG", "CLK_TOP_CAMTM_SEL_CG", "CLK_TOP_CAMTM_208_CG", "CLK_SCP_SYS_CAM";
		clocks = <0x1e 0x66 0x1e 0x67 0x1e 0x68 0x1e 0x69 0x1e 0x14 0x1e 0x13 0x1e 0x1d 0x1e 0x11 0x1e 0x1c 0x1e 0x12 0x1f 0x43 0x4 0x41 0xe 0x41 0x12 0x45 0x0 0x46 0x0 0x47 0x0 0x48 0x0 0x49 0x0 0x4a 0x0 0x1e 0x7d 0x1e 0x1a 0x28 0x9>;
		compatible = "mediatek,camera_hw";
		linux,phandle = <0xa5>;
		phandle = <0xa5>;
		reg = <0x0 0x1a040000 0x0 0x1000>;
	};

	kp@10010000 {
		compatible = "mediatek,kp";
		interrupts = <0x0 0xb4 0x2>;
		linux,phandle = <0x1a>;
		phandle = <0x1a>;
		reg = <0x0 0x10010000 0x0 0x1000>;
	};

	l2c_parity {
		compatible = "mediatek,l2c_parity-v1";
		interrupts = <0x0 0x18 0x4 0x0 0x19 0x4>;
	};

	lcm {
		compatible = "mediatek,lcm_mode";
		linux,phandle = <0x80>;
		phandle = <0x80>;
	};

	lk_charger {
		ac_charger_current = <0x668a0>;
		ac_charger_input_current = <0x1e8480>;
		charging_host_charger_current = <0x668a0>;
		compatible = "mediatek,lk_charger";
		enable_anime;
		enable_pe_plus;
		fast_charge_voltage = <0x2f4d60>;
		linux,phandle = <0xac>;
		max_charger_voltage = <0x588040>;
		non_std_ac_charger_current = <0x61a80>;
		pd_charger_current = <0x7a120>;
		phandle = <0xac>;
		power_path_support;
		ta_ac_charger_current = <0x2dc6c0>;
		temp_t1_threshold = <0x0>;
		temp_t3_threshold = <0x2d>;
		temp_t4_threshold = <0x32>;
		usb_charger_current = <0x668a0>;
	};

	m4u@10205000 {
		#iommu-cells = <0x1>;
		cell-index = <0x0>;
		compatible = "mediatek,iommu_v0";
		interrupts = <0x0 0x9e 0x8>;
		linux,phandle = <0x54>;
		mediatek,larbs = <0x23 0x24 0x25 0x26>;
		phandle = <0x54>;
		reg = <0x0 0x10205000 0x0 0x1000>;
	};

	mbist@17050000 {
		compatible = "mediatek,mbist";
		reg = <0x0 0x17050000 0x0 0x10000>;
	};

	mbist_ao@10013000 {
		compatible = "mediatek,mbist_ao";
		reg = <0x0 0x10013000 0x0 0x1000>;
	};

	mcdi@0010fc00 {
		compatible = "mediatek,mt6765-mcdi";
		reg = <0x0 0x10fc00 0x0 0x800>;
	};

	mcucfg@10200000 {
		compatible = "mediatek,mcucfg";
		interrupts = <0x0 0x0 0x8>;
		reg = <0x0 0x10200000 0x0 0x1000>;
	};

	mcucfg_mp0_counter@10200000 {
		compatible = "mediatek,mcucfg_mp0_counter";
		reg = <0x0 0x10200000 0x0 0x4000>;
	};

	mcupm_reg@10216000 {
		compatible = "mediatek,mcupm_reg";
		reg = <0x0 0x10216000 0x0 0x1000>;
	};

	mcupm_sram0@10217000 {
		compatible = "mediatek,mcupm_sram0";
		reg = <0x0 0x10217000 0x0 0x1000>;
	};

	mcupm_sram1@10218000 {
		compatible = "mediatek,mcupm_sram1";
		reg = <0x0 0x10218000 0x0 0x1000>;
	};

	mcupm_sram2@10211000 {
		compatible = "mediatek,mcupm_sram2";
		reg = <0x0 0x10211000 0x0 0x1000>;
	};

	mcupm_sram3@10213000 {
		compatible = "mediatek,mcupm_sram3";
		reg = <0x0 0x10213000 0x0 0x1000>;
	};

	md1_sim1_hot_plug_eint {
		linux,phandle = <0xbb>;
		phandle = <0xbb>;
	};

	md1_sim2_hot_plug_eint {
		linux,phandle = <0xbc>;
		phandle = <0xbc>;
	};

	md_ccif0@1020a000 {
		compatible = "mediatek,md_ccif0";
		reg = <0x0 0x1020a000 0x0 0x1000>;
	};

	md_ccif1@1020c000 {
		compatible = "mediatek,md_ccif1";
		reg = <0x0 0x1020c000 0x0 0x1000>;
	};

	md_ccif2@1023d000 {
		compatible = "mediatek,md_ccif2";
		reg = <0x0 0x1023d000 0x0 0x1000>;
	};

	md_ccif3@1023f000 {
		compatible = "mediatek,md_ccif3";
		reg = <0x0 0x1023f000 0x0 0x1000>;
	};

	mdcldma@10014000 {
		clock-names = "scp-sys-md1-main", "infra-cldma-bclk", "infra-ccif-ap", "infra-ccif-md", "infra-ccif1-ap", "infra-ccif1-md", "infra-ccif2-ap", "infra-ccif2-md";
		clocks = <0x28 0x0 0x27 0x32 0x27 0x29 0x27 0x2c 0x27 0x23 0x27 0x24 0x27 0x51 0x27 0x52>;
		compatible = "mediatek,mdcldma";
		interrupts = <0x0 0xa5 0x4 0x0 0x94 0x8 0x0 0x95 0x8 0x0 0x105 0x2>;
		linux,phandle = <0x1c>;
		mediatek,cldma_capability = <0x6>;
		mediatek,md_id = <0x0>;
		phandle = <0x1c>;
		reg = <0x0 0x10014000 0x0 0x1000 0x0 0x1021b000 0x0 0x1000 0x0 0x10209000 0x0 0x1000 0x0 0x1020a000 0x0 0x1000>;
	};

	mdcldmain@1021c000 {
		compatible = "mediatek,mdcldmain";
		reg = <0x0 0x1021c000 0x0 0x400>;
	};

	mdcldmain_ao@10015000 {
		compatible = "mediatek,mdcldmain_ao";
		reg = <0x0 0x10015000 0x0 0x400>;
	};

	mdcldmamisc@1021c800 {
		compatible = "mediatek,mdcldmamisc";
		reg = <0x0 0x1021c800 0x0 0x1000>;
	};

	mdcldmamisc_ao@10015800 {
		compatible = "mediatek,mdcldmamisc_ao";
		reg = <0x0 0x10015800 0x0 0x400>;
	};

	mdcldmaout@1021c400 {
		compatible = "mediatek,mdcldmaout";
		reg = <0x0 0x1021c400 0x0 0x400>;
	};

	mdcldmaout_ao@10015400 {
		compatible = "mediatek,mdcldmaout_ao";
		reg = <0x0 0x10015400 0x0 0x400>;
	};

	mdp_ccorr0@14005000 {
		clock-names = "MDP_CCORR";
		clocks = <0x29 0x1>;
		compatible = "mediatek,mdp_ccorr0";
		interrupts = <0x0 0xe2 0x8>;
		linux,phandle = <0x31>;
		phandle = <0x31>;
		reg = <0x0 0x14005000 0x0 0x1000>;
	};

	mdp_rdma0@14004000 {
		clock-names = "MDP_RDMA0";
		clocks = <0x29 0x0>;
		compatible = "mediatek,mdp_rdma0";
		interrupts = <0x0 0xd3 0x8>;
		linux,phandle = <0x2a>;
		phandle = <0x2a>;
		reg = <0x0 0x14004000 0x0 0x1000>;
	};

	mdp_rsz0@14006000 {
		clock-names = "MDP_RSZ0";
		clocks = <0x29 0x2>;
		compatible = "mediatek,mdp_rsz0";
		interrupts = <0x0 0xd4 0x8>;
		linux,phandle = <0x2b>;
		phandle = <0x2b>;
		reg = <0x0 0x14006000 0x0 0x1000>;
	};

	mdp_rsz1@14007000 {
		clock-names = "MDP_RSZ1";
		clocks = <0x29 0x3>;
		compatible = "mediatek,mdp_rsz1";
		interrupts = <0x0 0xd5 0x8>;
		linux,phandle = <0x2c>;
		phandle = <0x2c>;
		reg = <0x0 0x14007000 0x0 0x1000>;
	};

	mdp_tdshp0@1400a000 {
		clock-names = "MDP_TDSHP";
		clocks = <0x29 0x4>;
		compatible = "mediatek,mdp_tdshp0";
		linux,phandle = <0x2f>;
		phandle = <0x2f>;
		reg = <0x0 0x1400a000 0x0 0x1000>;
	};

	mdp_wdma0@14008000 {
		clock-names = "MDP_WDMA";
		clocks = <0x29 0x6>;
		compatible = "mediatek,mdp_wdma0";
		interrupts = <0x0 0xd8 0x8>;
		linux,phandle = <0x2d>;
		phandle = <0x2d>;
		reg = <0x0 0x14008000 0x0 0x1000>;
	};

	mdp_wrot0@14009000 {
		clock-names = "MDP_WROT0";
		clocks = <0x29 0x5>;
		compatible = "mediatek,mdp_wrot0";
		interrupts = <0x0 0xd7 0x8>;
		linux,phandle = <0x2e>;
		phandle = <0x2e>;
		reg = <0x0 0x14009000 0x0 0x1000>;
	};

	memory {
		device_type = "memory";
		reg = <0x0 0x40000000 0x0 0x20000000>;
	};

	mfg_cfg@13ffe000 {
		#clock-cells = <0x1>;
		compatible = "mediatek,mfgcfg", "syscon";
		linux,phandle = <0xa0>;
		phandle = <0xa0>;
		reg = <0x0 0x13ffe000 0x0 0x1000>;
	};

	mfg_doma@13000000 {
		clock-frequency = <0x21f98280>;
		compatible = "mediatek,doma";
		interrupt-names = "RGX";
		interrupts = <0x0 0x103 0x8>;
		reg = <0x0 0x13000000 0x0 0x80000>;
	};

	mipi_rx_ana_csi0a@11c10000 {
		#clock-cells = <0x1>;
		compatible = "mediatek,mipi_rx_ana_csi0a", "syscon";
		linux,phandle = <0x45>;
		phandle = <0x45>;
		reg = <0x0 0x11c10000 0x0 0x1000>;
	};

	mipi_rx_ana_csi0b@11c11000 {
		#clock-cells = <0x1>;
		compatible = "mediatek,mipi_rx_ana_csi0b", "syscon";
		linux,phandle = <0x46>;
		phandle = <0x46>;
		reg = <0x0 0x11c11000 0x0 0x1000>;
	};

	mipi_rx_ana_csi1a@11c12000 {
		#clock-cells = <0x1>;
		compatible = "mediatek,mipi_rx_ana_csi1a", "syscon";
		linux,phandle = <0x47>;
		phandle = <0x47>;
		reg = <0x0 0x11c12000 0x0 0x1000>;
	};

	mipi_rx_ana_csi1b@11c13000 {
		#clock-cells = <0x1>;
		compatible = "mediatek,mipi_rx_ana_csi1b", "syscon";
		linux,phandle = <0x48>;
		phandle = <0x48>;
		reg = <0x0 0x11c13000 0x0 0x1000>;
	};

	mipi_rx_ana_csi2a@11c14000 {
		#clock-cells = <0x1>;
		compatible = "mediatek,mipi_rx_ana_csi2a", "syscon";
		linux,phandle = <0x49>;
		phandle = <0x49>;
		reg = <0x0 0x11c14000 0x0 0x1000>;
	};

	mipi_rx_ana_csi2b@11c15000 {
		#clock-cells = <0x1>;
		compatible = "mediatek,mipi_rx_ana_csi2b", "syscon";
		linux,phandle = <0x4a>;
		phandle = <0x4a>;
		reg = <0x0 0x11c15000 0x0 0x1000>;
	};

	mipi_tx0@11c80000 {
		compatible = "mediatek,mipi_tx0";
		reg = <0x0 0x11c80000 0x0 0x10000>;
	};

	mmdvfs_pmqos {
		cam_freq = "mm_step0", "mm_step1", "mm_step2";
		clock-names = "mmdvfs_clk_mm_sel_ck", "mmdvfs_clk_mmpll_ck", "mmdvfs_clk_univpll1_d2_ck", "mmdvfs_clk_mmpll_d2_ck";
		clocks = <0x1e 0x62 0x1e 0x21 0x1e 0x17 0x1e 0x22>;
		compatible = "mediatek,mmdvfs_pmqos";
		disp_freq = "mm_step0", "mm_step1", "mm_step2";
		img_freq = "mm_step0", "mm_step1", "mm_step2";
		mdp_freq = "mm_step0", "mm_step1", "mm_step2";
		mm_step0 = <0x1c9 0x1 0x0 0x1>;
		mm_step1 = <0x138 0x1 0x0 0x2>;
		mm_step2 = <0xe4 0x1 0x0 0x3>;
		vdec_freq = "mm_step0", "mm_step1", "mm_step2";
		venc_freq = "mm_step0", "mm_step1", "mm_step2";
		vopp_steps = <0x0 0x1 0x3>;
	};

	mmsys_config@14000000 {
		#clock-cells = <0x1>;
		clock-names = "CAM_MDP", "IMG_DL_RELAY", "IMG_DL_ASYNC_TOP";
		clocks = <0x29 0x17 0x29 0x1a 0x29 0x1b>;
		compatible = "mediatek,mmsys_config", "syscon";
		interrupts = <0x0 0xe3 0x8>;
		linux,phandle = <0x29>;
		phandle = <0x29>;
		reg = <0x0 0x14000000 0x0 0x1000>;
	};

	mobicore {
		compatible = "trustonic,mobicore";
		interrupts = <0x0 0x10f 0x1>;
	};

	modem_temp_share@10018000 {
		compatible = "mediatek,modem_temp_share";
		reg = <0x0 0x10018000 0x0 0x1000>;
	};

	mrdump_ext_rst {
		compatible = "mediatek, mrdump_ext_rst-eint";
		linux,phandle = <0x7e>;
		mode = "IRQ";
		phandle = <0x7e>;
		source = "EINT";
		status = "okay";
	};

	msdc0_pad_macro@11cd0000 {
		compatible = "mediatek,msdc0_pad_macro";
		reg = <0x0 0x11cd0000 0x0 0x10000>;
	};

	msdc0_top@11cd0000 {
		compatible = "mediatek,msdc0_top";
		reg = <0x0 0x11cd0000 0x0 0x1000>;
	};

	msdc1_ins@0 {
		compatible = "mediatek,mt6765-sdcard-ins";
		linux,phandle = <0x9e>;
		phandle = <0x9e>;
	};

	msdc1_pad_macro@11c90000 {
		compatible = "mediatek,msdc1_pad_macro";
		reg = <0x0 0x11c90000 0x0 0x10000>;
	};

	msdc1_top@11c90000 {
		compatible = "mediatek,msdc1_top";
		reg = <0x0 0x11c90000 0x0 0x1000>;
	};

	msdc@11230000 {
		bootable;
		bus-width = <0x8>;
		cap-mmc-highspeed;
		clk_src = [01];
		clock-names = "msdc0-clock", "msdc0-hclock", "msdc0-aes-clock";
		clocks = <0x27 0x4c 0x27 0x1c 0x27 0x44>;
		compatible = "mediatek,msdc";
		host_function = [00];
		index = [00];
		interrupts = <0x0 0x4f 0x8>;
		linux,phandle = <0x9a>;
		max-frequency = <0xbebc200>;
		mmc-ddr-1_8v;
		mmc-hs200-1_8v;
		mmc-hs400-1_8v;
		no-sd;
		no-sdio;
		non-removable;
		phandle = <0x9a>;
		pinctl = <0x35>;
		pinctl_hs200 = <0x37>;
		pinctl_hs400 = <0x36>;
		reg = <0x0 0x11230000 0x0 0x10000>;
		register_setting = <0x38>;
		status = "okay";
		vmmc-supply = <0x39>;
	};

	msdc@11240000 {
		bus-width = <0x4>;
		cap-sd-highspeed;
		cd-gpios = <0x20 0x1 0x0>;
		cd-ldo-gpio = <0x20 0xad 0x0>;
		cd_level = [01];
		clk_src = [02];
		clock-names = "msdc1-clock", "msdc1-hclock";
		clocks = <0x27 0x4d 0x27 0x1d>;
		compatible = "mediatek,msdc";
		host_function = [01];
		index = [01];
		interrupts = <0x0 0x50 0x8>;
		linux,phandle = <0x9b>;
		max-frequency = <0xbebc200>;
		no-mmc;
		no-sdio;
		phandle = <0x9b>;
		pinctl = <0x3a>;
		pinctl_ddr50 = <0x3d>;
		pinctl_sdr104 = <0x3b>;
		pinctl_sdr50 = <0x3c>;
		reg = <0x0 0x11240000 0x0 0x10000>;
		register_setting = <0x3e>;
		sd-uhs-ddr50;
		sd-uhs-sdr104;
		sd-uhs-sdr12;
		sd-uhs-sdr25;
		sd-uhs-sdr50;
		status = "okay";
		vqmmc-supply = <0x3f>;
	};

	msdc@11250000 {
		compatible = "mediatek,msdc2";
		linux,phandle = <0x9c>;
		phandle = <0x9c>;
		reg = <0x0 0x11250000 0x0 0x10000>;
		status = "disable";
	};

	msdc@11260000 {
		compatible = "mediatek,msdc3";
		linux,phandle = <0x9d>;
		phandle = <0x9d>;
		reg = <0x0 0x11250000 0x0 0x10000>;
		status = "disable";
	};

	mt-pmic {
		compatible = "mediatek,mt_pmic";
		interrupt-controller;
		linux,phandle = <0x5d>;
		phandle = <0x5d>;

		buck_regulators {

			buck_vcore {
				linux,phandle = <0x61>;
				phandle = <0x61>;
				regulator-enable-ramp-delay = <0xdc>;
				regulator-max-microvolt = <0x1406f4>;
				regulator-min-microvolt = <0x7ea5e>;
				regulator-name = "vcore";
				regulator-ramp-delay = <0x186a>;
			};

			buck_vmodem {
				linux,phandle = <0x60>;
				phandle = <0x60>;
				regulator-enable-ramp-delay = <0xdc>;
				regulator-max-microvolt = <0x123716>;
				regulator-min-microvolt = <0x7a120>;
				regulator-name = "vmodem";
				regulator-ramp-delay = <0x186a>;
			};

			buck_vpa {
				linux,phandle = <0x63>;
				phandle = <0x63>;
				regulator-enable-ramp-delay = <0xdc>;
				regulator-max-microvolt = <0x37b1d0>;
				regulator-min-microvolt = <0x7a120>;
				regulator-name = "vpa";
				regulator-ramp-delay = <0xc350>;
			};

			buck_vproc {
				linux,phandle = <0x62>;
				phandle = <0x62>;
				regulator-enable-ramp-delay = <0xdc>;
				regulator-max-microvolt = <0x1406f4>;
				regulator-min-microvolt = <0x7ea5e>;
				regulator-name = "vproc";
				regulator-ramp-delay = <0x186a>;
			};

			buck_vs1 {
				linux,phandle = <0x5f>;
				phandle = <0x5f>;
				regulator-enable-ramp-delay = <0xdc>;
				regulator-max-microvolt = <0x2191c0>;
				regulator-min-microvolt = <0x124f80>;
				regulator-name = "vs1";
				regulator-ramp-delay = <0x30d4>;
			};
		};

		ldo_regulators {

			ldo_vaud28 {
				compatible = "regulator-fixed";
				linux,phandle = <0x74>;
				phandle = <0x74>;
				regulator-enable-ramp-delay = <0x108>;
				regulator-max-microvolt = <0x2ab980>;
				regulator-min-microvolt = <0x2ab980>;
				regulator-name = "vaud28";
			};

			ldo_vaux18 {
				compatible = "regulator-fixed";
				linux,phandle = <0x73>;
				phandle = <0x73>;
				regulator-enable-ramp-delay = <0x108>;
				regulator-max-microvolt = <0x1b7740>;
				regulator-min-microvolt = <0x1b7740>;
				regulator-name = "vaux18";
			};

			ldo_vcama {
				linux,phandle = <0x6d>;
				phandle = <0x6d>;
				regulator-enable-ramp-delay = <0x108>;
				regulator-max-microvolt = <0x2ab980>;
				regulator-min-microvolt = <0x2625a0>;
				regulator-name = "vcama";
			};

			ldo_vcamd {
				linux,phandle = <0x6e>;
				phandle = <0x6e>;
				regulator-enable-ramp-delay = <0x108>;
				regulator-max-microvolt = <0x1b7740>;
				regulator-min-microvolt = <0xf4240>;
				regulator-name = "vcamd";
			};

			ldo_vcamio {
				compatible = "regulator-fixed";
				linux,phandle = <0x6f>;
				phandle = <0x6f>;
				regulator-enable-ramp-delay = <0x108>;
				regulator-max-microvolt = <0x1b7740>;
				regulator-min-microvolt = <0x1b7740>;
				regulator-name = "vcamio";
			};

			ldo_vcn18 {
				compatible = "regulator-fixed";
				linux,phandle = <0x6c>;
				phandle = <0x6c>;
				regulator-enable-ramp-delay = <0x108>;
				regulator-max-microvolt = <0x1b7740>;
				regulator-min-microvolt = <0x1b7740>;
				regulator-name = "vcn18";
			};

			ldo_vcn28 {
				compatible = "regulator-fixed";
				linux,phandle = <0x6b>;
				phandle = <0x6b>;
				regulator-enable-ramp-delay = <0x108>;
				regulator-max-microvolt = <0x2ab980>;
				regulator-min-microvolt = <0x2ab980>;
				regulator-name = "vcn28";
			};

			ldo_vcn33_bt {
				linux,phandle = <0x69>;
				phandle = <0x69>;
				regulator-enable-ramp-delay = <0x108>;
				regulator-max-microvolt = <0x3567e0>;
				regulator-min-microvolt = <0x325aa0>;
				regulator-name = "vcn33_bt";
			};

			ldo_vcn33_wifi {
				linux,phandle = <0x6a>;
				phandle = <0x6a>;
				regulator-enable-ramp-delay = <0x108>;
				regulator-max-microvolt = <0x3567e0>;
				regulator-min-microvolt = <0x325aa0>;
				regulator-name = "vcn33_wifi";
			};

			ldo_vdram {
				linux,phandle = <0x77>;
				phandle = <0x77>;
				regulator-enable-ramp-delay = <0xce4>;
				regulator-max-microvolt = <0x124f80>;
				regulator-min-microvolt = <0x10c8e0>;
				regulator-name = "vdram";
			};

			ldo_vefuse {
				linux,phandle = <0x68>;
				phandle = <0x68>;
				regulator-enable-ramp-delay = <0x108>;
				regulator-max-microvolt = <0x325aa0>;
				regulator-min-microvolt = <0x124f80>;
				regulator-name = "vefuse";
			};

			ldo_vemc {
				linux,phandle = <0x39>;
				phandle = <0x39>;
				regulator-enable-ramp-delay = <0x2c>;
				regulator-max-microvolt = <0x325aa0>;
				regulator-min-microvolt = <0x2c4020>;
				regulator-name = "vemc";
			};

			ldo_vfe28 {
				compatible = "regulator-fixed";
				linux,phandle = <0x64>;
				phandle = <0x64>;
				regulator-enable-ramp-delay = <0x108>;
				regulator-max-microvolt = <0x2ab980>;
				regulator-min-microvolt = <0x2ab980>;
				regulator-name = "vfe28";
			};

			ldo_vibr {
				linux,phandle = <0x7b>;
				phandle = <0x7b>;
				regulator-enable-ramp-delay = <0x2c>;
				regulator-max-microvolt = <0x325aa0>;
				regulator-min-microvolt = <0x124f80>;
				regulator-name = "vibr";
			};

			ldo_vio18 {
				compatible = "regulator-fixed";
				linux,phandle = <0x76>;
				phandle = <0x76>;
				regulator-enable-ramp-delay = <0x108>;
				regulator-max-microvolt = <0x1b7740>;
				regulator-min-microvolt = <0x1b7740>;
				regulator-name = "vio18";
			};

			ldo_vio28 {
				compatible = "regulator-fixed";
				linux,phandle = <0x75>;
				phandle = <0x75>;
				regulator-enable-ramp-delay = <0x108>;
				regulator-max-microvolt = <0x2ab980>;
				regulator-min-microvolt = <0x2ab980>;
				regulator-name = "vio28";
			};

			ldo_vldo28 {
				linux,phandle = <0x70>;
				phandle = <0x70>;
				regulator-enable-ramp-delay = <0x108>;
				regulator-max-microvolt = <0x2dc6c0>;
				regulator-min-microvolt = <0x2ab980>;
				regulator-name = "vldo28";
			};

			ldo_vmc {
				linux,phandle = <0x3f>;
				phandle = <0x3f>;
				regulator-enable-ramp-delay = <0x2c>;
				regulator-max-microvolt = <0x325aa0>;
				regulator-min-microvolt = <0x1b7740>;
				regulator-name = "vmc";
			};

			ldo_vmch {
				linux,phandle = <0x78>;
				phandle = <0x78>;
				regulator-enable-ramp-delay = <0x2c>;
				regulator-max-microvolt = <0x325aa0>;
				regulator-min-microvolt = <0x2c4020>;
				regulator-name = "vmch";
			};

			ldo_vrf12 {
				compatible = "regulator-fixed";
				linux,phandle = <0x67>;
				phandle = <0x67>;
				regulator-enable-ramp-delay = <0x6e>;
				regulator-max-microvolt = <0x124f80>;
				regulator-min-microvolt = <0x124f80>;
				regulator-name = "vrf12";
			};

			ldo_vrf18 {
				compatible = "regulator-fixed";
				linux,phandle = <0x66>;
				phandle = <0x66>;
				regulator-enable-ramp-delay = <0x6e>;
				regulator-max-microvolt = <0x1b7740>;
				regulator-min-microvolt = <0x1b7740>;
				regulator-name = "vrf18";
			};

			ldo_vsim1 {
				linux,phandle = <0x79>;
				phandle = <0x79>;
				regulator-enable-ramp-delay = <0x108>;
				regulator-max-microvolt = <0x2f4d60>;
				regulator-min-microvolt = <0x19f0a0>;
				regulator-name = "vsim1";
			};

			ldo_vsim2 {
				linux,phandle = <0x7a>;
				phandle = <0x7a>;
				regulator-enable-ramp-delay = <0x108>;
				regulator-max-microvolt = <0x2f4d60>;
				regulator-min-microvolt = <0x19f0a0>;
				regulator-name = "vsim2";
			};

			ldo_vsram_others {
				linux,phandle = <0x71>;
				phandle = <0x71>;
				regulator-enable-ramp-delay = <0x6e>;
				regulator-max-microvolt = <0x1406f4>;
				regulator-min-microvolt = <0x7ea5e>;
				regulator-name = "vsram_others";
				regulator-ramp-delay = <0x186a>;
			};

			ldo_vsram_proc {
				linux,phandle = <0x72>;
				phandle = <0x72>;
				regulator-enable-ramp-delay = <0x6e>;
				regulator-max-microvolt = <0x1406f4>;
				regulator-min-microvolt = <0x7ea5e>;
				regulator-name = "vsram_proc";
				regulator-ramp-delay = <0x186a>;
			};

			ldo_vusb33 {
				linux,phandle = <0x7c>;
				phandle = <0x7c>;
				regulator-enable-ramp-delay = <0x108>;
				regulator-max-microvolt = <0x2f4d60>;
				regulator-min-microvolt = <0x2dc6c0>;
				regulator-name = "vusb33";
			};

			ldo_vxo22 {
				linux,phandle = <0x65>;
				phandle = <0x65>;
				regulator-enable-ramp-delay = <0x6e>;
				regulator-max-microvolt = <0x249f00>;
				regulator-min-microvolt = <0x2191c0>;
				regulator-name = "vxo22";
			};
		};

		mt635x-auxadc {
			#io-channel-cells = <0x1>;
			compatible = "mediatek,mt635x-auxadc";
			linux,phandle = <0x5e>;
			phandle = <0x5e>;

			accdet {
				channel = <0x9>;
			};

			bat_temp {
				channel = <0x3>;
				resistance-ratio = <0x1 0x1>;
			};

			batadc {
				avg-num = <0x80>;
				channel = <0x0>;
				resistance-ratio = <0x3 0x1>;
			};

			chip_temp {
				channel = <0x5>;
			};

			dcxo_temp {
				avg-num = <0x10>;
				channel = <0xd>;
			};

			hpofs_cal {
				avg-num = <0x100>;
				channel = <0xc>;
			};

			isense {
				avg-num = <0x80>;
				channel = <0x1>;
				resistance-ratio = <0x3 0x1>;
			};

			tsx_temp {
				avg-num = <0x80>;
				channel = <0xb>;
			};

			vbif {
				channel = <0xe>;
				resistance-ratio = <0x1 0x1>;
			};

			vcdt {
				channel = <0x2>;
			};

			vcore_temp {
				channel = <0x6>;
			};

			vproc_temp {
				channel = <0x7>;
			};
		};
	};

	mt6357_gauge {
		alias_name = "mt6357";
		compatible = "mediatek,mt6357_gauge";
		gauge_name = "gauge";
	};

	mt6370_pd_eint {
		linux,phandle = <0xb0>;
		phandle = <0xb0>;
	};

	mt6370_pmu_dts {
		#interrupt-cells = <0x1>;
		interrupt-controller;
		linux,phandle = <0xbf>;
		mt6370,intr_gpio = <0x20 0x3 0x0>;
		mt6370,intr_gpio_num = <0x3>;
		phandle = <0xbf>;

		bled {
			compatible = "mediatek,mt6370_pmu_bled";
			interrupt-names = "bled_ocp";
			mt,bl_ocp_level = <0x2>;
			mt,bl_ovp_level = <0x3>;
			mt,bled_flash_ramp = <0x1>;
			mt,bled_name = "mt6370_pmu_bled";
			mt,bled_ramptime = <0x3>;
			mt,chan_en = <0xf>;
			mt,map_linear;
			mt,max_bled_brightness = <0x200>;
			mt,pwm_avg_cycle = <0x0>;
			mt,pwm_deglitch = <0x1>;
			mt,pwm_fsample = <0x2>;
			mt,use_pwm;
		};

		charger {
			aicr = <0x7a120>;
			charger_name = "primary_chg";
			compatible = "mediatek,mt6370_pmu_charger";
			cv = <0x426030>;
			dc_wdt = <0x3d0900>;
			enable_te;
			enable_wdt;
			ichg = <0x1e8480>;
			ieoc = <0x249f0>;
			interrupt-names = "chg_mivr", "chg_aiclmeasi", "attachi", "ovpctrl_uvp_d_evt", "chg_wdtmri", "chg_vbusov", "chg_tmri", "chg_treg";
			ircmp_resistor = <0x61a8>;
			ircmp_vclamp = <0x7d00>;
			load_switch_name = "primary_load_switch";
			mivr = <0x432380>;
			safety_timer = <0xc>;
		};

		core {
			compatible = "mediatek,mt6370_pmu_core";
			i2cstmr_rst_tmr = <0x0>;
			int_deg = <0x0>;
			int_wdt = <0x0>;
			interrupt-names = "otp", "vdda_ovp", "vdda_uv";
			mrstb_en;
			mrstb_tmr = <0x3>;
		};

		dsv {
			compatible = "mediatek,mt6370_pmu_dsv";
			db_delay = <0x3>;
			db_ext_en = <0x0>;
			db_freq_pm = <0x0>;
			db_periodic_fix = <0x0>;
			db_periodic_mode = <0x0>;
			db_single_pin = <0x0>;
			db_startup = <0x0>;
			db_vbst = <0x1644>;
			db_vneg_20ms = <0x1>;
			db_vneg_disc = <0x0>;
			db_vneg_slew = <0x1>;
			db_vpos_20ms = <0x1>;
			db_vpos_disc = <0x1>;
			db_vpos_slew = <0x1>;
			interrupt-names = "dsv_vneg_ocp", "dsv_vpos_ocp", "dsv_bst_ocp", "dsv_vneg_scp", "dsv_vpos_scp";

			mt6370_dsvn {
				regulator-max-microvolt = <0x5b8d80>;
				regulator-min-microvolt = <0x3d0900>;
				regulator-name = "dsv_neg";
			};

			mt6370_dsvp {
				regulator-max-microvolt = <0x5b8d80>;
				regulator-min-microvolt = <0x3d0900>;
				regulator-name = "dsv_pos";
			};
		};

		ldo {
			compatible = "mediatek,mt6370_pmu_ldo";
			interrupt-names = "ldo_oc";
			ldo_oms = <0x1>;
			ldo_vrc_lt = <0x1>;

			mt6370_ldo {
				regulator-max-microvolt = <0x3d0900>;
				regulator-min-microvolt = <0x186a00>;
				regulator-name = "irtx_ldo";
			};
		};

		mt6370_pmu_fled1 {
			compatible = "mediatek,mt6370_pmu_fled1";
			fled_enable = <0x1>;
			interrupt-names = "fled_lvf", "fled2_short", "fled1_short";
			strobe_cur = <0x124f80>;
			strobe_timeout = <0x960>;
			torch_cur = <0x493e0>;
		};

		mt6370_pmu_fled2 {
			compatible = "mediatek,mt6370_pmu_fled2";
			fled_enable = <0x1>;
			strobe_cur = <0xf4240>;
			strobe_timeout = <0x4b0>;
			torch_cur = <0x30d40>;
		};

		rgbled {
			compatible = "mediatek,mt6370_pmu_rgbled";
			interrupt-names = "isink4_short", "isink3_short", "isink2_short", "isink1_short", "isink4_open", "isink3_open", "isink2_open", "isink1_open";
			mt,led_default_trigger = "cc_mode", "cc_mode", "cc_mode", "none";
			mt,led_name = "mt6370_pmu_led1", "mt6370_pmu_led2", "mt6370_pmu_led3", "mt6370_pmu_led4";
		};
	};

	mt6370_pmu_eint {
		linux,phandle = <0xaf>;
		phandle = <0xaf>;
	};

	mt_charger {
		compatible = "mediatek,mt-charger";
		linux,phandle = <0xab>;
		phandle = <0xab>;
	};

	mt_soc_anc_pcm {
		compatible = "mediatek,mt_soc_pcm_anc";
	};

	mt_soc_btcvsd_rx_pcm {
		compatible = "mediatek,mt_soc_btcvsd_rx_pcm";
	};

	mt_soc_btcvsd_tx_pcm {
		compatible = "mediatek,mt_soc_btcvsd_tx_pcm";
	};

	mt_soc_codec_dummy_name {
		compatible = "mediatek,mt_soc_codec_dummy";
	};

	mt_soc_codec_name {
		compatible = "mediatek,mt_soc_codec_63xx";
		use_hp_depop_flow = <0x0>;
		use_ul_260k = <0x0>;
	};

	mt_soc_dai_name {
		compatible = "mediatek,mt_soc_dai_stub";
	};

	mt_soc_deep_buffer_dl_pcm {
		compatible = "mediatek,mt_soc_pcm_deep_buffer_dl";
	};

	mt_soc_dl1_awb_pcm {
		compatible = "mediatek,mt_soc_pcm_dl1_awb";
	};

	mt_soc_dl1_pcm@11220000 {
		clock-names = "aud_afe_clk", "aud_dac_clk", "aud_dac_predis_clk", "aud_adc_clk", "aud_apll22m_clk", "aud_apll1_tuner_clk", "aud_tml_clk", "aud_infra_clk", "mtkaif_26m_clk", "top_mux_audio", "top_mux_audio_int", "top_sys_pll1_d4", "top_mux_aud_1", "top_apll1_ck", "top_mux_aud_eng1", "top_apll1_d8", "apmixed_apll1", "top_clk26m_clk";
		clocks = <0x40 0x0 0x40 0x4 0x40 0x5 0x40 0x3 0x40 0x1 0x40 0x2 0x40 0x6 0x27 0x2b 0x27 0x33 0x1e 0x6f 0x1e 0x70 0x1e 0x3 0x1e 0x71 0x1e 0x29 0x1e 0x72 0x1e 0x2c 0x41 0x8 0x1f>;
		compatible = "mediatek,mt_soc_pcm_dl1";
		interrupts = <0x0 0x99 0x8>;
		linux,phandle = <0x9f>;
		phandle = <0x9f>;
		reg = <0x0 0x11220000 0x0 0x1000>;
	};

	mt_soc_dl2_pcm {
		compatible = "mediatek,mt_soc_pcm_dl2";
	};

	mt_soc_dummy_pcm {
		compatible = "mediatek,mt_soc_pcm_dummy";
	};

	mt_soc_fm_i2s_awb_pcm {
		compatible = "mediatek,mt_soc_pcm_fm_i2s_awb";
	};

	mt_soc_fm_i2s_pcm {
		compatible = "mediatek,mt_soc_pcm_fm_i2s";
	};

	mt_soc_fm_mrgtx_pcm {
		compatible = "mediatek,mt_soc_pcm_fmtx";
	};

	mt_soc_hp_impedance_pcm {
		compatible = "mediatek,mt_soc_pcm_hp_impedance";
	};

	mt_soc_i2s0_awb_pcm {
		compatible = "mediatek,mt_soc_pcm_i2s0_awb";
	};

	mt_soc_i2s0_pcm {
		compatible = "mediatek,mt_soc_pcm_dl1_i2s0";
	};

	mt_soc_i2s0dl1_pcm {
		compatible = "mediatek,mt_soc_pcm_dl1_i2s0dl1";
	};

	mt_soc_mrgrx_awb_pcm {
		compatible = "mediatek,mt_soc_pcm_mrgrx_awb";
	};

	mt_soc_mrgrx_pcm {
		compatible = "mediatek,mt_soc_pcm_mrgrx";
	};

	mt_soc_pcm_dl1_scp_spk {
		compatible = "mediatek,mt_soc_pcm_dl1_scp_spk";
	};

	mt_soc_pcm_voice_scp {
		compatible = "mediatek,mt_soc_pcm_voice_scp";
	};

	mt_soc_pcm_voice_ultra {
		compatible = "mediatek,mt_soc_pcm_voice_ultra";
	};

	mt_soc_pcm_voice_usb {
		compatible = "mediatek,mt_soc_pcm_voice_usb";
	};

	mt_soc_pcm_voice_usb_echoref {
		compatible = "mediatek,mt_soc_pcm_voice_usb_echoref";
	};

	mt_soc_routing_dai_name {
		compatible = "mediatek,mt_soc_dai_routing";
	};

	mt_soc_routing_pcm {
		compatible = "mediatek,mt_soc_pcm_routing";
	};

	mt_soc_tdmrx_pcm {
		compatible = "mediatek,mt_soc_tdm_capture";
	};

	mt_soc_ul1_pcm {
		compatible = "mediatek,mt_soc_pcm_capture";
	};

	mt_soc_ul2_pcm {
		compatible = "mediatek,mt_soc_pcm_capture2";
	};

	mt_soc_uldlloopback_pcm {
		compatible = "mediatek,mt_soc_pcm_uldlloopback";
	};

	mt_soc_voice_md1 {
		compatible = "mediatek,mt_soc_pcm_voice_md1";
	};

	mt_soc_voice_md1_bt {
		compatible = "mediatek,mt_soc_pcm_voice_md1_bt";
	};

	mt_soc_voice_md2 {
		compatible = "mediatek,mt_soc_pcm_voice_md2";
	};

	mt_soc_voice_md2_bt {
		compatible = "mediatek,mt_soc_pcm_voice_md2_bt";
	};

	mt_soc_voip_bt_in {
		compatible = "mediatek,mt_soc_pcm_bt_dai";
	};

	mt_soc_voip_bt_out {
		compatible = "mediatek,mt_soc_pcm_dl1_bt";
	};

	mtkfb@0 {
		compatible = "mediatek,mtkfb";
		linux,phandle = <0xa3>;
		phandle = <0xa3>;
	};

	nfc {
		compatible = "mediatek,nfc-gpio-v2";
		gpio-irq = <0xa>;
		gpio-irq-std = <0x20 0xa 0x0>;
		gpio-rst = <0xac>;
		gpio-rst-std = <0x20 0xac 0x0>;
		linux,phandle = <0xa1>;
		phandle = <0xa1>;
	};

	nfi@11018000 {
		compatible = "mediatek,nfi";
		reg = <0x0 0x11018000 0x0 0x1000>;
	};

	nfiecc@11019000 {
		compatible = "mediatek,nfiecc";
		reg = <0x0 0x11019000 0x0 0x1000>;
	};

	odm {
		compatible = "simple-bus";
		linux,phandle = <0xb2>;
		phandle = <0xb2>;
	};

	oppo_secure_common {
		compatible = "oppo,secure_common";
		linux,phandle = <0xaa>;
		phandle = <0xaa>;
	};

	otg_iddig {
		compatible = "mediatek,usb_iddig_bi_eint";
		linux,phandle = <0x7d>;
		phandle = <0x7d>;
		pinctrl-0 = <0x21>;
		pinctrl-1 = <0x22>;
		pinctrl-names = "iddig_init", "iddig_low";
		usbid-gpio = <0x20 0x29 0x0>;
	};

	pericfg@10003000 {
		#clock-cells = <0x1>;
		compatible = "mediatek,pericfg", "syscon";
		linux,phandle = <0x58>;
		phandle = <0x58>;
		reg = <0x0 0x10003000 0x0 0x1000>;
	};

	pinctrl@1000b000 {
		#gpio-cells = <0x2>;
		#interrupt-cells = <0x4>;
		compatible = "mediatek,mt6765-pinctrl";
		gpio-controller;
		interrupt-controller;
		interrupts = <0x0 0xab 0x4>;
		linux,phandle = <0x20>;
		mediatek,pctl-regmap = <0x12 0x13 0x14 0x15 0x16 0x17 0x18 0x19>;
		phandle = <0x20>;
		pins-are-numbered;
		reg = <0x0 0x1000b000 0x0 0x1000>;

		flashlight_pins_default {
			linux,phandle = <0x4b>;
			phandle = <0x4b>;

			pins_cmd_dat0 {
				output-low;
				pinmux = <0x600>;
				slew-rate = <0x1>;
			};

			pins_cmd_dat1 {
				output-low;
				pinmux = <0x9d00>;
				slew-rate = <0x1>;
			};
		};

		flashlight_pins_srobe_off {
			linux,phandle = <0x4d>;
			phandle = <0x4d>;

			pins_cmd_dat {
				output-low;
				pinmux = <0x9d00>;
				slew-rate = <0x1>;
			};
		};

		flashlight_pins_srobe_on {
			linux,phandle = <0x4c>;
			phandle = <0x4c>;

			pins_cmd_dat {
				output-high;
				pinmux = <0x9d00>;
				slew-rate = <0x1>;
			};
		};

		flashlight_pins_torch_off {
			linux,phandle = <0x4f>;
			phandle = <0x4f>;

			pins_cmd_dat {
				output-low;
				pinmux = <0x600>;
				slew-rate = <0x1>;
			};
		};

		flashlight_pins_torch_on {
			linux,phandle = <0x4e>;
			phandle = <0x4e>;

			pins_cmd_dat {
				output-high;
				pinmux = <0x600>;
				slew-rate = <0x1>;
			};
		};

		flashlight_pins_torch_pwm {
			linux,phandle = <0x50>;
			phandle = <0x50>;

			pins_cmd_dat {
				output-low;
				pinmux = <0x603>;
				slew-rate = <0x1>;
			};
		};

		hwen_default {
			linux,phandle = <0x51>;
			phandle = <0x51>;
		};

		hwen_high {
			linux,phandle = <0x52>;
			phandle = <0x52>;

			pins_cmd_dat {
				output-high;
				pinmux = <0x9800>;
				slew-rate = <0x1>;
			};
		};

		hwen_low {
			linux,phandle = <0x53>;
			phandle = <0x53>;

			pins_cmd_dat {
				output-low;
				pinmux = <0x9800>;
				slew-rate = <0x1>;
			};
		};

		iddig_high {
			linux,phandle = <0x21>;
			phandle = <0x21>;

			pins_cmd_dat {
				bias-pull-up;
				pinmux = <0x2900>;
				slew-rate = <0x0>;
			};
		};

		iddig_low {
			linux,phandle = <0x22>;
			phandle = <0x22>;

			pins_cmd_dat {
				output-low;
				pinmux = <0x2900>;
				slew-rate = <0x1>;
			};
		};

		msdc0@default {
			linux,phandle = <0x35>;
			phandle = <0x35>;

			pins_clk {
				drive-strength = [03];
			};

			pins_cmd {
				drive-strength = [03];
			};

			pins_dat {
				drive-strength = [03];
			};

			pins_ds {
				drive-strength = [03];
			};

			pins_rst {
				drive-strength = [03];
			};
		};

		msdc0@hs200 {
			linux,phandle = <0x37>;
			phandle = <0x37>;

			pins_clk {
				drive-strength = [04];
			};

			pins_cmd {
				drive-strength = [03];
			};

			pins_dat {
				drive-strength = [04];
			};

			pins_ds {
				drive-strength = [04];
			};

			pins_rst {
				drive-strength = [03];
			};
		};

		msdc0@hs400 {
			linux,phandle = <0x36>;
			phandle = <0x36>;

			pins_clk {
				drive-strength = [04];
			};

			pins_cmd {
				drive-strength = [03];
			};

			pins_dat {
				drive-strength = [04];
			};

			pins_ds {
				drive-strength = [04];
			};

			pins_rst {
				drive-strength = [03];
			};
		};

		msdc0@register_default {
			cmd_edge = [00];
			linux,phandle = <0x38>;
			phandle = <0x38>;
			rdata_edge = [00];
			wdata_edge = [00];
		};

		msdc1@ddr50 {
			linux,phandle = <0x3d>;
			phandle = <0x3d>;

			pins_clk {
				drive-strength = [04];
			};

			pins_cmd {
				drive-strength = [03];
			};

			pins_dat {
				drive-strength = [03];
			};
		};

		msdc1@default {
			linux,phandle = <0x3a>;
			phandle = <0x3a>;

			pins_clk {
				drive-strength = [04];
			};

			pins_cmd {
				drive-strength = [03];
			};

			pins_dat {
				drive-strength = [03];
			};
		};

		msdc1@register_default {
			cmd_edge = [00];
			linux,phandle = <0x3e>;
			phandle = <0x3e>;
			rdata_edge = [00];
			wdata_edge = [00];
		};

		msdc1@sdr104 {
			linux,phandle = <0x3b>;
			phandle = <0x3b>;

			pins_clk {
				drive-strength = [04];
			};

			pins_cmd {
				drive-strength = [03];
			};

			pins_dat {
				drive-strength = [03];
			};
		};

		msdc1@sdr50 {
			linux,phandle = <0x3c>;
			phandle = <0x3c>;

			pins_clk {
				drive-strength = [04];
			};

			pins_cmd {
				drive-strength = [03];
			};

			pins_dat {
				drive-strength = [03];
			};
		};

		msdc3@default {
			linux,phandle = <0x5b>;
			phandle = <0x5b>;

			pins_clk {
				drive-strength = [04];
			};

			pins_cmd {
				drive-strength = [04];
			};

			pins_dat {
				drive-strength = [04];
			};
		};

		msdc3@register_default {
			cmd_edge = [01];
			linux,phandle = <0x5c>;
			phandle = <0x5c>;
			rdata_edge = [01];
			wdata_edge = [01];
		};
	};

	plat_sram_flag@0011db00 {
		compatible = "mediatek,plat_sram_flag";
		reg = <0x0 0x10e5f0 0x0 0x10>;
	};

	pmic_clock_buffer_ctrl {
		compatible = "mediatek,pmic_clock_buffer";
		linux,phandle = <0xb3>;
		mediatek,clkbuf-config = <0x2 0x1 0x1 0x2 0x0 0x0 0x0>;
		mediatek,clkbuf-driving-current = <0x1 0x1 0x1 0x1 0x1 0x1 0x1>;
		mediatek,clkbuf-quantity = <0x7>;
		phandle = <0xb3>;
	};

	pmu {
		compatible = "arm,armv8-pmuv3";
		interrupt-parent = <0x11>;
		interrupts = <0x1 0x7 0x8>;
	};

	psci {
		compatible = "arm,psci-1.0";
		method = "smc";
	};

	pseudo_m4u {
		compatible = "mediatek,mt-pseudo_m4u";
		iommus = <0x54 0x2>;
	};

	pseudo_m4u-larb0 {
		compatible = "mediatek,mt-pseudo_m4u-port";
		iommus = <0x54 0x0 0x54 0x1 0x54 0x2 0x54 0x3 0x54 0x4 0x54 0x5 0x54 0x6 0x54 0x7>;
		mediatek,larbid = <0x0>;
	};

	pseudo_m4u-larb1 {
		compatible = "mediatek,mt-pseudo_m4u-port";
		iommus = <0x54 0x20 0x54 0x21>;
		mediatek,larbid = <0x1>;
	};

	pseudo_m4u-larb2 {
		compatible = "mediatek,mt-pseudo_m4u-port";
		iommus = <0x54 0x40 0x54 0x41>;
		mediatek,larbid = <0x2>;
	};

	pseudo_m4u-larb3 {
		compatible = "mediatek,mt-pseudo_m4u-port";
		iommus = <0x54 0x60 0x54 0x61>;
		mediatek,larbid = <0x3>;
	};

	pwm@11006000 {
		clock-names = "PWM1-main", "PWM2-main", "PWM3-main", "PWM4-main", "PWM5-main", "PWM6-main", "PWM-HCLK-main", "PWM-main";
		clocks = <0x27 0x10 0x27 0x11 0x27 0x12 0x27 0x13 0x27 0x14 0x27 0x30 0x27 0xf 0x27 0x15>;
		compatible = "mediatek,pwm";
		interrupts = <0x0 0x4d 0x8>;
		linux,phandle = <0x93>;
		phandle = <0x93>;
		reg = <0x0 0x11006000 0x0 0x10000>;
	};

	pwrap@1000d000 {
		compatible = "mediatek,pwrap";
		interrupts = <0x0 0xb3 0x4>;
		reg = <0x0 0x1000d000 0x0 0x1000>;
	};

	radio_md_cfg {
		compatible = "mediatek,radio_md_cfg";
		linux,phandle = <0xbd>;
		phandle = <0xbd>;
	};

	reserved-memory {
		#address-cells = <0x2>;
		#size-cells = <0x2>;
		linux,phandle = <0x56>;
		phandle = <0x56>;
		ranges;

		consys-reserve-memory {
			alignment = <0x0 0x1000000>;
			alloc-ranges = <0x0 0x40000000 0x0 0x80000000>;
			compatible = "mediatek,consys-reserve-memory";
			no-map;
			size = <0x0 0x400000>;
		};

		minirdump-reserved-memory@47d70000 {
			compatible = "mediatek,minirdump";
			reg = <0x0 0x47d70000 0x0 0x10000>;
		};

		pstore-reserved-memory@47c90000 {
			compatible = "mediatek,pstore";
			reg = <0x0 0x47c90000 0x0 0xe0000>;
		};

		ram_console-reserved-memory@47c80000 {
			compatible = "mediatek,ram_console";
			reg = <0x0 0x47c80000 0x0 0x10000>;
		};

		reserve-memory-scp_share {
			alignment = <0x0 0x1000000>;
			alloc-ranges = <0x0 0x40000000 0x0 0x50000000>;
			compatible = "mediatek,reserve-memory-scp_share";
			no-map;
			size = <0x0 0x300000>;
		};

		reserve-memory-sspm_share {
			alignment = <0x0 0x10000>;
			alloc-ranges = <0x0 0x40000000 0x0 0x60000000>;
			compatible = "mediatek,reserve-memory-sspm_share";
			no-map;
			size = <0x0 0x510000>;
			status = "okay";
		};

		wifi-reserve-memory {
			alignment = <0x0 0x1000000>;
			alloc-ranges = <0x0 0x40000000 0x0 0x80000000>;
			compatible = "mediatek,wifi-reserve-memory";
			no-map;
			size = <0x0 0x300000>;
		};
	};

	rt-pd-manager {
		compatible = "mediatek,rt-pd-manager";
	};

	rt9465_slave_chr {
		compatible = "richtek,rt9465";
		linux,phandle = <0xae>;
		phandle = <0xae>;
		status = "disabled";
	};

	scp@10500000 {
		compatible = "mediatek,scp";
		core_1 = "enable";
		interrupts = <0x0 0xc0 0x4>;
		reg = <0x0 0x10500000 0x0 0x40000 0x0 0x105c0000 0x0 0x3000 0x0 0x105c4000 0x0 0x1000 0x0 0x105d4000 0x0 0x6000>;
		scp_sramSize = <0x40000>;
		status = "okay";
	};

	scp_dvfs {
		clock-names = "clk_mux", "clk_pll_0", "clk_pll_1", "clk_pll_2", "clk_pll_3", "clk_pll_4", "clk_pll_5", "clk_pll_6";
		clocks = <0x1e 0x63 0x1f 0x1e 0xe 0x1e 0x1a 0x1e 0x2 0x1e 0x17 0x1e 0x6 0x1e 0x19>;
		compatible = "mediatek,scp_dvfs";
	};

	scpsys@10001000 {
		#clock-cells = <0x1>;
		compatible = "mediatek,scpsys", "syscon";
		linux,phandle = <0x28>;
		phandle = <0x28>;
		reg = <0x0 0x10001000 0x0 0x1000 0x0 0x10006000 0x0 0x1000 0x0 0x14002000 0x0 0x1000 0x0 0x1020e000 0x0 0x1000 0x0 0x18004000 0x0 0x1000 0x0 0x18002000 0x0 0x1000>;
	};

	security_ao@1001a000 {
		compatible = "mediatek,security_ao";
		reg = <0x0 0x1001a000 0x0 0x1000>;
	};

	seninf1@1a040000 {
		compatible = "mediatek,seninf1";
		reg = <0x0 0x1a040000 0x0 0x1000>;
	};

	seninf2@1a041000 {
		compatible = "mediatek,seninf2";
		reg = <0x0 0x1a041000 0x0 0x1000>;
	};

	seninf3@1a042000 {
		compatible = "mediatek,seninf3";
		reg = <0x0 0x1a042000 0x0 0x1000>;
	};

	seninf4@1a043000 {
		compatible = "mediatek,seninf4";
		reg = <0x0 0x1a043000 0x0 0x1000>;
	};

	serial@11020000 {
		clock-names = "baud", "bus";
		clocks = <0x1f 0x27 0x16>;
		compatible = "mediatek,mt6758-uart", "mediatek,mt6577-uart";
		dma-names = "tx", "rx";
		dmas = <0x34 0x0 0x34 0x1>;
		interrupts = <0x0 0x5b 0x8>;
		linux,phandle = <0x87>;
		phandle = <0x87>;
		reg = <0x0 0x11002000 0x0 0x1000>;
	};

	serial@11030000 {
		clock-names = "baud", "bus";
		clocks = <0x1f 0x27 0x17>;
		compatible = "mediatek,mt6758-uart", "mediatek,mt6577-uart";
		interrupts = <0x0 0x5c 0x8>;
		linux,phandle = <0x88>;
		phandle = <0x88>;
		reg = <0x0 0x11003000 0x0 0x1000>;
	};

	silead_fp {
		compatible = "mediatek,silead_fp", "mediatek,egis_fp";
		linux,phandle = <0x82>;
		phandle = <0x82>;
	};

	sleep@10006000 {
		compatible = "mediatek,sleep";
		interrupts = <0x0 0xb5 0x8>;
		reg = <0x0 0x10006000 0x0 0x1000>;
		wakeup-source = <0x1a 0x0 0x4 0x1b 0x1 0x20 0x1c 0x3 0x2000000>;
	};

	sleep_reg_md@1000f000 {
		compatible = "mediatek,sleep_reg_md";
		reg = <0x0 0x1000f000 0x0 0x1000>;
	};

	smart_pa {
		linux,phandle = <0xb7>;
		phandle = <0xb7>;
	};

	smi_common@14002000 {
		clock-names = "mtcmos-mm", "smi-common-gals-comm0", "smi-common-gals-comm1", "smi-common", "mmdvfs_clk_mm_sel_ck", "mmdvfs_clk_mmpll_ck", "mmdvfs_clk_univpll1_d2_ck", "mmdvfs_clk_mmpll_d2_ck";
		clocks = <0x28 0x3 0x29 0x15 0x29 0x16 0x29 0x13 0x1e 0x62 0x1e 0x21 0x1e 0x17 0x1e 0x22>;
		compatible = "mediatek,smi_common";
		larbs = <0x23 0x24 0x25 0x26>;
		mmsys_config = <0x29>;
		nr_larbs = <0x4>;
		reg = <0x0 0x14002000 0x0 0x1000>;
	};

	smi_larb0@14003000 {
		cell-index = <0x0>;
		clock-names = "mtcmos-mm", "mm-larb0";
		clocks = <0x28 0x3 0x29 0x14>;
		compatible = "mediatek,smi_larb0", "mediatek,smi_larb";
		linux,phandle = <0x23>;
		phandle = <0x23>;
		reg = <0x0 0x14003000 0x0 0x1000>;
	};

	smi_larb1@17010000 {
		cell-index = <0x1>;
		clock-names = "mtcmos-vcodec", "venc-larb1";
		clocks = <0x28 0xa 0x44 0x1>;
		compatible = "mediatek,smi_larb1", "mediatek,smi_larb";
		linux,phandle = <0x24>;
		phandle = <0x24>;
		reg = <0x0 0x17010000 0x0 0x1000>;
	};

	smi_larb2@15021000 {
		cell-index = <0x2>;
		clock-names = "mtcmos-isp", "gals-img2mm", "img-larb2";
		clocks = <0x28 0x5 0x29 0x18 0x42 0x0>;
		compatible = "mediatek,smi_larb2", "mediatek,smi_larb";
		linux,phandle = <0x25>;
		phandle = <0x25>;
		reg = <0x0 0x15021000 0x0 0x1000>;
	};

	smi_larb3@1a002000 {
		cell-index = <0x3>;
		clock-names = "mtcmos-cam", "gals-cam2mm", "cam-larb3";
		clocks = <0x28 0x9 0x29 0x19 0x43 0x0>;
		compatible = "mediatek,smi_larb3", "mediatek,smi_larb";
		linux,phandle = <0x26>;
		phandle = <0x26>;
		reg = <0x0 0x1a002000 0x0 0x1000>;
	};

	spi@1100a000 {
		clock-names = "parent-clk", "sel-clk", "spi-clk";
		clocks = <0x1e 0xb 0x1e 0x6b 0x27 0x1b>;
		compatible = "mediatek,mt6765-spi";
		interrupts = <0x0 0x76 0x8>;
		linux,phandle = <0x94>;
		mediatek,pad-select = <0x0>;
		phandle = <0x94>;
		reg = <0x0 0x1100a000 0x0 0x1000>;
	};

	spi@11010000 {
		clock-names = "parent-clk", "sel-clk", "spi-clk";
		clocks = <0x1e 0xb 0x1e 0x6b 0x27 0x34>;
		compatible = "mediatek,mt6765-spi";
		interrupts = <0x0 0x7a 0x8>;
		linux,phandle = <0x95>;
		mediatek,pad-select = <0x0>;
		phandle = <0x95>;
		reg = <0x0 0x11010000 0x0 0x1000>;
	};

	spi@11012000 {
		clock-names = "parent-clk", "sel-clk", "spi-clk";
		clocks = <0x1e 0xb 0x1e 0x6b 0x27 0x37>;
		compatible = "mediatek,mt6765-spi";
		interrupts = <0x0 0x80 0x8>;
		linux,phandle = <0x96>;
		mediatek,pad-select = <0x0>;
		phandle = <0x96>;
		reg = <0x0 0x11012000 0x0 0x1000>;
	};

	spi@11013000 {
		clock-names = "parent-clk", "sel-clk", "spi-clk";
		clocks = <0x1e 0xb 0x1e 0x6b 0x27 0x38>;
		compatible = "mediatek,mt6765-spi";
		interrupts = <0x0 0x81 0x8>;
		linux,phandle = <0x97>;
		mediatek,pad-select = <0x0>;
		phandle = <0x97>;
		reg = <0x0 0x11013000 0x0 0x1000>;
	};

	spi@11014000 {
		clock-names = "parent-clk", "sel-clk", "spi-clk";
		clocks = <0x1e 0xb 0x1e 0x6b 0x27 0x41>;
		compatible = "mediatek,mt6765-spi";
		interrupts = <0x0 0x5f 0x8>;
		linux,phandle = <0x98>;
		mediatek,pad-select = <0x0>;
		phandle = <0x98>;
		reg = <0x0 0x11014000 0x0 0x1000>;
	};

	spi@11015000 {
		clock-names = "parent-clk", "sel-clk", "spi-clk";
		clocks = <0x1e 0xb 0x1e 0x6b 0x27 0x42>;
		compatible = "mediatek,mt6765-spi";
		interrupts = <0x0 0x60 0x8>;
		linux,phandle = <0x99>;
		mediatek,pad-select = <0x0>;
		phandle = <0x99>;
		reg = <0x0 0x11015000 0x0 0x1000>;
	};

	sramrom@10214000 {
		compatible = "mediatek,sramrom";
		reg = <0x0 0x10214000 0x0 0x1000>;
	};

	sspm@10440000 {
		compatible = "mediatek,sspm";
		interrupt-names = "ipc", "mbox0", "mbox1", "mbox2", "mbox3", "mbox4";
		interrupts = <0x0 0xca 0x4 0x0 0xcd 0x4 0x0 0xce 0x4 0x0 0xcf 0x4 0x0 0xd0 0x4 0x0 0xd1 0x4>;
		reg = <0x0 0x10440000 0x0 0x10000 0x0 0x10450000 0x0 0x100 0x0 0x10451000 0x0 0x8 0x0 0x10460000 0x0 0x100 0x0 0x10461000 0x0 0x8 0x0 0x10470000 0x0 0x100 0x0 0x10471000 0x0 0x8 0x0 0x10480000 0x0 0x100 0x0 0x10481000 0x0 0x8 0x0 0x10490000 0x0 0x100 0x0 0x10491000 0x0 0x8>;
		reg-names = "cfgreg", "mbox0_base", "mbox0_ctrl", "mbox1_base", "mbox1_ctrl", "mbox2_base", "mbox2_ctrl", "mbox3_base", "mbox3_ctrl", "mbox4_base", "mbox4_ctrl";
	};

	swtp {
		linux,phandle = <0x89>;
		phandle = <0x89>;
	};

	swtp_1 {
		linux,phandle = <0x8a>;
		phandle = <0x8a>;
	};

	sys_cirq@10204000 {
		compatible = "mediatek,sys_cirq";
		interrupts = <0x0 0x118 0x8>;
		mediatek,cirq_num = <0xd1>;
		mediatek,spi_start_offset = <0x48>;
		reg = <0x0 0x10204000 0x0 0x1000>;
	};

	sys_timer@10017000 {
		compatible = "mediatek,sys_timer";
		interrupts = <0x0 0xc2 0x4>;
		reg = <0x0 0x10017000 0x0 0x1000>;
		reg-names = "sys_timer_base";
	};

	syscfg_pctl_0@10005000 {
		compatible = "mediatek,mt6765-pctl-0-syscfg", "syscon";
		linux,phandle = <0x12>;
		phandle = <0x12>;
		reg = <0x0 0x10005000 0x0 0x1000>;
	};

	syscfg_pctl_1@0x10002000 {
		compatible = "mediatek,mt6765-pctl-1-syscfg", "syscon";
		linux,phandle = <0x13>;
		phandle = <0x13>;
		reg = <0x0 0x10002000 0x0 0x1000>;
	};

	syscfg_pctl_2@0x10002200 {
		compatible = "mediatek,mt6765-pctl-2-syscfg", "syscon";
		linux,phandle = <0x14>;
		phandle = <0x14>;
		reg = <0x0 0x10002200 0x0 0x1000>;
	};

	syscfg_pctl_3@0x10002400 {
		compatible = "mediatek,mt6765-pctl-3-syscfg", "syscon";
		linux,phandle = <0x15>;
		phandle = <0x15>;
		reg = <0x0 0x10002400 0x0 0x1000>;
	};

	syscfg_pctl_4@0x10002600 {
		compatible = "mediatek,mt6765-pctl-4-syscfg", "syscon";
		linux,phandle = <0x16>;
		phandle = <0x16>;
		reg = <0x0 0x10002600 0x0 0x1000>;
	};

	syscfg_pctl_5@0x10002800 {
		compatible = "mediatek,mt6765-pctl-5-syscfg", "syscon";
		linux,phandle = <0x17>;
		phandle = <0x17>;
		reg = <0x0 0x10002800 0x0 0x1000>;
	};

	syscfg_pctl_6@0x10002a00 {
		compatible = "mediatek,mt6765-pctl-6-syscfg", "syscon";
		linux,phandle = <0x18>;
		phandle = <0x18>;
		reg = <0x0 0x10002a00 0x0 0x1000>;
	};

	syscfg_pctl_7@0x10002c00 {
		compatible = "mediatek,mt6765-pctl-7-syscfg", "syscon";
		linux,phandle = <0x19>;
		phandle = <0x19>;
		reg = <0x0 0x10002c00 0x0 0x1000>;
	};

	therm_ctrl@1100b000 {
		clock-names = "therm-main";
		clocks = <0x27 0xa>;
		compatible = "mediatek,therm_ctrl";
		interrupts = <0x0 0x4e 0x8>;
		reg = <0x0 0x1100b000 0x0 0x1000>;
	};

	timer {
		clock-frequency = <0xc65d40>;
		compatible = "arm,armv8-timer";
		interrupt-parent = <0x11>;
		interrupts = <0x1 0xd 0x8 0x1 0xe 0x8 0x1 0xb 0x8 0x1 0xa 0x8>;
	};

	tkcore {
		compatible = "trustkernel,tkcore";
		interrupts = <0x0 0xf8 0x1>;
	};

	topckgen@10000000 {
		#clock-cells = <0x1>;
		compatible = "mediatek,topckgen", "syscon";
		linux,phandle = <0x1e>;
		phandle = <0x1e>;
		reg = <0x0 0x10000000 0x0 0x1000>;
	};

	topckgen_ao@1001b000 {
		compatible = "mediatek,topckgen_ao";
		reg = <0x0 0x1001b000 0x0 0x1000>;
	};

	topmisc@10011000 {
		compatible = "mediatek,topmisc";
		reg = <0x0 0x10011000 0x0 0x1000>;
	};

	toprgu@10007000 {
		compatible = "mediatek,mt6765-toprgu";
		interrupts = <0x0 0x8b 0x0>;
		reg = <0x0 0x10007000 0x0 0x1000>;
	};

	touch {
		compatible = "mediatek,touch";
		linux,phandle = <0x7f>;
		phandle = <0x7f>;
	};

	trng@1020f000 {
		compatible = "mediatek,trng";
		interrupts = <0x0 0xa1 0x8>;
		reg = <0x0 0x1020f000 0x0 0x1000>;
	};

	type_c_port0 {
		linux,phandle = <0xc0>;
		mt-tcpc,name = "type_c_port0";
		mt-tcpc,role_def = <0x4>;
		mt-tcpc,rp_level = <0x0>;
		mt-tcpc,vconn_supply = <0x1>;
		mt6370pd,intr_gpio = <0x20 0x18 0x0>;
		mt6370pd,intr_gpio_num = <0x18>;
		phandle = <0xc0>;
		tcpc-dual,supported_modes = <0x0>;

		dpm_caps {
			attemp_discover_cable;
			attemp_discover_id;
			attemp_enter_dp_mode;
			dr_check = <0x0>;
			local_dr_data;
			local_dr_power;
			local_no_suspend;
			local_usb_comm;
			local_vconn_supply;
			pr_check = <0x0>;
			pr_check_gp_source;
		};

		pd-data {
			bat,nr = <0x1>;
			pd,charging_policy = <0x21>;
			pd,country_nr = <0x0>;
			pd,id-vdo-data = <0xd10029cf 0x0 0x10000>;
			pd,id-vdo-size = <0x3>;
			pd,mfrs = "RichtekTCPC";
			pd,pid = <0x5081>;
			pd,sink-pdo-data = <0x190c8 0xc0761e3c>;
			pd,sink-pdo-size = <0x2>;
			pd,source-cap-ext = <0x171129cf 0x0 0x102 0x0 0x0 0x2000000>;
			pd,source-pdo-data = <0x19032>;
			pd,source-pdo-size = <0x1>;
			pd,vid = <0x29cf>;

			bat-info0 {
				bat,design_cap = <0xbb8>;
				bat,mfrs = "bat1";
				bat,pid = <0x1711>;
				bat,vid = <0x29cf>;
			};
		};
	};

	usb0@11200000 {
		clock-names = "usb0", "usb0_clk_top_sel", "usb0_clk_univpll3_d4";
		clocks = <0x27 0x8 0x1e 0x76 0x1e 0x20>;
		compatible = "mediatek,mt6765-usb20";
		interrupts = <0x0 0x49 0x8>;
		mode = <0x2>;
		multipoint = <0x1>;
		num_eps = <0x10>;
		reg = <0x0 0x11200000 0x0 0x10000 0x0 0x11cc0000 0x0 0x10000>;
	};

	usb1p_sif@11210000 {
		compatible = "mediatek,usb1p_sif";
		reg = <0x0 0x11210000 0x0 0x10000>;
	};

	usb_sif@11210000 {
		compatible = "mediatek,usb_sif";
		reg = <0x0 0x11210000 0x0 0x10000>;
	};

	utos {
		compatible = "microtrust,utos";
		interrupts = <0x0 0xf9 0x1 0x0 0xfa 0x1>;
	};

	utos_tester {
		compatible = "microtrust,tester-v1";
	};

	vdec@17040000 {
		compatible = "mediatek,vdec";
		interrupts = <0x0 0xe9 0x8>;
		reg = <0x0 0x17040000 0x0 0x10000>;
	};

	venc@17020000 {
		compatible = "mediatek,venc";
		interrupts = <0x0 0xe6 0x8>;
		reg = <0x0 0x17020000 0x0 0x10000>;
	};

	venc_gcon@17000000 {
		#clock-cells = <0x1>;
		clock-names = "MT_SCP_SYS_DIS", "MT_SCP_SYS_VCODEC", "MT_CG_MM_SMI_COMM0", "MT_CG_MM_SMI_COMM1", "MT_CG_MM_SMI_COMMON", "MT_CG_VDEC", "MT_CG_VENC";
		clocks = <0x28 0x3 0x28 0xa 0x29 0x15 0x29 0x16 0x29 0x13 0x44 0x3 0x44 0x1>;
		compatible = "mediatek,venc_gcon", "syscon";
		linux,phandle = <0x44>;
		phandle = <0x44>;
		reg = <0x0 0x17000000 0x0 0x10000>;
	};

	venc_jpg@17030000 {
		clock-names = "MT_CG_VENC_JPGENC";
		clocks = <0x44 0x2>;
		compatible = "mediatek,venc_jpg";
		interrupts = <0x0 0xe8 0x8>;
		reg = <0x0 0x17030000 0x0 0x10000>;
	};

	wifi@18000000 {
		compatible = "mediatek,wifi";
		interrupts = <0x0 0x10c 0x8>;
		reg = <0x0 0x18000000 0x0 0x100000>;
	};
};
