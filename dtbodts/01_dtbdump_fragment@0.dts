/dts-v1/;

/ {

	__fixups__ {
		accdet = "/fragment@17:target:0";
		alsps_mtk = "/fragment@52:target:0";
		audgpio = "/fragment@25:target:0";
		auxadc = "/fragment@35:target:0";
		bat_gm30 = "/fragment@22:target:0";
		charger = "/fragment@29:target:0";
		chosen = "/fragment@0:target:0";
		chr_stat = "/fragment@54:target:0";
		consys = "/fragment@16:target:0";
		dsi_te = "/fragment@56:target:0";
		gpio = "/fragment@48:target:0";
		gpio_usage_mapping = "/fragment@47:target:0";
		gse_1 = "/fragment@55:target:0";
		i2c0 = "/fragment@37:target:0";
		i2c1 = "/fragment@38:target:0";
		i2c2 = "/fragment@39:target:0";
		i2c3 = "/fragment@2:target:0", "/fragment@31:target:0", "/fragment@40:target:0";
		i2c4 = "/fragment@41:target:0";
		i2c5 = "/fragment@30:target:0", "/fragment@42:target:0";
		i2c6 = "/fragment@3:target:0", "/fragment@43:target:0";
		i2c7 = "/fragment@44:target:0";
		i2c8 = "/fragment@45:target:0";
		i2c9 = "/fragment@46:target:0";
		irtx_pwm = "/fragment@23:target:0";
		kd_camera_hw1 = "/fragment@33:target:0", "/fragment@68:target:0";
		keypad = "/fragment@4:target:0", "/fragment@70:target:0";
		lcm = "/fragment@6:target:0";
		main_pmic = "/fragment@58:target:0";
		md1_sim1_hot_plug_eint = "/fragment@60:target:0";
		md1_sim2_hot_plug_eint = "/fragment@61:target:0";
		mrdump_ext_rst = "/fragment@51:target:0";
		msdc1_ins = "/fragment@50:target:0";
		mt6370_pmu = "/fragment@27:target:0";
		mt6370_typec = "/fragment@28:target:0";
		mt_pmic_vcama_ldo_reg = "/fragment@62:target:0", "/fragment@68/__overlay__:vcama_main2-supply:0";
		mt_pmic_vcamd_ldo_reg = "/fragment@65:target:0", "/fragment@68/__overlay__:vcamd-supply:0", "/fragment@68/__overlay__:vcamd_sub-supply:0";
		mt_pmic_vcamio_ldo_reg = "/fragment@66:target:0", "/fragment@68/__overlay__:vcamio-supply:0", "/fragment@68/__overlay__:vcamio_sub-supply:0", "/fragment@68/__overlay__:vcamio_main2-supply:0";
		mt_pmic_vldo28_ldo_reg = "/fragment@67:target:0", "/fragment@68/__overlay__:vcamaf-supply:0";
		mt_pmic_vmch_ldo_reg = "/fragment@19/__overlay__/silead_fp@0:vmch-supply:0";
		mt_pmic_vsim1_ldo_reg = "/fragment@63:target:0";
		mt_pmic_vsim2_ldo_reg = "/fragment@64:target:0";
		mtkfb = "/fragment@9:target:0";
		odm = "/fragment@1:target:0";
		otg_iddig = "/fragment@59:target:0";
		pio = "/fragment@1/__overlay__/kpd_volume_up:interrupt-parent:0", "/fragment@1/__overlay__/kpd_volume_down:interrupt-parent:0", "/fragment@4/__overlay__:keypad,volume-up:0", "/fragment@4/__overlay__:keypad,volume-down:0", "/fragment@5:target:0", "/fragment@7:target:0", "/fragment@8:target:0", "/fragment@10/__overlay__/ilitek@0:reset-gpio:0", "/fragment@10/__overlay__/ilitek@0:interrupt-parent:0", "/fragment@10/__overlay__/ilitek@0:irq-gpio:0", "/fragment@12:target:0", "/fragment@14:target:0", "/fragment@15:target:0", "/fragment@18:target:0", "/fragment@21:target:0", "/fragment@24:target:0", "/fragment@25/__overlay__:gpio_audio_pa_ctrl:0", "/fragment@26:target:0", "/fragment@27/__overlay__:mt6370,intr_gpio:0", "/fragment@28/__overlay__:mt6370pd,intr_gpio:0", "/fragment@30/__overlay__/subpmic_pmu@34:sm5414,intr_gpio:0", "/fragment@31/__overlay__/rt9465@4b:rt,en_gpio:0", "/fragment@31/__overlay__/rt9465@4b:rt,intr_gpio:0", "/fragment@32:target:0", "/fragment@33/__overlay__:camera-main-af-en:0", "/fragment@47/__overlay__:GPIO_SIM2_SIO:0", "/fragment@47/__overlay__:GPIO_SIM2_SRST:0", "/fragment@47/__overlay__:GPIO_SIM2_SCLK:0", "/fragment@47/__overlay__:GPIO_SIM1_SCLK:0", "/fragment@47/__overlay__:GPIO_SIM1_SRST:0", "/fragment@47/__overlay__:GPIO_SIM1_SIO:0", "/fragment@47/__overlay__:GPIO_SIM2_HOT_PLUG:0", "/fragment@47/__overlay__:GPIO_SIM1_HOT_PLUG:0", "/fragment@47/__overlay__:GPIO_FDD_BAND_SUPPORT_DETECT_3RD_PIN:0", "/fragment@47/__overlay__:GPIO_FDD_BAND_SUPPORT_DETECT_2ND_PIN:0", "/fragment@47/__overlay__:GPIO_FDD_BAND_SUPPORT_DETECT_1ST_PIN:0", "/fragment@49/__overlay__:interrupt-parent:0", "/fragment@50/__overlay__:interrupt-parent:0", "/fragment@51/__overlay__:interrupt-parent:0", "/fragment@51/__overlay__:deb-gpios:0", "/fragment@52/__overlay__:interrupt-parent:0", "/fragment@53/__overlay__:interrupt-parent:0", "/fragment@54/__overlay__:interrupt-parent:0", "/fragment@55/__overlay__:interrupt-parent:0", "/fragment@56/__overlay__:interrupt-parent:0", "/fragment@57/__overlay__:interrupt-parent:0", "/fragment@57/__overlay__:deb-gpios:0", "/fragment@58/__overlay__:interrupt-parent:0", "/fragment@59/__overlay__:interrupt-parent:0";
		pmic_clock_buffer_ctrl = "/fragment@36:target:0";
		silead_fp = "/fragment@20:target:0", "/fragment@53:target:0";
		spi1 = "/fragment@19:target:0";
		spi3 = "/fragment@10:target:0";
		swtp = "/fragment@34:target:0", "/fragment@57:target:0";
		touch = "/fragment@11:target:0", "/fragment@49:target:0", "/fragment@69:target:0";
		uart0 = "/fragment@13:target:0";
	};

	__local_fixups__ {

		fragment@10 {

			__overlay__ {

				ilitek@0 {
					pinctrl-0 = <0x0>;
					pinctrl-1 = <0x0>;
					pinctrl-2 = <0x0>;
					pinctrl-3 = <0x0>;
					pinctrl-4 = <0x0>;
					pinctrl-5 = <0x0>;
				};
			};
		};

		fragment@11 {

			__overlay__ {
				pinctrl-0 = <0x0>;
				pinctrl-1 = <0x0>;
				pinctrl-2 = <0x0>;
				pinctrl-3 = <0x0>;
				pinctrl-4 = <0x0>;
				pinctrl-5 = <0x0>;
			};
		};

		fragment@13 {

			__overlay__ {
				pinctrl-0 = <0x0>;
				pinctrl-1 = <0x0>;
				pinctrl-2 = <0x0>;
				pinctrl-3 = <0x0>;
				pinctrl-4 = <0x0>;
			};
		};

		fragment@16 {

			__overlay__ {
				pinctrl-0 = <0x0>;
				pinctrl-1 = <0x0>;
				pinctrl-2 = <0x0>;
				pinctrl-3 = <0x0>;
			};
		};

		fragment@17 {

			__overlay__ {
				pinctrl-0 = <0x0>;
				pinctrl-1 = <0x0>;
			};
		};

		fragment@20 {

			__overlay__ {
				pinctrl-0 = <0x0>;
				pinctrl-1 = <0x0>;
				pinctrl-2 = <0x0>;
			};
		};

		fragment@23 {

			__overlay__ {
				pinctrl-0 = <0x0>;
				pinctrl-1 = <0x0>;
			};
		};

		fragment@25 {

			__overlay__ {
				pinctrl-0 = <0x0>;
				pinctrl-1 = <0x0>;
				pinctrl-2 = <0x0>;
				pinctrl-3 = <0x0>;
				pinctrl-4 = <0x0>;
				pinctrl-5 = <0x0>;
				pinctrl-6 = <0x0>;
				pinctrl-7 = <0x0>;
				pinctrl-8 = <0x0>;
				pinctrl-9 = <0x0>;
			};
		};

		fragment@33 {

			__overlay__ {
				pinctrl-0 = <0x0>;
				pinctrl-1 = <0x0>;
				pinctrl-10 = <0x0>;
				pinctrl-11 = <0x0>;
				pinctrl-12 = <0x0>;
				pinctrl-13 = <0x0>;
				pinctrl-14 = <0x0>;
				pinctrl-15 = <0x0>;
				pinctrl-16 = <0x0>;
				pinctrl-17 = <0x0>;
				pinctrl-18 = <0x0>;
				pinctrl-19 = <0x0>;
				pinctrl-2 = <0x0>;
				pinctrl-20 = <0x0>;
				pinctrl-3 = <0x0>;
				pinctrl-4 = <0x0>;
				pinctrl-5 = <0x0>;
				pinctrl-6 = <0x0>;
				pinctrl-7 = <0x0>;
				pinctrl-8 = <0x0>;
				pinctrl-9 = <0x0>;
			};
		};

		fragment@4 {

			__overlay__ {
				pinctrl-0 = <0x0>;
				pinctrl-1 = <0x0>;
			};
		};

		fragment@6 {

			__overlay__ {
				pinctrl-0 = <0x0>;
				pinctrl-1 = <0x0>;
				pinctrl-2 = <0x0>;
				pinctrl-3 = <0x0>;
				pinctrl-4 = <0x0>;
			};
		};

		fragment@9 {

			__overlay__ {
				pinctrl-0 = <0x0>;
				pinctrl-1 = <0x0>;
			};
		};
	};

	__symbols__ {
		accdet_pins_default = "/fragment@18/__overlay__/accdetdefault";
		accdet_pins_eint_as_int = "/fragment@18/__overlay__/accdeteint@0";
		aud_clk_miso_off = "/fragment@26/__overlay__/aud_clk_miso_off";
		aud_clk_miso_on = "/fragment@26/__overlay__/aud_clk_miso_on";
		aud_clk_mosi_off = "/fragment@26/__overlay__/aud_clk_mosi_off";
		aud_clk_mosi_on = "/fragment@26/__overlay__/aud_clk_mosi_on";
		aud_dat_miso_off = "/fragment@26/__overlay__/aud_dat_miso_off";
		aud_dat_miso_on = "/fragment@26/__overlay__/aud_dat_miso_on";
		aud_dat_mosi_off = "/fragment@26/__overlay__/aud_dat_mosi_off";
		aud_dat_mosi_on = "/fragment@26/__overlay__/aud_dat_mosi_on";
		aud_pins_extamp_pullhigh = "/fragment@26/__overlay__/aud_pins_extamp_pullhigh";
		aud_pins_extamp_pulllow = "/fragment@26/__overlay__/aud_pins_extamp_pulllow";
		camera_main_af_mtk = "/fragment@39/__overlay__/camera_main_af@0c";
		camera_main_eeprom_mtk = "/fragment@39/__overlay__/camera_main_eeprom@50";
		camera_main_mtk = "/fragment@39/__overlay__/camera_main@20";
		camera_main_two_af_mtk = "/fragment@41/__overlay__/camera_main_two_af@0c";
		camera_main_two_eeprom_mtk = "/fragment@41/__overlay__/camera_main_two_eeprom@50";
		camera_main_two_mtk = "/fragment@41/__overlay__/camera_main_two@7a";
		camera_pins_cam0_mclk_off = "/fragment@32/__overlay__/camera_pins_cam0_mclk_off";
		camera_pins_cam0_mclk_on = "/fragment@32/__overlay__/camera_pins_cam0_mclk_on";
		camera_pins_cam0_rst0 = "/fragment@32/__overlay__/cam0@0";
		camera_pins_cam0_rst1 = "/fragment@32/__overlay__/cam0@1";
		camera_pins_cam1_mclk_off = "/fragment@32/__overlay__/camera_pins_cam1_mclk_off";
		camera_pins_cam1_mclk_on = "/fragment@32/__overlay__/camera_pins_cam1_mclk_on";
		camera_pins_cam1_pnd0 = "/fragment@32/__overlay__/cam1@2";
		camera_pins_cam1_pnd1 = "/fragment@32/__overlay__/cam1@3";
		camera_pins_cam1_rst0 = "/fragment@32/__overlay__/cam1@0";
		camera_pins_cam1_rst1 = "/fragment@32/__overlay__/cam1@1";
		camera_pins_cam2_mclk_off = "/fragment@32/__overlay__/camera_pins_cam2_mclk_off";
		camera_pins_cam2_mclk_on = "/fragment@32/__overlay__/camera_pins_cam2_mclk_on";
		camera_pins_cam2_pnd0 = "/fragment@32/__overlay__/cam2@2";
		camera_pins_cam2_pnd1 = "/fragment@32/__overlay__/cam2@3";
		camera_pins_cam2_rst0 = "/fragment@32/__overlay__/cam2@0";
		camera_pins_cam2_rst1 = "/fragment@32/__overlay__/cam2@1";
		camera_pins_cam_ldo_rear_vcama_0 = "/fragment@32/__overlay__/cam0@vcama0";
		camera_pins_cam_ldo_rear_vcama_1 = "/fragment@32/__overlay__/cam0@vcama1";
		camera_pins_cam_ldo_sub_vcama_0 = "/fragment@32/__overlay__/cam1@vcama0";
		camera_pins_cam_ldo_sub_vcama_1 = "/fragment@32/__overlay__/cam1@vcama1";
		camera_pins_default = "/fragment@32/__overlay__/camdefault";
		camera_sub_eeprom_mtk = "/fragment@41/__overlay__/camera_sub_eeprom@54";
		camera_sub_mtk = "/fragment@41/__overlay__/camera_sub@2d";
		camera_sub_two_eeprom_mtk = "/fragment@41/__overlay__/camera_sub_two_eeprom@a4";
		camera_sub_two_mtk = "/fragment@41/__overlay__/camera_sub_two@6e";
		ccu_sensor_i2c_main2_hw_mtk = "/fragment@41/__overlay__/ccu_sensor_i2c_main2_hw@10";
		ccu_sensor_i2c_main_hw_mtk = "/fragment@39/__overlay__/ccu_sensor_i2c_main_hw@35";
		ccu_sensor_i2c_sub_hw_mtk = "/fragment@41/__overlay__/ccu_sensor_i2c_sub_hw@11";
		consys_pins_default = "/fragment@15/__overlay__/consys_default";
		ctp_pins_default = "/fragment@12/__overlay__/eint0default";
		ctp_pins_eint_as_int = "/fragment@12/__overlay__/eint@0";
		ctp_pins_eint_output0 = "/fragment@12/__overlay__/eintoutput0";
		ctp_pins_eint_output1 = "/fragment@12/__overlay__/eintoutput1";
		ctp_pins_rst_output0 = "/fragment@12/__overlay__/rstoutput0";
		ctp_pins_rst_output1 = "/fragment@12/__overlay__/rstoutput1";
		ext_buck_lp4_mtk = "/fragment@40/__overlay__/ext_buck_lp4@57";
		ext_buck_lp4x_mtk = "/fragment@40/__overlay__/ext_buck_lp4x@50";
		ext_buck_vgpu_mtk = "/fragment@43/__overlay__/ext_buck_vgpu@55";
		fingerprint_default = "/fragment@21/__overlay__/state_default";
		fingerprint_reset_high = "/fragment@21/__overlay__/state_reset_high";
		fingerprint_reset_low = "/fragment@21/__overlay__/state_reset_low";
		gpslna_pins_init = "/fragment@15/__overlay__/gpslna@0";
		gpslna_pins_oh = "/fragment@15/__overlay__/gpslna@1";
		gpslna_pins_ol = "/fragment@15/__overlay__/gpslna@2";
		irtx_gpio_led_default = "/fragment@24/__overlay__/irtx_gpio_led_def@gpio90";
		irtx_gpio_led_set = "/fragment@24/__overlay__/irtx_gpio_led_set@gpio90";
		kpd_volume_down = "/fragment@1/__overlay__/kpd_volume_down";
		kpd_volume_up = "/fragment@1/__overlay__/kpd_volume_up";
		lcm_pins_bais_N_output0 = "/fragment@7/__overlay__/bais_N_output0";
		lcm_pins_bais_N_output1 = "/fragment@7/__overlay__/bais_N_output1";
		lcm_pins_bais_P_output0 = "/fragment@7/__overlay__/bais_P_output0";
		lcm_pins_bais_P_output1 = "/fragment@7/__overlay__/bais_P_output1";
		lcm_pins_default = "/fragment@7/__overlay__/lcmpinsdefault";
		led0 = "/fragment@1/__overlay__/led@0";
		led1 = "/fragment@1/__overlay__/led@1";
		led2 = "/fragment@1/__overlay__/led@2";
		led3 = "/fragment@1/__overlay__/led@3";
		led4 = "/fragment@1/__overlay__/led@4";
		led5 = "/fragment@1/__overlay__/led@5";
		led6 = "/fragment@1/__overlay__/led@6";
		mtkfb_pins_lcm_reset0 = "/fragment@8/__overlay__/lcm_rst_out0_gpio";
		mtkfb_pins_lcm_reset1 = "/fragment@8/__overlay__/lcm_rst_out1_gpio";
		nfc_mtk = "/fragment@40/__overlay__/nfc@08";
		oppo_project = "/fragment@1/__overlay__/oppo_project";
		slave_charger_mtk = "/fragment@40/__overlay__/slave_charger@4b";
		speaker_amp_mtk = "/fragment@40/__overlay__/speaker_amp@34";
		strobe_main_mtk = "/fragment@43/__overlay__/strobe_main@63";
		subpmic_pmu_mtk = "/fragment@42/__overlay__/subpmic_pmu@34";
		uart0_pins_default = "/fragment@14/__overlay__/uart0default";
		uart0_rx_output0 = "/fragment@14/__overlay__/rxoutput0";
		uart0_rx_output1 = "/fragment@14/__overlay__/rxoutput1";
		uart0_tx_output0 = "/fragment@14/__overlay__/txoutput0";
		uart0_tx_output1 = "/fragment@14/__overlay__/txoutput1";
		usb_type_c_mtk = "/fragment@42/__overlay__/usb_type_c@4e";
		vibrator0 = "/fragment@1/__overlay__/vibrator@0";
		volume_down_gpio_eint = "/fragment@5/__overlay__/volume_down@0";
		volume_up_gpio_eint = "/fragment@5/__overlay__/volume_up@0";
	};

	fragment@0 {
		target = <0xffffffff>;

		__overlay__ {
			atag,videolfb-fb_base_h = <0x0>;
			atag,videolfb-fb_base_l = "^`P";
			atag,videolfb-fps = <0x1770>;
			atag,videolfb-islcm_inited = <0x0>;
			atag,videolfb-islcmfound = <0x1>;
			atag,videolfb-lcmname = "nt35695B_fhd_dsi_cmd_auo_rt5081_drv";
			atag,videolfb-vramSize = <0x17bb000>;
		};
	};

	fragment@1 {
		target = <0xffffffff>;

		__overlay__ {

			kpd_volume_down {
				compatible = "mediatek, VOLUME_DOWN-eint";
				debounce = <0x7d00>;
				interrupt-parent = <0xffffffff>;
				interrupts = <0x5e 0x2 0x5e 0x0>;
				linux,phandle = <0x48>;
				phandle = <0x48>;
				status = "okay";
			};

			kpd_volume_up {
				compatible = "mediatek, VOLUME_UP-eint";
				debounce = <0x7d00>;
				interrupt-parent = <0xffffffff>;
				interrupts = <0x5d 0x2 0x5d 0x0>;
				linux,phandle = <0x47>;
				phandle = <0x47>;
				status = "okay";
			};

			led@0 {
				compatible = "mediatek,red";
				data = <0x1>;
				led_mode = <0x0>;
				linux,phandle = <0x3f>;
				phandle = <0x3f>;
				pwm_config = <0x0 0x0 0x0 0x0 0x0>;
			};

			led@1 {
				compatible = "mediatek,green";
				data = <0x1>;
				led_mode = <0x0>;
				linux,phandle = <0x40>;
				phandle = <0x40>;
				pwm_config = <0x0 0x0 0x0 0x0 0x0>;
			};

			led@2 {
				compatible = "mediatek,blue";
				data = <0x1>;
				led_mode = <0x0>;
				linux,phandle = <0x41>;
				phandle = <0x41>;
				pwm_config = <0x0 0x0 0x0 0x0 0x0>;
			};

			led@3 {
				compatible = "mediatek,jogball-backlight";
				data = <0x1>;
				led_mode = <0x0>;
				linux,phandle = <0x42>;
				phandle = <0x42>;
				pwm_config = <0x0 0x0 0x0 0x0 0x0>;
			};

			led@4 {
				compatible = "mediatek,keyboard-backlight";
				data = <0x1>;
				led_mode = <0x0>;
				linux,phandle = <0x43>;
				phandle = <0x43>;
				pwm_config = <0x0 0x0 0x0 0x0 0x0>;
			};

			led@5 {
				compatible = "mediatek,button-backlight";
				data = <0x1>;
				led_mode = <0x0>;
				linux,phandle = <0x44>;
				phandle = <0x44>;
				pwm_config = <0x0 0x0 0x0 0x0 0x0>;
			};

			led@6 {
				compatible = "mediatek,lcd-backlight";
				data = <0x1>;
				led_mode = <0x4>;
				linux,phandle = <0x45>;
				phandle = <0x45>;
				pwm_config = <0x0 0x3 0x0 0x0 0x0>;
			};

			oppo_project {
				compatible = "oppo,oppo_project";
				linux,phandle = <0x49>;
				phandle = <0x49>;
			};

			vibrator@0 {
				compatible = "mediatek,vibrator";
				linux,phandle = <0x46>;
				phandle = <0x46>;
				vib_limit = <0x9>;
				vib_timer = <0x19>;
				vib_vol = <0xb>;
			};
		};
	};

	fragment@10 {
		target = <0xffffffff>;

		__overlay__ {

			ilitek@0 {
				black_gesture_support;
				black_gesture_test_support;
				charger_pump_support;
				chip-name = "NF_ILI9881H";
				chip_name_himax = "NF_HX83102D";
				chip_name_ili9882n = "NF_ILI9882N";
				chip_name_novatek = "NF_NT36525B";
				compatible = "tchip,ilitek", "himax,hxcommon", "novatek,nf_nt36525b", "ilitek,nf_ili9882n";
				drlimit_remove_support;
				esd_handle_support;
				freq_hop_simulate_support;
				fw_edge_limit_support;
				fw_update_app_support;
				game_switch_support;
				headset_pump_support;
				incell_screen;
				interrupt-parent = <0xffffffff>;
				interrupts = <0x0 0x2 0x0 0x0>;
				irq-gpio = <0xffffffff 0x0 0x2002>;
				lcd_trigger_load_tp_fw_support;
				noflash_support;
				pinctrl-0 = <0xa>;
				pinctrl-1 = <0xb>;
				pinctrl-2 = <0xc>;
				pinctrl-3 = <0xd>;
				pinctrl-4 = <0xe>;
				pinctrl-5 = <0xf>;
				pinctrl-names = "default", "state_eint_as_int", "state_eint_output0", "state_eint_output1", "state_rst_output0", "state_rst_output1";
				pressure_report_support;
				reg = <0x0>;
				reset-gpio = <0xffffffff 0xae 0x0>;
				smart_gesture_support;
				spi-max-frequency = <0x927c00>;
				status = "okay";
				suspend_gesture_cfg;
				touchpanel,button-type = <0x4>;
				touchpanel,display-coords = <0x2d0 0x5f0>;
				touchpanel,max-num-support = <0xa>;
				touchpanel,panel-coords = <0x2d0 0x5f0>;
				touchpanel,touchmajor-limit = <0x0 0x36>;
				touchpanel,tx-rx-num = <0x12 0x20>;
			};
		};
	};

	fragment@11 {
		target = <0xffffffff>;

		__overlay__ {
			pinctrl-0 = <0xa>;
			pinctrl-1 = <0xb>;
			pinctrl-2 = <0xc>;
			pinctrl-3 = <0xd>;
			pinctrl-4 = <0xe>;
			pinctrl-5 = <0xf>;
			pinctrl-names = "default", "state_eint_as_int", "state_eint_output0", "state_eint_output1", "state_rst_output0", "state_rst_output1";
			status = "okay";
			tpd-filter-custom-prameters = <0x0 0x0 0x0 0x0 0x0 0x0 0x0 0x0 0x0 0x0 0x0 0x0>;
			tpd-filter-custom-speed = <0x0 0x0 0x0>;
			tpd-filter-enable = <0x0>;
			tpd-filter-pixel-density = <0x92>;
			tpd-key-dim-local = <0x5a 0x373 0x64 0x28 0xe6 0x373 0x64 0x28 0x172 0x373 0x64 0x28 0x0 0x0 0x0 0x0>;
			tpd-key-local = <0x8b 0xac 0x9e 0x0>;
			tpd-key-num = <0x3>;
			tpd-max-touch-num = <0xa>;
			tpd-resolution = <0x2d0 0x618>;
			use-tpd-button = <0x0>;
		};
	};

	fragment@12 {
		target = <0xffffffff>;

		__overlay__ {

			eint0default {
				linux,phandle = <0xa>;
				phandle = <0xa>;
			};

			eint@0 {
				linux,phandle = <0xb>;
				phandle = <0xb>;

				pins_cmd_dat {
					bias-disable;
					pinmux = <0x0>;
					slew-rate = <0x0>;
				};
			};

			eintoutput0 {
				linux,phandle = <0xc>;
				phandle = <0xc>;

				pins_cmd_dat {
					output-low;
					pinmux = <0x0>;
					slew-rate = <0x1>;
				};
			};

			eintoutput1 {
				linux,phandle = <0xd>;
				phandle = <0xd>;

				pins_cmd_dat {
					output-high;
					pinmux = <0x0>;
					slew-rate = <0x1>;
				};
			};

			rstoutput0 {
				linux,phandle = <0xe>;
				phandle = <0xe>;

				pins_cmd_dat {
					output-low;
					pinmux = <0xae00>;
					slew-rate = <0x1>;
				};
			};

			rstoutput1 {
				linux,phandle = <0xf>;
				phandle = <0xf>;

				pins_cmd_dat {
					output-high;
					pinmux = <0xae00>;
					slew-rate = <0x1>;
				};
			};
		};
	};

	fragment@13 {
		target = <0xffffffff>;

		__overlay__ {
			pinctrl-0 = <0x10>;
			pinctrl-1 = <0x11>;
			pinctrl-2 = <0x12>;
			pinctrl-3 = <0x13>;
			pinctrl-4 = <0x14>;
			pinctrl-names = "default", "state_uart0_rx_output0", "state_uart0_rx_output1", "state_uart0_tx_output0", "state_uart0_tx_output1";
			status = "okay";
		};
	};

	fragment@14 {
		target = <0xffffffff>;

		__overlay__ {

			rxoutput0 {
				linux,phandle = <0x11>;
				phandle = <0x11>;

				pins_cmd_dat {
					output-low;
					pinmux = <0x5f00>;
					slew-rate = <0x1>;
				};
			};

			rxoutput1 {
				linux,phandle = <0x12>;
				phandle = <0x12>;

				pins_cmd_dat {
					output-high;
					pinmux = <0x5f00>;
					slew-rate = <0x1>;
				};
			};

			txoutput0 {
				linux,phandle = <0x13>;
				phandle = <0x13>;

				pins_cmd_dat {
					output-low;
					pinmux = <0x6000>;
					slew-rate = <0x1>;
				};
			};

			txoutput1 {
				linux,phandle = <0x14>;
				phandle = <0x14>;

				pins_cmd_dat {
					output-high;
					pinmux = <0x6000>;
					slew-rate = <0x1>;
				};
			};

			uart0default {
				linux,phandle = <0x10>;
				phandle = <0x10>;
			};
		};
	};

	fragment@15 {
		target = <0xffffffff>;

		__overlay__ {

			consys_default {
				linux,phandle = <0x15>;
				phandle = <0x15>;
			};

			gpslna@0 {
				linux,phandle = <0x16>;
				phandle = <0x16>;

				pins_cmd_dat {
					bias-disable;
					output-low;
					pinmux = <0x5b00>;
					slew-rate = <0x0>;
				};
			};

			gpslna@1 {
				linux,phandle = <0x17>;
				phandle = <0x17>;

				pins_cmd_dat {
					output-high;
					pinmux = <0x5b00>;
					slew-rate = <0x1>;
				};
			};

			gpslna@2 {
				linux,phandle = <0x18>;
				phandle = <0x18>;

				pins_cmd_dat {
					output-low;
					pinmux = <0x5b00>;
					slew-rate = <0x1>;
				};
			};
		};
	};

	fragment@16 {
		target = <0xffffffff>;

		__overlay__ {
			pinctrl-0 = <0x15>;
			pinctrl-1 = <0x16>;
			pinctrl-2 = <0x17>;
			pinctrl-3 = <0x18>;
			pinctrl-names = "default", "gps_lna_state_init", "gps_lna_state_oh", "gps_lna_state_ol";
			status = "okay";
		};
	};

	fragment@17 {
		target = <0xffffffff>;

		__overlay__ {
			accdet-mic-mode = <0x1>;
			accdet-mic-vol = <0x6>;
			accdet-plugout-debounce = <0x1>;
			headset-eint-level-pol = <0x8>;
			headset-four-key-threshold = <0x0 0x3a 0x79 0xc0 0x190>;
			headset-mode-setting = <0x500 0x500 0x1 0x1f0 0x800 0x800 0x20 0x44>;
			headset-three-key-threshold = <0x0 0x50 0xdc 0x190>;
			headset-three-key-threshold-CDD = <0x0 0x79 0xc0 0x258>;
			pinctrl-0 = <0x19>;
			pinctrl-1 = <0x1a>;
			pinctrl-names = "default", "state_eint_as_int";
			status = "okay";
		};
	};

	fragment@18 {
		target = <0xffffffff>;

		__overlay__ {

			accdetdefault {
				linux,phandle = <0x19>;
				phandle = <0x19>;
			};

			accdeteint@0 {
				linux,phandle = <0x1a>;
				phandle = <0x1a>;

				pins_cmd_dat {
					bias-disable;
					pinmux = <0x900>;
					slew-rate = <0x0>;
				};
			};
		};
	};

	fragment@19 {
		target = <0xffffffff>;

		__overlay__ {
			#address-cells = <0x1>;
			#size-cells = <0x0>;

			silead_fp@0 {
				compatible = "mediatek,finger_fp";
				netlink-event = <0x1e>;
				reg = <0x0>;
				spi-id = <0x1>;
				spi-irq = <0x7a>;
				spi-max-frequency = <0x7a1200>;
				spi-reg = <0x11010000>;
				status = "okay";
				vmch-supply = <0xffffffff>;
			};
		};
	};

	fragment@2 {
		target = <0xffffffff>;

		__overlay__ {

			ext_buck_lp4@57 {
				regulator-max-microvolt = <0x13d620>;
				regulator-min-microvolt = <0x493e0>;
				regulator-name = "ext_buck_vdd2";
				vsel_pin = <0x0>;
			};

			ext_buck_lp4x@50 {
				regulator-max-microvolt = <0x13d620>;
				regulator-min-microvolt = <0x493e0>;
				regulator-name = "ext_buck_vddq";
				vsel_pin = <0x1>;
			};
		};
	};

	fragment@20 {
		target = <0xffffffff>;

		__overlay__ {
			pinctrl-0 = <0x1b>;
			pinctrl-1 = <0x1c>;
			pinctrl-2 = <0x1d>;
			pinctrl-names = "default", "reset_high", "reset_low";
			status = "okay";
		};
	};

	fragment@21 {
		target = <0xffffffff>;

		__overlay__ {

			state_default {
				linux,phandle = <0x1b>;
				phandle = <0x1b>;

				pins_cmd_dat {
					bias-disable;
					pinmux = <0xab00>;
					slew-rate = <0x0>;
				};
			};

			state_reset_high {
				linux,phandle = <0x1c>;
				phandle = <0x1c>;

				pins_cmd_dat {
					output-high;
					pinmux = <0xab00>;
					slew-rate = <0x1>;
				};
			};

			state_reset_low {
				linux,phandle = <0x1d>;
				phandle = <0x1d>;

				pins_cmd_dat {
					output-low;
					pinmux = <0xab00>;
					slew-rate = <0x1>;
				};
			};
		};
	};

	fragment@22 {
		target = <0xffffffff>;

		__overlay__ {
			EMBEDDED_SEL = <0x1>;
		};
	};

	fragment@23 {
		target = <0xffffffff>;

		__overlay__ {
			pinctrl-0 = <0x1e>;
			pinctrl-1 = <0x1f>;
			pinctrl-names = "irtx_gpio_led_default", "irtx_gpio_led_set";
			status = "okay";
		};
	};

	fragment@24 {
		target = <0xffffffff>;

		__overlay__ {

			irtx_gpio_led_def@gpio90 {
				linux,phandle = <0x1e>;
				phandle = <0x1e>;

				pins_cmd_dat {
					bias-disable;
					input-schmitt-enable = <0x0>;
					output-low;
					pinmux = <0x5a00>;
					slew-rate = <0x1>;
				};
			};

			irtx_gpio_led_set@gpio90 {
				linux,phandle = <0x1f>;
				phandle = <0x1f>;

				pins_cmd_dat {
					output-high;
					pinmux = <0x5a02>;
					slew-rate = <0x1>;
				};
			};
		};
	};

	fragment@25 {
		target = <0xffffffff>;

		__overlay__ {
			gpio_audio_pa_ctrl = <0xffffffff 0x9f 0x0>;
			pinctrl-0 = <0x20>;
			pinctrl-1 = <0x21>;
			pinctrl-2 = <0x22>;
			pinctrl-3 = <0x23>;
			pinctrl-4 = <0x24>;
			pinctrl-5 = <0x25>;
			pinctrl-6 = <0x26>;
			pinctrl-7 = <0x27>;
			pinctrl-8 = <0x28>;
			pinctrl-9 = <0x29>;
			pinctrl-names = "aud_clk_mosi_off", "aud_clk_mosi_on", "aud_clk_miso_off", "aud_clk_miso_on", "aud_dat_mosi_off", "aud_dat_mosi_on", "aud_dat_miso_off", "aud_dat_miso_on", "extamp-pulllow", "extamp-pullhigh";
			status = "okay";
		};
	};

	fragment@26 {
		target = <0xffffffff>;

		__overlay__ {

			aud_clk_miso_off {
				linux,phandle = <0x22>;
				phandle = <0x22>;

				pins_cmd0_dat {
					pinmux = <0x8c00>;
				};
			};

			aud_clk_miso_on {
				linux,phandle = <0x23>;
				phandle = <0x23>;

				pins_cmd0_dat {
					pinmux = <0x8c01>;
				};
			};

			aud_clk_mosi_off {
				linux,phandle = <0x20>;
				phandle = <0x20>;

				pins_cmd0_dat {
					pinmux = <0x8800>;
				};
			};

			aud_clk_mosi_on {
				linux,phandle = <0x21>;
				phandle = <0x21>;

				pins_cmd0_dat {
					pinmux = <0x8801>;
				};
			};

			aud_dat_miso_off {
				linux,phandle = <0x26>;
				phandle = <0x26>;

				pins_cmd1_dat {
					bias-disable;
					input-enable;
					pinmux = <0x8e00>;
					slew-rate = <0x0>;
				};

				pins_cmd2_dat {
					bias-disable;
					input-enable;
					pinmux = <0x8f00>;
					slew-rate = <0x0>;
				};
			};

			aud_dat_miso_on {
				linux,phandle = <0x27>;
				phandle = <0x27>;

				pins_cmd1_dat {
					pinmux = <0x8e01>;
				};

				pins_cmd2_dat {
					pinmux = <0x8f01>;
				};
			};

			aud_dat_mosi_off {
				linux,phandle = <0x24>;
				phandle = <0x24>;

				pins_cmd1_dat {
					bias-disable;
					input-enable;
					pinmux = <0x8a00>;
					slew-rate = <0x0>;
				};

				pins_cmd2_dat {
					bias-disable;
					input-enable;
					pinmux = <0x8b00>;
					slew-rate = <0x0>;
				};
			};

			aud_dat_mosi_on {
				linux,phandle = <0x25>;
				phandle = <0x25>;

				pins_cmd1_dat {
					pinmux = <0x8a01>;
				};

				pins_cmd2_dat {
					pinmux = <0x8b01>;
				};
			};

			aud_pins_extamp_pullhigh {
				linux,phandle = <0x29>;
				phandle = <0x29>;

				pins_cmd_dat {
					output-high;
					pinmux = <0x9f00>;
					slew-rate = <0x1>;
				};
			};

			aud_pins_extamp_pulllow {
				linux,phandle = <0x28>;
				phandle = <0x28>;

				pins_cmd_dat {
					output-low;
					pinmux = <0x9f00>;
					slew-rate = <0x1>;
				};
			};
		};
	};

	fragment@27 {
		target = <0xffffffff>;

		__overlay__ {
			mt6370,intr_gpio = <0xffffffff 0xb 0x0>;
			mt6370,intr_gpio_num = <0xb>;
		};
	};

	fragment@28 {
		target = <0xffffffff>;

		__overlay__ {
			mt6370pd,intr_gpio = <0xffffffff 0x29 0x0>;
			mt6370pd,intr_gpio_num = <0x29>;
		};
	};

	fragment@29 {
		target = <0xffffffff>;

		__overlay__ {
			algorithm_name = "SwitchCharging";
			chg1_ta_ac_charger_current = <0x1e8480>;
			chg2_ta_ac_charger_current = <0x1e8480>;
			qcom,batt_capacity_mah = <0x1086>;
			qcom,charge_current_calling_ma = <0x1f4>;
			qcom,charger_hv_thr = <0x16a8>;
			qcom,charger_lv_thr = <0xd48>;
			qcom,check_batt_full_by_sw;
			qcom,chg_ctrl_by_calling;
			qcom,chg_ctrl_by_camera;
			qcom,chg_ctrl_by_cool_down;
			qcom,chg_ctrl_by_lcd;
			qcom,cold_bat_decidegc = <0x14>;
			qcom,cold_vfloat_over_sw_limit = <0xf8c>;
			qcom,cold_vfloat_sw_limit = <0xf5a>;
			qcom,cool_bat_decidegc = <0x32>;
			qcom,cool_vfloat_over_sw_limit = <0x1131>;
			qcom,cool_vfloat_sw_limit = <0x10ef>;
			qcom,default_iterm_ma = <0xcd>;
			qcom,default_normal_vfloat_over_sw_limit = <0x1131>;
			qcom,default_normal_vfloat_sw_limit = <0x10ef>;
			qcom,default_temp_normal_fastchg_current_ma = <0x7d0>;
			qcom,default_temp_normal_vfloat_mv = <0x1121>;
			qcom,hot_bat_decidegc = <0x212>;
			qcom,input_current_calling_ma = <0x384>;
			qcom,input_current_camera_ma = <0x4b0>;
			qcom,input_current_cdp_ma = <0x5dc>;
			qcom,input_current_charger_ma = <0x7d0>;
			qcom,input_current_cool_down_ma = <0x1f4>;
			qcom,input_current_led_ma = <0x4b0>;
			qcom,input_current_led_ma_high = <0x4b0>;
			qcom,input_current_led_ma_normal = <0x4b0>;
			qcom,input_current_led_ma_warm = <0x4b0>;
			qcom,input_current_usb_ma = <0x1f4>;
			qcom,iterm_disabled = <0x0>;
			qcom,iterm_ma = <0xcd>;
			qcom,little_cold_bat_decidegc = <0x0>;
			qcom,little_cold_vfloat_over_sw_limit = <0x1131>;
			qcom,little_cold_vfloat_sw_limit = <0x10ef>;
			qcom,little_cool_bat_decidegc = <0x78>;
			qcom,little_cool_vfloat_over_sw_limit = <0x1131>;
			qcom,little_cool_vfloat_sw_limit = <0x10ef>;
			qcom,max_chg_time_sec = <0x8ca0>;
			qcom,non_normal_vterm_hw_inc = <0x14>;
			qcom,non_standard_fastchg_current_ma = <0x200>;
			qcom,non_standard_vfloat_mv = <0xf8c>;
			qcom,non_standard_vfloat_over_sw_limit = <0xf8c>;
			qcom,non_standard_vfloat_sw_limit = <0xf5a>;
			qcom,normal_bat_decidegc = <0xa0>;
			qcom,normal_vfloat_over_sw_limit = <0x1131>;
			qcom,normal_vfloat_sw_limit = <0x10ef>;
			qcom,normal_vterm_hw_inc = <0x14>;
			qcom,overtemp_bat_decidegc = <0x15e>;
			qcom,recharge-mv = <0x64>;
			qcom,removed_bat_decidegc = <0xbe>;
			qcom,sw_vfloat_over_protect_enable;
			qcom,temp_cold_fastchg_current_ma = <0x168>;
			qcom,temp_cold_vfloat_mv = <0xf8c>;
			qcom,temp_cool_fastchg_current_ma_high = <0x4e2>;
			qcom,temp_cool_fastchg_current_ma_low = <0x28a>;
			qcom,temp_cool_vfloat_mv = <0x1121>;
			qcom,temp_little_cold_fastchg_current_ma = <0x226>;
			qcom,temp_little_cold_fastchg_current_ma_high = <0x226>;
			qcom,temp_little_cold_fastchg_current_ma_low = <0x226>;
			qcom,temp_little_cold_vfloat_mv = <0x1121>;
			qcom,temp_little_cool_fastchg_current_ma = <0x6fe>;
			qcom,temp_little_cool_vfloat_mv = <0x1121>;
			qcom,temp_normal_fastchg_current_ma = <0x7d0>;
			qcom,temp_normal_vfloat_mv = <0x1121>;
			qcom,temp_warm_fastchg_current_ma = <0x4e2>;
			qcom,temp_warm_fastchg_current_ma_led_on = <0x1f4>;
			qcom,temp_warm_vfloat_mv = <0x1022>;
			qcom,vbatt_full_thr = <0x1130>;
			qcom,vbatt_hv_thr = <0x1194>;
			qcom,vbatt_num = <0x1>;
			qcom,vbatt_power_off = <0xce4>;
			qcom,vbatt_soc_1 = <0xd52>;
			qcom,vfloat_step_mv = <0x10>;
			qcom,vooc_project = <0x0>;
			qcom,warm_bat_decidegc = <0x1c2>;
			qcom,warm_vfloat_over_sw_limit = <0x1036>;
			qcom,warm_vfloat_sw_limit = <0xff0>;
		};
	};

	fragment@3 {
		target = <0xffffffff>;

		__overlay__ {

			ext_buck_vgpu@55 {
				regulator-max-microvolt = <0x13d620>;
				regulator-min-microvolt = <0x493e0>;
				regulator-name = "ext_buck_vgpu";
				vsel_pin = <0x2>;
			};
		};
	};

	fragment@30 {
		target = <0xffffffff>;

		__overlay__ {

			bq25601@6B {
				compatible = "ti,bq25601";
				reg = <0x6b>;
				ti,bq2560x,boost-current = <0x4b0>;
				ti,bq2560x,boost-voltage = <0x1386>;
				ti,bq2560x,enable_term;
				ti,bq2560x,precharge-current = <0x100>;
				ti,bq2560x,stat-pin-ctrl = <0x3>;
				ti,bq2560x,termination-current = <0x12c>;
				ti,bq2560x,usb-ichg = <0x1f4>;
				ti,bq2560x,usb-ilim = <0x1f4>;
				ti,bq2560x,usb-vlim = <0x11f8>;
				ti,bq2560x,usb-vreg = <0x1130>;
				ti,bq2560x,vac-ovp-threshold = <0x1964>;
			};

			subpmic_pmu@34 {
				sm5414,intr_gpio = <0xffffffff 0xb 0x0>;
				sm5414,intr_gpio_num = <0xb>;
				status = "okay";
			};
		};
	};

	fragment@31 {
		target = <0xffffffff>;

		__overlay__ {

			rt9465@4b {
				charger_name = "secondary_chg";
				compatible = "richtek,rt9465";
				cv = <0x456d70>;
				en_st;
				en_wdt;
				ichg = <0x16e360>;
				ieoc = <0xaae60>;
				interrupt-names = "wdtmri";
				mivr = <0x44aa20>;
				reg = <0x4b>;
				rt,en_gpio = <0xffffffff 0xb0 0x0>;
				rt,en_gpio_num = <0xb0>;
				rt,intr_gpio = <0xffffffff 0x17 0x0>;
				rt,intr_gpio_num = <0x17>;
				safety_timer = <0xc>;
				status = "okay";
			};
		};
	};

	fragment@32 {
		target = <0xffffffff>;

		__overlay__ {

			cam0@0 {
				linux,phandle = <0x2b>;
				phandle = <0x2b>;

				pins_cmd_dat {
					output-low;
					pinmux = <0x6500>;
					slew-rate = <0x1>;
				};
			};

			cam0@1 {
				linux,phandle = <0x2c>;
				phandle = <0x2c>;

				pins_cmd_dat {
					output-high;
					pinmux = <0x6500>;
					slew-rate = <0x1>;
				};
			};

			cam0@vcama0 {
				linux,phandle = <0x36>;
				phandle = <0x36>;

				pins_cmd_dat {
					output-low;
					pinmux = <0xaf00>;
					slew-rate = <0x1>;
				};
			};

			cam0@vcama1 {
				linux,phandle = <0x35>;
				phandle = <0x35>;

				pins_cmd_dat {
					output-high;
					pinmux = <0xaf00>;
					slew-rate = <0x1>;
				};
			};

			cam1@0 {
				linux,phandle = <0x2d>;
				phandle = <0x2d>;

				pins_cmd_dat {
					output-low;
					pinmux = <0x6600>;
					slew-rate = <0x1>;
				};
			};

			cam1@1 {
				linux,phandle = <0x2e>;
				phandle = <0x2e>;

				pins_cmd_dat {
					output-high;
					pinmux = <0x6600>;
					slew-rate = <0x1>;
				};
			};

			cam1@2 {
				linux,phandle = <0x2f>;
				phandle = <0x2f>;

				pins_cmd_dat {
					output-low;
					pinmux = <0xa700>;
					slew-rate = <0x1>;
				};
			};

			cam1@3 {
				linux,phandle = <0x30>;
				phandle = <0x30>;

				pins_cmd_dat {
					output-high;
					pinmux = <0xa700>;
					slew-rate = <0x1>;
				};
			};

			cam1@vcama0 {
				linux,phandle = <0x38>;
				phandle = <0x38>;

				pins_cmd_dat {
					output-low;
					pinmux = <0xaf00>;
					slew-rate = <0x1>;
				};
			};

			cam1@vcama1 {
				linux,phandle = <0x37>;
				phandle = <0x37>;

				pins_cmd_dat {
					output-high;
					pinmux = <0xaf00>;
					slew-rate = <0x1>;
				};
			};

			cam2@0 {
				linux,phandle = <0x31>;
				phandle = <0x31>;

				pins_cmd_dat {
					output-low;
					pinmux = <0x6d00>;
					slew-rate = <0x1>;
				};
			};

			cam2@1 {
				linux,phandle = <0x32>;
				phandle = <0x32>;

				pins_cmd_dat {
					output-high;
					pinmux = <0x6d00>;
					slew-rate = <0x1>;
				};
			};

			cam2@2 {
				linux,phandle = <0x33>;
				phandle = <0x33>;

				pins_cmd_dat {
					output-low;
					pinmux = <0x6b00>;
					slew-rate = <0x1>;
				};
			};

			cam2@3 {
				linux,phandle = <0x34>;
				phandle = <0x34>;

				pins_cmd_dat {
					output-high;
					pinmux = <0x6b00>;
					slew-rate = <0x1>;
				};
			};

			camdefault {
				linux,phandle = <0x2a>;
				phandle = <0x2a>;
			};

			camera_pins_cam0_mclk_off {
				linux,phandle = <0x3a>;
				phandle = <0x3a>;

				pins_cmd_dat {
					pinmux = <0x6300>;
				};
			};

			camera_pins_cam0_mclk_on {
				linux,phandle = <0x39>;
				phandle = <0x39>;

				pins_cmd_dat {
					pinmux = <0x6301>;
				};
			};

			camera_pins_cam1_mclk_off {
				linux,phandle = <0x3c>;
				phandle = <0x3c>;

				pins_cmd_dat {
					pinmux = <0x6400>;
				};
			};

			camera_pins_cam1_mclk_on {
				linux,phandle = <0x3b>;
				phandle = <0x3b>;

				pins_cmd_dat {
					pinmux = <0x6401>;
				};
			};

			camera_pins_cam2_mclk_off {
				linux,phandle = <0x3e>;
				phandle = <0x3e>;

				pins_cmd_dat {
					pinmux = <0x6c00>;
				};
			};

			camera_pins_cam2_mclk_on {
				linux,phandle = <0x3d>;
				phandle = <0x3d>;

				pins_cmd_dat {
					pinmux = <0x6c01>;
				};
			};
		};
	};

	fragment@33 {
		target = <0xffffffff>;

		__overlay__ {
			camera-main-af-en = <0xffffffff 0xb1 0x0>;
			pinctrl-0 = <0x2a>;
			pinctrl-1 = <0x2b>;
			pinctrl-10 = <0x34>;
			pinctrl-11 = <0x35>;
			pinctrl-12 = <0x36>;
			pinctrl-13 = <0x37>;
			pinctrl-14 = <0x38>;
			pinctrl-15 = <0x39>;
			pinctrl-16 = <0x3a>;
			pinctrl-17 = <0x3b>;
			pinctrl-18 = <0x3c>;
			pinctrl-19 = <0x3d>;
			pinctrl-2 = <0x2c>;
			pinctrl-20 = <0x3e>;
			pinctrl-3 = <0x2d>;
			pinctrl-4 = <0x2e>;
			pinctrl-5 = <0x2f>;
			pinctrl-6 = <0x30>;
			pinctrl-7 = <0x31>;
			pinctrl-8 = <0x32>;
			pinctrl-9 = <0x33>;
			pinctrl-names = "default", "cam0_rst0", "cam0_rst1", "cam1_rst0", "cam1_rst1", "cam1_pnd0", "cam1_pnd1", "cam2_rst0", "cam2_rst1", "cam2_pnd0", "cam2_pnd1", "cam0_vcama_on", "cam0_vcama_off", "cam1_vcama_on", "cam1_vcama_off", "cam0_mclk_on", "cam0_mclk_off", "cam1_mclk_on", "cam1_mclk_off", "cam2_mclk_on", "cam2_mclk_off";
			status = "okay";
		};
	};

	fragment@34 {
		target = <0xffffffff>;

		__overlay__ {
			compatible = "mediatek, swtp-eint";
		};
	};

	fragment@35 {
		target = <0xffffffff>;

		__overlay__ {

			adc_channel@ {
				compatible = "mediatek,adc_channel";
				mediatek,adc_fdd_rf_params_dynamic_custom_ch = <0x4>;
				mediatek,temperature0 = <0x0>;
				mediatek,temperature1 = <0x1>;
				status = "okay";
			};
		};
	};

	fragment@36 {
		target = <0xffffffff>;

		__overlay__ {
			mediatek,clkbuf-config = <0x2 0x1 0x1 0x2 0x0 0x0 0x0>;
			mediatek,clkbuf-driving-current = <0x1 0x1 0x1 0x1 0x1 0x1 0x1>;
			mediatek,clkbuf-quantity = <0x7>;
			status = "okay";
		};
	};

	fragment@37 {
		target = <0xffffffff>;

		__overlay__ {
			#address-cells = <0x1>;
			#size-cells = <0x0>;
			clock-frequency = <0x61a80>;
			mediatek,use-open-drain;
		};
	};

	fragment@38 {
		target = <0xffffffff>;

		__overlay__ {
			#address-cells = <0x1>;
			#size-cells = <0x0>;
			clock-frequency = <0x61a80>;
			mediatek,use-open-drain;
		};
	};

	fragment@39 {
		target = <0xffffffff>;

		__overlay__ {
			#address-cells = <0x1>;
			#size-cells = <0x0>;
			clock-frequency = <0x61a80>;
			mediatek,use-open-drain;

			camera_main@20 {
				compatible = "mediatek,camera_main";
				linux,phandle = <0x4a>;
				phandle = <0x4a>;
				reg = <0x20>;
				status = "okay";
			};

			camera_main_af@0c {
				compatible = "mediatek,camera_main_af";
				linux,phandle = <0x4c>;
				phandle = <0x4c>;
				reg = <0xc>;
				status = "okay";
			};

			camera_main_eeprom@50 {
				compatible = "mediatek,camera_main_eeprom";
				linux,phandle = <0x4b>;
				phandle = <0x4b>;
				reg = <0x50>;
				status = "okay";
			};

			ccu_sensor_i2c_main_hw@35 {
				compatible = "mediatek,ccu_sensor_i2c_main_hw";
				linux,phandle = <0x4d>;
				phandle = <0x4d>;
				reg = <0x35>;
				status = "okay";
			};
		};
	};

	fragment@4 {
		target = <0xffffffff>;

		__overlay__ {
			keypad,volume-down = <0xffffffff 0x5e 0x0>;
			keypad,volume-up = <0xffffffff 0x5d 0x0>;
			pinctrl-0 = <0x1>;
			pinctrl-1 = <0x2>;
			pinctrl-names = "volume_up_as_int", "volume_down_as_int";
			status = "okay";
		};
	};

	fragment@40 {
		target = <0xffffffff>;

		__overlay__ {
			#address-cells = <0x1>;
			#size-cells = <0x0>;
			clock-frequency = <0x61a80>;
			mediatek,use-open-drain;

			ext_buck_lp4@57 {
				compatible = "mediatek,ext_buck_lp4";
				linux,phandle = <0x51>;
				phandle = <0x51>;
				reg = <0x57>;
				status = "okay";
			};

			ext_buck_lp4x@50 {
				compatible = "mediatek,ext_buck_lp4x";
				linux,phandle = <0x52>;
				phandle = <0x52>;
				reg = <0x50>;
				status = "okay";
			};

			nfc@08 {
				compatible = "mediatek,nfc";
				linux,phandle = <0x50>;
				phandle = <0x50>;
				reg = <0x8>;
				status = "okay";
			};

			slave_charger@4b {
				compatible = "mediatek,slave_charger";
				linux,phandle = <0x4f>;
				phandle = <0x4f>;
				reg = <0x4b>;
				status = "okay";
			};

			speaker_amp@34 {
				compatible = "mediatek,speaker_amp";
				linux,phandle = <0x4e>;
				phandle = <0x4e>;
				reg = <0x34>;
				status = "okay";
			};
		};
	};

	fragment@41 {
		target = <0xffffffff>;

		__overlay__ {
			#address-cells = <0x1>;
			#size-cells = <0x0>;
			clock-frequency = <0x61a80>;
			mediatek,use-open-drain;

			camera_main_two@7a {
				compatible = "mediatek,camera_main_two";
				linux,phandle = <0x53>;
				phandle = <0x53>;
				reg = <0x7a>;
				status = "okay";
			};

			camera_main_two_af@0c {
				compatible = "mediatek,camera_main_two_af";
				linux,phandle = <0x55>;
				phandle = <0x55>;
				reg = <0xc>;
				status = "okay";
			};

			camera_main_two_eeprom@50 {
				compatible = "mediatek,camera_main_two_eeprom";
				linux,phandle = <0x54>;
				phandle = <0x54>;
				reg = <0x50>;
				status = "okay";
			};

			camera_sub@2d {
				compatible = "mediatek,camera_sub";
				linux,phandle = <0x56>;
				phandle = <0x56>;
				reg = <0x2d>;
				status = "okay";
			};

			camera_sub_eeprom@54 {
				compatible = "mediatek,camera_sub_eeprom";
				linux,phandle = <0x57>;
				phandle = <0x57>;
				reg = <0x54>;
				status = "okay";
			};

			camera_sub_two@6e {
				compatible = "mediatek,camera_sub_two";
				linux,phandle = <0x5a>;
				phandle = <0x5a>;
				reg = <0x6e>;
				status = "okay";
			};

			camera_sub_two_eeprom@a4 {
				compatible = "mediatek,camera_sub_two_eeprom";
				linux,phandle = <0x5b>;
				phandle = <0x5b>;
				reg = <0xa4>;
				status = "okay";
			};

			ccu_sensor_i2c_main2_hw@10 {
				compatible = "mediatek,ccu_sensor_i2c_main2_hw";
				linux,phandle = <0x59>;
				phandle = <0x59>;
				reg = <0x10>;
				status = "okay";
			};

			ccu_sensor_i2c_sub_hw@11 {
				compatible = "mediatek,ccu_sensor_i2c_sub_hw";
				linux,phandle = <0x58>;
				phandle = <0x58>;
				reg = <0x11>;
				status = "okay";
			};
		};
	};

	fragment@42 {
		target = <0xffffffff>;

		__overlay__ {
			#address-cells = <0x1>;
			#size-cells = <0x0>;
			clock-frequency = <0x61a80>;
			mediatek,use-push-pull;

			subpmic_pmu@34 {
				compatible = "mediatek,subpmic_pmu";
				linux,phandle = <0x5c>;
				phandle = <0x5c>;
				reg = <0x34>;
				status = "okay";
			};

			usb_type_c@4e {
				compatible = "mediatek,usb_type_c";
				linux,phandle = <0x5d>;
				phandle = <0x5d>;
				reg = <0x4e>;
				status = "okay";
			};
		};
	};

	fragment@43 {
		target = <0xffffffff>;

		__overlay__ {
			#address-cells = <0x1>;
			#size-cells = <0x0>;
			clock-frequency = <0x61a80>;
			mediatek,use-open-drain;

			ext_buck_vgpu@55 {
				compatible = "mediatek,ext_buck_vgpu";
				linux,phandle = <0x5f>;
				phandle = <0x5f>;
				reg = <0x55>;
				status = "okay";
			};

			strobe_main@63 {
				compatible = "mediatek,strobe_main";
				linux,phandle = <0x5e>;
				phandle = <0x5e>;
				reg = <0x63>;
				status = "okay";
			};
		};
	};

	fragment@44 {
		target = <0xffffffff>;

		__overlay__ {
			#address-cells = <0x1>;
			#size-cells = <0x0>;
			clock-frequency = <0x61a80>;
			mediatek,use-open-drain;
		};
	};

	fragment@45 {
		target = <0xffffffff>;

		__overlay__ {
			#address-cells = <0x1>;
			#size-cells = <0x0>;
			clock-frequency = <0x61a80>;
			mediatek,use-open-drain;
		};
	};

	fragment@46 {
		target = <0xffffffff>;

		__overlay__ {
			#address-cells = <0x1>;
			#size-cells = <0x0>;
			clock-frequency = <0x61a80>;
			mediatek,use-open-drain;
		};
	};

	fragment@47 {
		target = <0xffffffff>;

		__overlay__ {
			GPIO_FDD_BAND_SUPPORT_DETECT_1ST_PIN = <0xffffffff 0xa5 0x0>;
			GPIO_FDD_BAND_SUPPORT_DETECT_2ND_PIN = <0xffffffff 0xa4 0x0>;
			GPIO_FDD_BAND_SUPPORT_DETECT_3RD_PIN = <0xffffffff 0xa3 0x0>;
			GPIO_SIM1_HOT_PLUG = <0xffffffff 0x2f 0x0>;
			GPIO_SIM1_SCLK = <0xffffffff 0x26 0x0>;
			GPIO_SIM1_SIO = <0xffffffff 0x28 0x0>;
			GPIO_SIM1_SRST = <0xffffffff 0x27 0x0>;
			GPIO_SIM2_HOT_PLUG = <0xffffffff 0x2e 0x0>;
			GPIO_SIM2_SCLK = <0xffffffff 0x25 0x0>;
			GPIO_SIM2_SIO = <0xffffffff 0x23 0x0>;
			GPIO_SIM2_SRST = <0xffffffff 0x24 0x0>;
		};
	};

	fragment@48 {
		target = <0xffffffff>;

		__overlay__ {
			gpio_init_default = <0x0 0x0 0x0 0x0 0x1 0x1 0x1 0x1 0x0 0x0 0x0 0x1 0x1 0x1 0x2 0x0 0x0 0x0 0x1 0x1 0x1 0x3 0x0 0x0 0x0 0x1 0x1 0x1 0x4 0x0 0x0 0x0 0x1 0x1 0x0 0x5 0x0 0x0 0x0 0x1 0x1 0x0 0x6 0x0 0x0 0x0 0x1 0x1 0x0 0x7 0x0 0x0 0x0 0x1 0x0 0x0 0x8 0x0 0x0 0x0 0x1 0x0 0x0 0x9 0x0 0x0 0x0 0x1 0x0 0x0 0xa 0x0 0x0 0x0 0x1 0x1 0x0 0xb 0x0 0x0 0x0 0x1 0x1 0x0 0xc 0x0 0x0 0x0 0x1 0x1 0x0 0xd 0x3 0x0 0x0 0x1 0x0 0x0 0xe 0x3 0x1 0x0 0x0 0x0 0x0 0xf 0x3 0x1 0x0 0x0 0x0 0x0 0x10 0x3 0x1 0x0 0x0 0x0 0x0 0x11 0x0 0x0 0x0 0x1 0x0 0x0 0x12 0x0 0x0 0x0 0x1 0x0 0x0 0x13 0x0 0x0 0x0 0x1 0x0 0x0 0x14 0x0 0x0 0x0 0x1 0x0 0x0 0x15 0x1 0x0 0x0 0x1 0x0 0x0 0x16 0x1 0x1 0x0 0x0 0x0 0x0 0x17 0x1 0x1 0x0 0x0 0x0 0x0 0x18 0x1 0x1 0x0 0x0 0x0 0x0 0x19 0x1 0x0 0x0 0x1 0x0 0x0 0x1a 0x1 0x1 0x0 0x0 0x0 0x0 0x1b 0x1 0x1 0x0 0x0 0x0 0x0 0x1c 0x1 0x1 0x0 0x0 0x0 0x0 0x1d 0x1 0x1 0x0 0x0 0x0 0x1 0x1e 0x1 0x0 0x0 0x1 0x1 0x1 0x1f 0x1 0x0 0x0 0x1 0x1 0x1 0x20 0x1 0x0 0x0 0x1 0x1 0x1 0x21 0x1 0x0 0x0 0x1 0x1 0x1 0x22 0x1 0x0 0x0 0x1 0x1 0x1 0x23 0x1 0x0 0x0 0x1 0x1 0x0 0x24 0x1 0x1 0x0 0x0 0x0 0x0 0x25 0x1 0x1 0x0 0x0 0x0 0x0 0x26 0x1 0x1 0x0 0x0 0x0 0x0 0x27 0x1 0x1 0x0 0x0 0x0 0x0 0x28 0x1 0x0 0x0 0x1 0x1 0x0 0x29 0x1 0x0 0x0 0x1 0x1 0x0 0x2a 0x0 0x0 0x0 0x0 0x0 0x0 0x2b 0x0 0x0 0x0 0x1 0x0 0x0 0x2c 0x1 0x0 0x0 0x1 0x0 0x0 0x2d 0x0 0x1 0x0 0x0 0x0 0x0 0x2e 0x1 0x0 0x0 0x0 0x0 0x0 0x2f 0x1 0x0 0x0 0x0 0x0 0x0 0x30 0x1 0x0 0x0 0x1 0x1 0x1 0x31 0x1 0x0 0x0 0x1 0x1 0x1 0x32 0x1 0x0 0x0 0x1 0x1 0x1 0x33 0x1 0x0 0x0 0x1 0x1 0x1 0x34 0x1 0x1 0x0 0x1 0x0 0x0 0x35 0x1 0x1 0x0 0x1 0x0 0x0 0x36 0x1 0x1 0x0 0x1 0x0 0x0 0x37 0x1 0x1 0x0 0x1 0x0 0x0 0x38 0x1 0x1 0x0 0x1 0x0 0x0 0x39 0x0 0x0 0x0 0x0 0x0 0x0 0x3a 0x0 0x0 0x0 0x1 0x0 0x0 0x3b 0x1 0x0 0x0 0x1 0x0 0x0 0x3c 0x1 0x0 0x0 0x1 0x0 0x0 0x3d 0x1 0x0 0x0 0x1 0x0 0x0 0x3e 0x1 0x0 0x0 0x1 0x0 0x0 0x3f 0x1 0x0 0x0 0x1 0x0 0x0 0x40 0x1 0x0 0x0 0x1 0x0 0x0 0x41 0x0 0x0 0x0 0x1 0x0 0x0 0x42 0x0 0x0 0x0 0x1 0x0 0x0 0x43 0x1 0x0 0x0 0x1 0x0 0x0 0x44 0x1 0x0 0x0 0x1 0x0 0x0 0x45 0x1 0x1 0x0 0x1 0x0 0x0 0x46 0x1 0x1 0x0 0x1 0x0 0x0 0x47 0x1 0x1 0x0 0x1 0x0 0x0 0x48 0x1 0x1 0x0 0x1 0x0 0x0 0x49 0x1 0x1 0x0 0x1 0x0 0x0 0x4a 0x1 0x1 0x0 0x1 0x0 0x0 0x4b 0x1 0x1 0x0 0x1 0x0 0x0 0x4c 0x1 0x1 0x0 0x1 0x0 0x0 0x4d 0x1 0x1 0x0 0x1 0x0 0x0 0x4e 0x1 0x1 0x0 0x1 0x0 0x0 0x4f 0x0 0x0 0x0 0x1 0x0 0x0 0x50 0x0 0x0 0x0 0x1 0x0 0x0 0x51 0x1 0x0 0x0 0x1 0x1 0x1 0x52 0x0 0x0 0x0 0x1 0x0 0x1 0x53 0x0 0x0 0x0 0x1 0x0 0x1 0x54 0x1 0x0 0x0 0x1 0x1 0x1 0x55 0x1 0x1 0x0 0x1 0x0 0x0 0x56 0x1 0x1 0x0 0x1 0x0 0x0 0x57 0x0 0x1 0x1 0x0 0x0 0x0 0x58 0x0 0x1 0x0 0x1 0x0 0x0 0x59 0x0 0x0 0x0 0x1 0x0 0x0 0x5a 0x0 0x0 0x0 0x1 0x0 0x0 0x5b 0x0 0x1 0x0 0x1 0x0 0x0 0x5c 0x0 0x0 0x0 0x1 0x0 0x0 0x5d 0x1 0x0 0x0 0x1 0x1 0x0 0x5e 0x1 0x0 0x0 0x1 0x1 0x0 0x5f 0x1 0x0 0x0 0x1 0x1 0x0 0x60 0x1 0x1 0x0 0x0 0x0 0x0 0x61 0x0 0x1 0x0 0x0 0x0 0x0 0x62 0x0 0x1 0x0 0x0 0x0 0x0 0x63 0x1 0x1 0x0 0x0 0x0 0x0 0x64 0x1 0x1 0x0 0x0 0x0 0x0 0x65 0x0 0x1 0x1 0x0 0x0 0x0 0x66 0x0 0x1 0x1 0x0 0x0 0x0 0x67 0x1 0x0 0x0 0x1 0x1 0x1 0x68 0x1 0x0 0x0 0x1 0x1 0x1 0x69 0x1 0x0 0x0 0x1 0x1 0x1 0x6a 0x1 0x0 0x0 0x1 0x1 0x1 0x6b 0x0 0x1 0x0 0x0 0x0 0x0 0x6c 0x1 0x1 0x0 0x0 0x0 0x0 0x6d 0x0 0x1 0x1 0x0 0x0 0x0 0x6e 0x0 0x0 0x0 0x1 0x0 0x0 0x6f 0x0 0x0 0x0 0x1 0x0 0x0 0x70 0x0 0x0 0x0 0x1 0x0 0x0 0x71 0x0 0x0 0x0 0x1 0x0 0x0 0x72 0x0 0x0 0x0 0x1 0x0 0x0 0x73 0x0 0x0 0x0 0x1 0x0 0x0 0x74 0x0 0x0 0x0 0x1 0x0 0x0 0x75 0x0 0x0 0x0 0x1 0x0 0x0 0x76 0x0 0x0 0x0 0x1 0x0 0x0 0x77 0x0 0x0 0x0 0x1 0x0 0x0 0x78 0x0 0x0 0x0 0x1 0x0 0x0 0x79 0x0 0x0 0x0 0x1 0x0 0x0 0x7a 0x1 0x0 0x0 0x1 0x1 0x1 0x7b 0x1 0x0 0x0 0x1 0x1 0x1 0x7c 0x1 0x1 0x0 0x0 0x0 0x1 0x7d 0x1 0x0 0x0 0x1 0x1 0x1 0x7e 0x1 0x0 0x0 0x1 0x1 0x1 0x7f 0x1 0x0 0x0 0x1 0x1 0x1 0x80 0x1 0x0 0x0 0x1 0x1 0x1 0x81 0x1 0x0 0x0 0x1 0x1 0x1 0x82 0x1 0x0 0x0 0x1 0x1 0x1 0x83 0x1 0x0 0x0 0x1 0x0 0x1 0x84 0x1 0x0 0x0 0x1 0x1 0x1 0x85 0x1 0x1 0x1 0x0 0x0 0x1 0x86 0x1 0x0 0x0 0x1 0x0 0x1 0x87 0x1 0x1 0x0 0x0 0x0 0x0 0x88 0x1 0x1 0x0 0x0 0x0 0x0 0x89 0x1 0x1 0x0 0x0 0x0 0x0 0x8a 0x1 0x1 0x0 0x0 0x0 0x0 0x8b 0x1 0x1 0x0 0x0 0x0 0x0 0x8c 0x1 0x0 0x0 0x1 0x0 0x0 0x8d 0x1 0x0 0x0 0x1 0x0 0x0 0x8e 0x1 0x0 0x0 0x1 0x0 0x0 0x8f 0x1 0x0 0x0 0x1 0x0 0x0 0x90 0x1 0x0 0x0 0x1 0x0 0x0 0x91 0x1 0x1 0x1 0x0 0x0 0x0 0x92 0x1 0x0 0x0 0x1 0x0 0x0 0x93 0x1 0x1 0x0 0x0 0x0 0x0 0x94 0x1 0x1 0x0 0x0 0x0 0x0 0x95 0x1 0x1 0x0 0x0 0x0 0x0 0x96 0x0 0x1 0x0 0x0 0x0 0x0 0x97 0x0 0x1 0x0 0x0 0x0 0x0 0x98 0x0 0x1 0x0 0x0 0x0 0x0 0x99 0x0 0x0 0x0 0x1 0x0 0x0 0x9a 0x0 0x1 0x0 0x0 0x0 0x0 0x9b 0x0 0x1 0x0 0x0 0x0 0x0 0x9c 0x0 0x1 0x0 0x0 0x0 0x0 0x9d 0x0 0x1 0x0 0x0 0x0 0x0 0x9e 0x0 0x1 0x1 0x1 0x0 0x0 0x9f 0x0 0x1 0x0 0x0 0x0 0x0 0xa0 0x0 0x0 0x0 0x0 0x0 0x0 0xa1 0x1 0x0 0x0 0x1 0x1 0x1 0xa2 0x1 0x0 0x0 0x1 0x1 0x1 0xa3 0x0 0x0 0x0 0x0 0x0 0x0 0xa4 0x0 0x0 0x0 0x0 0x0 0x0 0xa5 0x0 0x0 0x0 0x0 0x0 0x0 0xa6 0x0 0x1 0x1 0x1 0x0 0x0 0xa7 0x0 0x1 0x0 0x0 0x0 0x0 0xa8 0x0 0x1 0x0 0x0 0x0 0x0 0xa9 0x0 0x1 0x0 0x0 0x0 0x0 0xaa 0x0 0x1 0x0 0x0 0x0 0x0 0xab 0x0 0x1 0x0 0x0 0x0 0x0 0xac 0x0 0x0 0x0 0x1 0x0 0x0 0xad 0x0 0x1 0x0 0x0 0x0 0x0 0xae 0x0 0x1 0x0 0x0 0x0 0x0 0xaf 0x0 0x1 0x0 0x0 0x0 0x0 0xb0 0x0 0x0 0x0 0x1 0x0 0x0 0xb1 0x0 0x1 0x0 0x0 0x0 0x0 0xb2 0x0 0x1 0x0 0x0 0x0 0x0 0xb3 0x0 0x0 0x0 0x1 0x0 0x0>;
		};
	};

	fragment@49 {
		target = <0xffffffff>;

		__overlay__ {
			interrupt-parent = <0xffffffff>;
			interrupts = <0x0 0x2 0x0 0x0>;
			status = "okay";
		};
	};

	fragment@5 {
		target = <0xffffffff>;

		__overlay__ {

			volume_down@0 {
				linux,phandle = <0x2>;
				phandle = <0x2>;

				pins_cmd_dat {
					input-enable;
					pinmux = <0x5e00>;
					slew-rate = <0x0>;
				};
			};

			volume_up@0 {
				linux,phandle = <0x1>;
				phandle = <0x1>;

				pins_cmd_dat {
					input-enable;
					pinmux = <0x5d00>;
					slew-rate = <0x0>;
				};
			};
		};
	};

	fragment@50 {
		target = <0xffffffff>;

		__overlay__ {
			interrupt-parent = <0xffffffff>;
			interrupts = <0x1 0x1 0x1 0x0>;
			status = "okay";
		};
	};

	fragment@51 {
		target = <0xffffffff>;

		__overlay__ {
			deb-gpios = <0xffffffff 0x2 0x0>;
			debounce = <0x7d000>;
			interrupt-parent = <0xffffffff>;
			interrupts = <0x2 0x8 0x2 0x0>;
			status = "okay";
		};
	};

	fragment@52 {
		target = <0xffffffff>;

		__overlay__ {
			interrupt-parent = <0xffffffff>;
			interrupts = <0x4 0x8 0x4 0x0>;
			status = "okay";
		};
	};

	fragment@53 {
		target = <0xffffffff>;

		__overlay__ {
			interrupt-parent = <0xffffffff>;
			interrupts = <0x5 0x8 0x5 0x0>;
			status = "okay";
		};
	};

	fragment@54 {
		target = <0xffffffff>;

		__overlay__ {
			interrupt-parent = <0xffffffff>;
			interrupts = <0xb 0x2 0xb 0x0>;
			status = "okay";
		};
	};

	fragment@55 {
		target = <0xffffffff>;

		__overlay__ {
			interrupt-parent = <0xffffffff>;
			interrupts = <0xc 0x8 0xc 0x0>;
			status = "okay";
		};
	};

	fragment@56 {
		target = <0xffffffff>;

		__overlay__ {
			interrupt-parent = <0xffffffff>;
			interrupts = <0x2c 0x1 0x2c 0x1>;
			status = "okay";
		};
	};

	fragment@57 {
		target = <0xffffffff>;

		__overlay__ {
			deb-gpios = <0xffffffff 0x39 0x0>;
			debounce = <0x3e800>;
			interrupt-parent = <0xffffffff>;
			interrupts = <0x39 0x4 0x39 0x0>;
			status = "okay";
		};
	};

	fragment@58 {
		target = <0xffffffff>;

		__overlay__ {
			interrupt-parent = <0xffffffff>;
			interrupts = <0x90 0x4 0x90 0x1>;
			status = "okay";
		};
	};

	fragment@59 {
		target = <0xffffffff>;

		__overlay__ {
			interrupt-parent = <0xffffffff>;
			interrupts = <0x93 0x8 0x29 0x1>;
			status = "okay";
		};
	};

	fragment@6 {
		target = <0xffffffff>;

		__overlay__ {
			pinctrl-0 = <0x3>;
			pinctrl-1 = <0x4>;
			pinctrl-2 = <0x5>;
			pinctrl-3 = <0x6>;
			pinctrl-4 = <0x7>;
			pinctrl-names = "default", "state_bais_N_output0", "state_bais_N_output1", "state_bais_P_output0", "state_bais_P_output1";
			status = "okay";
		};
	};

	fragment@60 {
		target = <0xffffffff>;

		__overlay__ {
			compatible = "mediatek,md1_sim1_hot_plug_eint-eint";
			debounce = <0x0 0x2710>;
			dedicated = <0x0 0x0>;
			interrupts = <0x0 0x8>;
			sockettype = <0x0 0x0>;
			src_pin = <0x0 0x1>;
			status = "okay";
		};
	};

	fragment@61 {
		target = <0xffffffff>;

		__overlay__ {
			compatible = "mediatek,md1_sim2_hot_plug_eint-eint";
			debounce = <0x1 0x2710>;
			dedicated = <0x1 0x0>;
			interrupts = <0x1 0x8>;
			sockettype = <0x1 0x0>;
			src_pin = <0x1 0x2>;
			status = "okay";
		};
	};

	fragment@62 {
		target = <0xffffffff>;

		__overlay__ {
			regulator-default-on = <0x1>;
			regulator-name = "vcama";
			status = "okay";
		};
	};

	fragment@63 {
		target = <0xffffffff>;

		__overlay__ {
			regulator-default-on = <0x1>;
			regulator-name = "vsim1";
			status = "okay";
		};
	};

	fragment@64 {
		target = <0xffffffff>;

		__overlay__ {
			regulator-default-on = <0x1>;
			regulator-name = "vsim2";
			status = "okay";
		};
	};

	fragment@65 {
		target = <0xffffffff>;

		__overlay__ {
			regulator-default-on = <0x1>;
			regulator-name = "vcamd";
			status = "okay";
		};
	};

	fragment@66 {
		target = <0xffffffff>;

		__overlay__ {
			regulator-default-on = <0x1>;
			regulator-name = "vcamio";
			status = "okay";
		};
	};

	fragment@67 {
		target = <0xffffffff>;

		__overlay__ {
			regulator-default-on = <0x1>;
			regulator-name = "vldo28";
			status = "okay";
		};
	};

	fragment@68 {
		target = <0xffffffff>;

		__overlay__ {
			status = "okay";
			vcama_main2-supply = <0xffffffff>;
			vcamaf-supply = <0xffffffff>;
			vcamd-supply = <0xffffffff>;
			vcamd_sub-supply = <0xffffffff>;
			vcamio-supply = <0xffffffff>;
			vcamio_main2-supply = <0xffffffff>;
			vcamio_sub-supply = <0xffffffff>;
		};
	};

	fragment@69 {
		target = <0xffffffff>;

		__overlay__ {
			status = "okay";
		};
	};

	fragment@7 {
		target = <0xffffffff>;

		__overlay__ {

			bais_N_output0 {
				linux,phandle = <0x4>;
				phandle = <0x4>;

				pins_cmd_dat {
					output-low;
					pinmux = <0x9700>;
					slew-rate = <0x1>;
				};
			};

			bais_N_output1 {
				linux,phandle = <0x5>;
				phandle = <0x5>;

				pins_cmd_dat {
					output-high;
					pinmux = <0x9700>;
					slew-rate = <0x1>;
				};
			};

			bais_P_output0 {
				linux,phandle = <0x6>;
				phandle = <0x6>;

				pins_cmd_dat {
					output-low;
					pinmux = <0x9600>;
					slew-rate = <0x1>;
				};
			};

			bais_P_output1 {
				linux,phandle = <0x7>;
				phandle = <0x7>;

				pins_cmd_dat {
					output-high;
					pinmux = <0x9600>;
					slew-rate = <0x1>;
				};
			};

			lcmpinsdefault {
				linux,phandle = <0x3>;
				phandle = <0x3>;
			};
		};
	};

	fragment@70 {
		target = <0xffffffff>;

		__overlay__ {
			mediatek,kpd-hw-dl-key0 = <0x11>;
			mediatek,kpd-hw-dl-key1 = <0x1>;
			mediatek,kpd-hw-dl-key2 = <0x8>;
			mediatek,kpd-hw-init-map = <0x0 0x72 0x0 0x0 0x0 0x0 0x0 0x0 0x0 0x0 0x0 0x0 0x0 0x0 0x0 0x0 0x0 0x0 0x0 0x0 0x0 0x0 0x0 0x0 0x0 0x0 0x0 0x0 0x0 0x0 0x0 0x0 0x0 0x0 0x0 0x0 0x0 0x0 0x0 0x0 0x0 0x0 0x0 0x0 0x0 0x0 0x0 0x0 0x0 0x0 0x0 0x0 0x0 0x0 0x0 0x0 0x0 0x0 0x0 0x0 0x0 0x0 0x0 0x0 0x0 0x0 0x0 0x0 0x0 0x0 0x0 0x0>;
			mediatek,kpd-hw-map-num = <0x48>;
			mediatek,kpd-hw-pwrkey = <0x8>;
			mediatek,kpd-hw-recovery-key = <0x1>;
			mediatek,kpd-hw-rstkey = <0x11>;
			mediatek,kpd-key-debounce = <0x400>;
			mediatek,kpd-pwkey-gpio-din = <0x0>;
			mediatek,kpd-pwrkey-eint-gpio = <0x0>;
			mediatek,kpd-sw-pwrkey = <0x74>;
			mediatek,kpd-sw-rstkey = <0x73>;
			mediatek,kpd-use-extend-type = <0x0>;
			status = "okay";
		};
	};

	fragment@8 {
		target = <0xffffffff>;

		__overlay__ {

			lcm_rst_out0_gpio {
				linux,phandle = <0x8>;
				phandle = <0x8>;

				pins_cmd_dat {
					output-low;
					pinmux = <0x2d00>;
					slew-rate = <0x1>;
				};
			};

			lcm_rst_out1_gpio {
				linux,phandle = <0x9>;
				phandle = <0x9>;

				pins_cmd_dat {
					output-high;
					pinmux = <0x2d00>;
					slew-rate = <0x1>;
				};
			};
		};
	};

	fragment@9 {
		target = <0xffffffff>;

		__overlay__ {
			pinctrl-0 = <0x8>;
			pinctrl-1 = <0x9>;
			pinctrl-names = "lcm_rst_out0_gpio", "lcm_rst_out1_gpio";
			status = "okay";
		};
	};
};
